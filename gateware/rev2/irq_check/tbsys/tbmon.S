* tbmon.S - FAKE //e MONITOR FOR
* irq_check SYSTEM SIM. NOT FOR THE //e.
* ENTRY POINTS SIT AT REAL ROM ADDRS.
* COUT WRITES $BFF0 (TB PRINTS IT),
* $BFF1 ENDS THE SIM.
* RESET: PR#4 THEN PR#5 (JSR $Cn00).
 TYP $06
 DSK tbmon.bin
 ORG $F800

OUT = $BFF0
FIN = $BFF1

* IRQ LIKE THE UNENHANCED //e: SAVE A
* IN $45, BRK -> STOP, ELSE ($3FE)
IRQH STA $45
 PLA
 PHA
 ASL
 ASL
 ASL
 BMI BRKH
 JMP ($03FE)
BRKH STA FIN
RST LDX #$FF
 TXS
 SEI
 CLD
 JSR $C400
 JSR $C500
 STA FIN
HANG JMP HANG

 DS $FD8E-*
CROUT LDA #$8D
 JMP COUT

 DS $FDDA-*
PRBYTE PHA
 LSR
 LSR
 LSR
 LSR
 JSR PRHEXZ
 PLA
PRHEX AND #$0F
PRHEXZ ORA #$B0
 CMP #$BA
 BCC COUT
 ADC #$06
COUT STA OUT
 RTS

 DS $FE93-*
SETVID RTS

 DS $FF58-*
IORTS RTS

 DS $FFFA-*
 DA $03FB
 DA RST
 DA IRQH
