## gateware/yellow_hamr/firmware/phase2_command_decoder/sdkconfig.defaults
```kconfig
# Target ESP32 (not S2/S3/C3)
CONFIG_IDF_TARGET="esp32"

# Enable PSRAM for WROVER
CONFIG_ESP32_SPIRAM_SUPPORT=y
CONFIG_SPIRAM=y
CONFIG_SPIRAM_USE_CAPS_ALLOC=y

# Serial output settings
CONFIG_ESP_CONSOLE_UART_BAUDRATE=115200

# Reduce boot verbosity
CONFIG_BOOTLOADER_LOG_LEVEL_WARN=y
CONFIG_LOG_DEFAULT_LEVEL_INFO=y

# Optimize for speed (timing-critical bit-banging)
CONFIG_COMPILER_OPTIMIZATION_PERF=y
```
