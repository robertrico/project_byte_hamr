********************************
* PLANE - MULTIBYTE DRAW       *
********************************
 ORG $8000
 JMP MAIN
BYTE DS 1
LINE DS 1
DEPTH DS 1
XCOUNT DS 1
 PUT INCLUDE
 PUT LINEADDR
HIGH = $1B
LOW = $1A
MAIN JSR HGR
 LDA #$15
 STA LINE
 CLC
 ADC #$05
 STA DEPTH ;DEPTH OF SHAPE
 LDA #$04
 STA BYTE ;BYTE
 LDA #$00
 STA XCOUNT ;ZERO XCOUNT
DRAW LDY BYTE ; BYTE IN Y
 LDX LINE ; LINE IN X
 LDA HI,X ; LINE ADDR
 STA HIGH
 LDA LO,X
 STA LOW
 LDX XCOUNT ;LOAD X WITH XCOUNT
 LDA SHAPE,X ;SHAPE BYTE
 STA (LOW),Y ;PLOT
 INY ;NEXT BYTE
 LDA SHAPE+1,X ;NEXT SHAPE BYTE
 STA (LOW),Y ;PLOT
 INC XCOUNT ;INC XCOUNT BY NUM OF BYTES IN SHAPE
 INC XCOUNT
 INC LINE ;NEXT LINE
 LDA LINE
 CMP DEPTH ;SHAPE DONE
 BLT DRAW
 RTS
SHAPE HEX 030003007D3F01407F3F
