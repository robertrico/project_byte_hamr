********************************
* BASIC GUI                    *
********************************
 ORG $8000
 JMP MAIN
BYTE DS 1
LINE DS 1
DEPTH DS 1
XCOUNT DS 1
BYTES DS 1
 PUT INCLUDE
 PUT LINEADDR
MAIN JSR HGR
 LDA #$0C ;START AT 12 LINES
 STA LINE
 CLC
 ADC #$0C ;12 LINES + 12 OFFSET
 STA DEPTH ;DEPTH OF SHAPE
 LDA #$04
 STA BYTE ;BYTE
 LDA #$00
 STA XCOUNT ;ZERO XCOUNT
DRAW LDY BYTE ; BYTE IN Y
 LDX LINE ; LINE IN X
 LDA HI,X ; LINE ADDR
 STA HIGH
 LDA LO,X
 STA LOW
 LDX XCOUNT ;LOAD X WITH XCOUNT
* START DRAWING LOOP 3 BYTES *
 LDA #$03
 STA BYTES
LOOP INY
 LDA SHAPE,X
 STA (LOW),Y
 INX
 INC XCOUNT
 DEC BYTES
 BNE LOOP
 INC LINE ;NEXT LINE
 LDA LINE
 CMP DEPTH ;SHAPE DONE
 BLT DRAW
 RTS
SHAPE HEX 000800001400003E00007F00500005381C0E501C05
 HEX 005D00002200001C00001C00001C00001C00001C00
