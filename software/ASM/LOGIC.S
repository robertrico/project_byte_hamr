 LST OFF
********************************
* BASIC GUI                    *
********************************
 ORG $8000
 JMP MAIN
* DRAWING UTILITIES
 PUT INCLUDE
* LINE ADDRESS LUT
 PUT LINEADDR
* DRAWING VARIABLES
BYTE DS 1
LINE DS 1
DEPTH DS 1
XCOUNT DS 1
BYTES DS 1
HIGH = $1B
LOW = $1A
* MAIN ROUTINE
MAIN JSR HGR
 LDA #$00 ;START AT 0 LINES
 STA LINE
 CLC
 ADC #$24 ;0 LINES + 0 OFFSET
 STA DEPTH ;DEPTH OF SHAPE
 LDA #$00
 STA BYTE ;BYTE
 LDA #$00
 STA XCOUNT ;ZERO XCOUNT
* DRAW THE GRAPHICS
DRAW LDY BYTE ; BYTE IN Y
 LDX LINE ; LINE IN X
 LDA HI,X ; HI LINE ADDR
 STA HIGH
 LDA LO,X ; LOW LINE ADDR
 STA LOW
 LDX XCOUNT ;LOAD X WITH XCOUNT
 LDA #$05 ; BYTES-WIDE
 STA BYTES ; HOW MANY BYTE "COLUMNS" ACROSS SCREEN
LOOP LDA SHAPE,X
 STA (LOW),Y
 INY
 INX
 INC XCOUNT
 DEC BYTES
 BNE LOOP
 INC LINE ;NEXT LINE
 LDA LINE
 CMP DEPTH ;SHAPE DONE
 BLT DRAW
 RTS
SHAPE HEX 7F7F7F7F7F7F7F7F7F7F7F7F7F7F7F7F7F7F7F7F7F
 HEX 7F7F7F7F7F7F7F7F7F7F7F7F7F7F
 HEX 7F7F7F7F7F7F7F7F7F7F7F7F7F7F
 HEX 7F7F7F7F7F7F7F7F7F7F7F7F7F7F
 HEX 7F7F7F7F7F7F7F7F7F7F7F7F7F7F
 HEX 7F7F7F7F7F7F7F7F7F7F7F7F7F7F
 HEX 7F7F7F7F7F7F7F7F7F7F7F7F7F7F
 HEX 7F7F7F7F7F7F7F7F7F7F7F7F7F7F
