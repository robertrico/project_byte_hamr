* ASM8.S - NATIVE 8008 ASSEMBLER
* BRUN ASM8. PROMPTS FOR A TXT SOURCE
* IN TRUE 8008 SYNTAX (ASL 8008NEW),
* STREAMING TWO-PASS ASSEMBLE, WRITES
* BIN OBJECT WITH AUX TYPE = ORG.
* RUN OBJECTS WITH: B8RUN <NAME>.
* THIN FILE DRIVER AROUND ASM8CORE
* (SEAMS: SRCOPEN/SRCLINE/SRCDONE,
* OINIT/OSTORE, ERRHOOK).
* DESIGN VALIDATED BY ASM8_CHECK.PY
* (SAME SPEC, BYTE-IDENTICAL 6/6).
* NO ZERO PAGE (SELF-MOD POINTERS).
 ORG $2000
 JMP MAIN

MLI = $BF00
GETLN1 = $FD6F
COUT = $FDED
PRBYTE = $FDDA
CROUT = $FD8E
OUTBUF = $4000
OUTMAX = $30 ; 12KB IN PAGES
SYMTAB = $7000
SYMFUL = $8BF3
IOBUF = $8C00
CR = $0D

* DRIVER STATE
SSAVE DS 1
EOFF DS 1
CAVL DS 1
CAVH DS 1
ERRB DS 1
AEML DS 1
AEMH DS 1
DIGV DS 1
DSTRT DS 1

MAIN TSX
 STX SSAVE
 JSR CROUT
* MLI PREFIX EMPTY AT BOOT: BUILD
* FROM LAST DEVICE VIA ON_LINE
 JSR MLI
 DFB $C7 ; GET_PREFIX
 DA GPPARM
 LDA PFXBUF
 BNE :pfok
 LDA $BF30
 STA OLUNIT
 JSR MLI
 DFB $C5 ; ON_LINE
 DA OLPARM
 BCS :pfok
 LDA OLBUF
 AND #$0F
 BEQ :pfok
 TAX
 LDY #0
:pcp LDA OLBUF+1,Y
 STA PFXBUF+2,Y
 INY
 DEX
 BNE :pcp
 LDA #'/'
 STA PFXBUF+1
 LDA OLBUF
 AND #$0F
 CLC
 ADC #1
 STA PFXBUF
 JSR MLI
 DFB $C6 ; SET_PREFIX
 DA GPPARM
:pfok LDX #<MSGSRC
 LDY #>MSGSRC
 JSR PRSTR
 JSR GETLN1
 CPX #0
 BNE :have
 RTS
:have STX PATH
 LDY #0
:cp LDA $200,Y
 JSR UPC
 STA PATH+1,Y
 INY
 DEX
 BNE :cp
 JSR MKOBJ
 LDX #<MSGOBJ
 LDY #>MSGOBJ
 JSR PRSTR
 JSR PROPATH
 JSR CROUT
 JSR ASMGO
 JMP WROBJ

* WRITE OBJECT: DESTROY STALE FILE,
* CREATE BIN AUX=ORG, WRITE, CLOSE
WROBJ JSR MLI
 DFB $C1 ; DESTROY
 DA DPARM
 BCC :cr
 CMP #$46 ; NOT FOUND = FINE
 BEQ :cr
 JMP MERR
:cr LDA ORGL
 STA CRAUX
 LDA ORGH
 STA CRAUX+1
 JSR MLI
 DFB $C0 ; CREATE
 DA CRPARM
 BCC :op
 JMP MERR
:op JSR MLI
 DFB $C8 ; OPEN OBJ
 DA WOPARM
 BCC :wr
 JMP MERR
:wr LDA WOREF
 STA WREF
 LDA OENDL
 STA WCNT
 LDA OENDH
 STA WCNT+1
 JSR MLI
 DFB $CB ; WRITE
 DA WPARM
 BCC :cl
 JMP MERR
:cl LDA WOREF
 STA WCREF
 LDA #0
 STA WOREF
 JSR MLI
 DFB $CC ; CLOSE OBJ
 DA WCPARM
 LDX #<MSGOK1
 LDY #>MSGOK1
 JSR PRSTR
 LDA OENDH
 JSR PRBYTE
 LDA OENDL
 JSR PRBYTE
 LDX #<MSGOK2
 LDY #>MSGOK2
 JSR PRSTR
 LDA ORGH
 JSR PRBYTE
 LDA ORGL
 JSR PRBYTE
 JSR CROUT
 LDX #<MSGRUN
 LDY #>MSGRUN
 JSR PRSTR
 JSR PROPATH
 JSR CROUT
 RTS

* OBJ NAME = SRC MINUS .EXT (OR +.B)
MKOBJ LDX #0
MKC CPX PATH
 BCS MKS
 LDA PATH+1,X
 STA OPATH+1,X
 INX
 BNE MKC
MKS LDX PATH
MK1 LDA OPATH,X
 CMP #'.'
 BEQ MKDOT
 CMP #'/'
 BEQ MKAPP
 DEX
 BNE MK1
MKAPP LDX PATH
 INX
 LDA #'.'
 STA OPATH,X
 INX
 LDA #'B'
 STA OPATH,X
 STX OPATH
 RTS
MKDOT DEX
 STX OPATH
 RTS

* PRINT COUNTED OPATH
PROPATH LDX #0
PRP1 CPX OPATH
 BCS PRP2
 LDA OPATH+1,X
 ORA #$80
 JSR COUT
 INX
 BNE PRP1
PRP2 RTS

* ---- CORE SEAM: SOURCE ----
SRCOPEN JSR MLI
 DFB $C8 ; OPEN SRC
 DA OPARM
 BCC RDO1
 JMP MERR
RDO1 LDA OREF
 STA RREF
 STA RCREF
 LDA #0
 STA CAVL
 STA CAVH
 STA EOFF
 RTS
* NEXT RAW BYTE. C=1 AT EOF.
RDBYTE LDA CAVL
 ORA CAVH
 BNE RDB2
 LDA EOFF
 BEQ RDB3
 SEC
 RTS
RDB3 LDA #0
 STA RTRANS
 STA RTRANS+1
 JSR MLI
 DFB $CA ; READ 512
 DA RPARM
 BCC RDB4
 CMP #$4C ; EOF IS FINE
 BEQ RDB4
 JMP MERR
RDB4 LDA RTRANS
 ORA RTRANS+1
 BNE RDB5
 LDA #1
 STA EOFF
 SEC
 RTS
RDB5 LDA RTRANS
 STA CAVL
 LDA RTRANS+1
 STA CAVH
 LDA #<CHUNKB
 STA RDB1+1
 LDA #>CHUNKB
 STA RDB1+2
RDB2 LDA CAVL
 BNE RDB6
 DEC CAVH
RDB6 DEC CAVL
RDB1 LDA $FFFF
 INC RDB1+1
 BNE RDB7
 INC RDB1+2
RDB7 CLC
 RTS
* NEXT LINE -> LINEB. C=1 NO MORE.
* STRIP HI BIT, TAB->SPC, UPCASE.
SRCLINE LDA #0
 STA LINEL
RL1 JSR RDBYTE
 BCS RLEOF
 AND #$7F
 CMP #CR
 BEQ RLCR
 CMP #$0A ; LF SKIPPED
 BEQ RL1
 CMP #9
 BNE RL2
 LDA #' '
RL2 JSR UPC
 LDX LINEL
 CPX #127
 BCS RLLONG
 STA LINEB,X
 INC LINEL
 JMP RL1
RLLONG LDX #<ELONG
 LDY #>ELONG
 JMP ERRHOOK
RLCR CLC
 RTS
RLEOF LDA LINEL
 BEQ RLE2
 CLC ; LAST LINE, NO CR
 RTS
RLE2 SEC
 RTS
SRCDONE JSR MLI
 DFB $CC ; CLOSE SRC
 DA RCPARM
 LDA #0
 STA OREF
 RTS

* ---- CORE SEAM: OBJECT SINK ----
* ZERO 12KB OUTPUT BUFFER
OINIT LDA #>OUTBUF
 STA ZO1+2
 LDA #0
 LDX #OUTMAX
 LDY #0
ZOL
ZO1 STA OUTBUF,Y
 INY
 BNE ZOL
 INC ZO1+2
 DEX
 BNE ZOL
 RTS
* STORE EMB AT OUTBUF+OFL/OFH
OSTORE LDA OFH
 CLC
 ADC #>OUTBUF
 STA OS1+2
 LDA OFL
 STA OS1+1
 LDA EMB
OS1 STA $FFFF
 RTS

* ---- CORE SEAM: ERROR EXIT ----
* X/Y=MSG. PRINTS LINE NO, MSG,
* THE LINE. RESETS STACK.
ERRHOOK STX AEML
 STY AEMH
 LDX #<MSGLN
 LDY #>MSGLN
 JSR PRSTR
 JSR PRDEC
 LDX #<MSGCO
 LDY #>MSGCO
 JSR PRSTR
 LDX AEML
 LDY AEMH
 JSR PRSTR
 JSR CROUT
 LDX #0
AEL CPX LINEL
 BCS AED
 LDA LINEB,X
 ORA #$80
 JSR COUT
 INX
 BNE AEL
AED JSR CROUT
 JSR CLSALL
 LDX SSAVE
 TXS
 RTS
* MERR: A=MLI ERROR CODE
MERR STA ERRB
 LDX #<MSGER
 LDY #>MSGER
 JSR PRSTR
 LDA ERRB
 JSR PRBYTE
 JSR CROUT
 JSR CLSALL
 LDX SSAVE
 TXS
 RTS
* CLOSE ANY OPEN REFS (GUARDED)
CLSALL LDA OREF
 BEQ CLA1
 STA RCREF
 LDA #0
 STA OREF
 JSR MLI
 DFB $CC
 DA RCPARM
CLA1 LDA WOREF
 BEQ CLA2
 STA WCREF
 LDA #0
 STA WOREF
 JSR MLI
 DFB $CC
 DA WCPARM
CLA2 RTS

* PRINT LINENO AS DECIMAL
PRDEC LDA LINENO
 STA T2L
 LDA LINENO+1
 STA T2H
 LDA #0
 STA DSTRT
 LDX #0
PDL LDA #0
 STA DIGV
PDS LDA T2H
 CMP DECH,X
 BCC PDN
 BNE PDSUB
 LDA T2L
 CMP DECL,X
 BCC PDN
PDSUB SEC
 LDA T2L
 SBC DECL,X
 STA T2L
 LDA T2H
 SBC DECH,X
 STA T2H
 INC DIGV
 JMP PDS
PDN LDA DIGV
 BNE PDP
 LDA DSTRT
 BNE PDP
 CPX #4
 BNE PDSK
PDP LDA DIGV
 ORA #$B0
 JSR COUT
 LDA #1
 STA DSTRT
PDSK INX
 CPX #5
 BCC PDL
 RTS
DECL DFB $10,$E8,$64,$0A,$01
DECH DFB $27,$03,$00,$00,$00

* UPCASE 7-BIT CHAR IN A
UPC AND #$7F
 CMP #$61
 BCC UPCD
 CMP #$7B
 BCS UPCD
 AND #$5F
UPCD RTS

* PRINT ASCIIZ AT Y:X (SELF-MOD)
PRSTR STX PRS1+1
 STY PRS1+2
PRS1 LDA $FFFF
 BEQ PRSD
 JSR COUT
 INC PRS1+1
 BNE PRS1
 INC PRS1+2
 BNE PRS1
PRSD RTS

* MLI PARM BLOCKS
OPARM DFB 3
 DA PATH
 DA IOBUF
OREF DFB 0
RPARM DFB 4
RREF DFB 0
 DA CHUNKB
 DA 512
RTRANS DA 0
RCPARM DFB 1
RCREF DFB 0
DPARM DFB 1
 DA OPATH
CRPARM DFB 7
 DA OPATH
 DFB $C3 ; ACCESS
 DFB $06 ; BIN
CRAUX DA 0
 DFB $01 ; SEEDLING
 DA 0
 DA 0
WOPARM DFB 3
 DA OPATH
 DA IOBUF
WOREF DFB 0
WPARM DFB 4
WREF DFB 0
 DA OUTBUF
WCNT DA 0
WTRANS DA 0
WCPARM DFB 1
WCREF DFB 0
GPPARM DFB 1
 DA PFXBUF
OLPARM DFB 2
OLUNIT DFB 0
 DA OLBUF

* MESSAGES
MSGSRC ASC "8008 SRC FILE: "
 DFB 0
MSGOBJ ASC "OBJ: "
 DFB 0
MSGLN ASC "LINE "
 DFB 0
MSGCO ASC ": "
 DFB 0
MSGOK1 ASC "OK $"
 DFB 0
MSGOK2 ASC " BYTES AT $"
 DFB 0
MSGRUN ASC "RUN WITH: B8RUN "
 DFB 0
MSGER ASC "MLI ERR $"
 DFB 0

* BUFFERS
CHUNKB DS 512
PATH DS 65
OPATH DS 68
PFXBUF DS 66
OLBUF DS 16

* CORE + TABLE (MUST BE ADJACENT:
* DIRTAB ENDS THE CORE, ASM8TAB
* CONTINUES THE SAME SCAN REGION)
 PUT ASM8CORE
 PUT ASM8TAB
