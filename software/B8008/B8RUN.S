* B8RUN.S - LOAD+RUN AN 8008 PROGRAM
* BRUN B8RUN. PROMPTS FOR A BIN FILE
* (AUX TYPE = 8008 LOAD ADDR, SET BY ORG),
* READS IT VIA MLI, STREAMS INTEL HEX TO
* THE MONITOR'S L COMMAND THROUGH THE RX
* FIFO (FIFO SPACE BIT = FLOW CONTROL, NO
* PACING NEEDED), THEN PRINTS THE G ADDR.
* USER RUNS IT THEMSELVES: PR#4, G XXXX.
* NO ZERO PAGE (SELF-MOD POINTERS).
 TYP $06
 DSK B8RUN
 ORG $2000
 JMP MAIN
 PUT B8LIB

MLI = $BF00
GETLN1 = $FD6F
IOBUF = $8C00
DBUF = $4000
ESC = $1B
CR = $0D

AUXLO DS 1
AUXHI DS 1
LENLO DS 1
LENHI DS 1
RECN DS 1
CKSUM DS 1
ERRB DS 1

MAIN JSR CROUT
 JSR B8_PRESENT
 BCC :ok
 LDX #<MSGNO
 LDY #>MSGNO
 JSR PRSTR
 RTS
* MLI PREFIX IS EMPTY AT BOOT. BASIC.SYSTEM
* RESOLVES PARTIAL NAMES ITSELF, BUT RAW MLI
* CALLS GET $40. IF EMPTY, BUILD /VOLNAME
* FROM THE LAST-USED DEVICE ($BF30 DEVNUM)
* VIA ON_LINE AND SET_PREFIX.
:ok JSR MLI
 DFB $C7 ; GET_PREFIX
 DA GPPARM
 LDA PFXBUF
 BNE :pfok
 LDA $BF30
 STA OLUNIT
 JSR MLI
 DFB $C5 ; ON_LINE
 DA OLPARM
 BCS :pfok
 LDA OLBUF
 AND #$0F
 BEQ :pfok
 TAX
 LDY #0
:pcp LDA OLBUF+1,Y
 STA PFXBUF+2,Y
 INY
 DEX
 BNE :pcp
 LDA #'/'
 STA PFXBUF+1
 LDA OLBUF
 AND #$0F
 CLC
 ADC #1
 STA PFXBUF
 JSR MLI
 DFB $C6 ; SET_PREFIX (SAME PARM SHAPE)
 DA GPPARM
:pfok LDX #<MSGF
 LDY #>MSGF
 JSR PRSTR
 JSR GETLN1
 CPX #0
 BNE :have
 RTS
:have STX PATH
 LDY #0
:cp LDA $200,Y
 AND #$7F
 CMP #$61 ; UPCASE a-z (PRODOS
 BCC :st ; REJECTS LOWERCASE, $40)
 CMP #$7B
 BCS :st
 AND #$5F
:st STA PATH+1,Y
 INY
 DEX
 BNE :cp

* FILE INFO: AUX TYPE = 8008 LOAD ADDR
 JSR MLI
 DFB $C4
 DA FIPARM
 BCC :fi
 JMP MERR
:fi LDA FIAUX
 STA AUXLO
 LDA FIAUX+1
 STA AUXHI

* OPEN + READ + CLOSE
 JSR MLI
 DFB $C8
 DA OPARM
 BCC :op
 JMP MERR
:op LDA OREF
 STA RREF
 STA CREF
 JSR MLI
 DFB $CA
 DA RPARM
 BCC :rd
 JMP MERR
:rd LDA RTRANS
 STA LENLO
 LDA RTRANS+1
 STA LENHI
 JSR MLI
 DFB $CC
 DA CPARM

* ENTER MONITOR L MODE
 LDX #<MSGLD
 LDY #>MSGLD
 JSR PRSTR
 LDA #'L'
 JSR B8_RXPUT
 LDA #CR
 JSR B8_RXPUT

* STREAM 16-BYTE HEX RECORDS
 LDA #<DBUF
 STA SRC+1
 LDA #>DBUF
 STA SRC+2
:rec LDA LENLO
 ORA LENHI
 BNE :rgo
 JMP :eof
:rgo
* RECN = MIN(16,LEN)
 LDA LENHI
 BNE :n16
 LDA LENLO
 CMP #16
 BCS :n16
 STA RECN
 JMP :len
:n16 LDA #16
 STA RECN
:len LDA #0
 STA CKSUM
 LDA #':'
 JSR B8_RXPUT
 LDA RECN
 JSR HEXOUT
 LDA AUXHI
 JSR HEXOUT
 LDA AUXLO
 JSR HEXOUT
 LDA #0
 JSR HEXOUT
 LDX RECN
:dat
SRC LDA $FFFF
 JSR HEXOUT
 INC SRC+1
 BNE :nc
 INC SRC+2
:nc INC AUXLO
 BNE :nc2
 INC AUXHI
:nc2 LDA LENLO
 BNE :nb
 DEC LENHI
:nb DEC LENLO
 DEX
 BNE :dat
* CHECKSUM = 2S COMPLEMENT OF SUM
 LDA #0
 SEC
 SBC CKSUM
 JSR HEXOUT
 LDA #CR
 JSR B8_RXPUT
* DRAIN TX TO SCREEN EACH RECORD: SHOWS THE
* MONITOR'S LIVE RESPONSES AND KEEPS THE
* 64-BYTE FIFO FROM OVERFLOWING (IT ATE
* THE OK/PROMPT TAIL WHEN UNATTENDED)
:drn JSR B8_TXGET
 BCS :drdn
 CMP #$0A
 BEQ :drn
 ORA #$80
 JSR COUT
 JMP :drn
:drdn JMP :rec

* EOF RECORD, ESC, DRAIN, THEN G <ADDR>
* EOF = :00000001FF. HEXOUT RETURNS WITH
* A = LAST CHAR SENT, SO RELOAD 0 EACH TIME
:eof LDA #':'
 JSR B8_RXPUT
 LDA #0
 STA CKSUM
 LDA #0
 JSR HEXOUT
 LDA #0
 JSR HEXOUT
 LDA #0
 JSR HEXOUT
 LDA #1
 JSR HEXOUT
 LDA #$FF
 JSR HEXOUT
 LDA #CR
 JSR B8_RXPUT
 LDA #ESC
 JSR B8_RXPUT
* LET THE MONITOR FINISH (OK + PROMPT),
* THEN DRAIN THE TAIL TO THE SCREEN
 LDX #250
:edl LDY #0
:edy DEY
 BNE :edy
 DEX
 BNE :edl
:edr JSR B8_TXGET
 BCS :eddn
 CMP #$0A
 BEQ :edr
 ORA #$80
 JSR COUT
 JMP :edr
:eddn JSR CROUT
* NO AUTO-G: TELL THE USER WHAT TO TYPE.
* MONITOR'S OK/ERR WAITS IN TX FOR PR#4.
 LDX #<MSGGO
 LDY #>MSGGO
 JSR PRSTR
 LDA FIAUX+1
 JSR PRBYTE
 LDA FIAUX
 JSR PRBYTE
 JSR CROUT
 RTS

* A = MLI ERROR CODE (PRSTR EATS A).
* ALSO DUMPS THE PATHNAME AS SENT TO MLI.
MERR STA ERRB
 LDX #<MSGER
 LDY #>MSGER
 JSR PRSTR
 LDA ERRB
 JSR PRBYTE
 LDX #<MSGPD
 LDY #>MSGPD
 JSR PRSTR
 LDA PATH
 JSR PRBYTE
 LDA #$A0
 JSR COUT
 LDX #0
:pd CPX PATH
 BCS :pdn
 LDA PATH+1,X
 ORA #$80
 JSR COUT
 INX
 CPX #16
 BCC :pd
:pdn JSR CROUT
 RTS

* A -> TWO HEX CHARS TO RX, ADD TO CKSUM
HEXOUT PHA
 CLC
 ADC CKSUM
 STA CKSUM
 PLA
 PHA
 LSR
 LSR
 LSR
 LSR
 JSR NIB
 PLA
 AND #$0F
NIB CMP #10
 BCC :dig
 ADC #6
:dig ADC #'0'
 JMP B8_RXPUT

* MLI PARM BLOCKS
FIPARM DFB $A
 DA PATH
FIACC DFB 0
FITYP DFB 0
FIAUX DA 0
FISTG DFB 0
FIBLK DA 0
FIMD DA 0
FIMT DA 0
FICD DA 0
FICT DA 0

OPARM DFB 3
 DA PATH
 DA IOBUF
OREF DFB 0

RPARM DFB 4
RREF DFB 0
 DA DBUF
 DA $3000
RTRANS DA 0

CPARM DFB 1
CREF DFB 0

GPPARM DFB 1
 DA PFXBUF
OLPARM DFB 2
OLUNIT DFB 0
 DA OLBUF

PATH DS 65
PFXBUF DS 66
OLBUF DS 16

MSGNO ASC "NO B8008 CARD IN SLOT 4"
 DFB $8D,0
MSGF ASC "8008 BIN FILE: "
 DFB 0
MSGLD ASC "SENDING HEX"
 DFB $8D,0
MSGGO ASC "LOADED. PR#4 THEN TYPE: G "
 DFB 0
MSGER ASC "MLI ERR $"
 DFB 0
MSGPD ASC " PATH LEN=$"
 DFB 0
