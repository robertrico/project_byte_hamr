* B8CMP.S - COMPARE TWO PRODOS FILES
* BRUN B8CMP. PROMPTS FOR TWO FILES,
* STREAMS BOTH VIA MLI (512B CHUNKS),
* PRINTS PASS+SIZE OR FIRST DIFF.
* ASM8 GATE TOOL: PROVE OBJECT ==
* REFERENCE BYTE-FOR-BYTE ON THE E.
* NO ZERO PAGE (SELF-MOD POINTERS).
 ORG $2000
 JMP MAIN

MLI = $BF00
GETLN1 = $FD6F
COUT = $FDED
PRBYTE = $FDDA
CROUT = $FD8E
IOBUF1 = $8C00
IOBUF2 = $9000
BUF1 = $4000
BUF2 = $4200
CR = $0D

B1V DS 1
D1V DS 1
D2V DS 1
ERRB DS 1
OFFL DS 1
OFFH DS 1
CNTL DS 1
CNTH DS 1

MAIN JSR CROUT
* MLI PREFIX EMPTY AT BOOT: BUILD
* FROM LAST DEVICE VIA ON_LINE
 JSR MLI
 DFB $C7 ; GET_PREFIX
 DA GPPARM
 LDA PFXBUF
 BNE :pfok
 LDA $BF30
 STA OLUNIT
 JSR MLI
 DFB $C5 ; ON_LINE
 DA OLPARM
 BCS :pfok
 LDA OLBUF
 AND #$0F
 BEQ :pfok
 TAX
 LDY #0
:pcp LDA OLBUF+1,Y
 STA PFXBUF+2,Y
 INY
 DEX
 BNE :pcp
 LDA #'/'
 STA PFXBUF+1
 LDA OLBUF
 AND #$0F
 CLC
 ADC #1
 STA PFXBUF
 JSR MLI
 DFB $C6 ; SET_PREFIX
 DA GPPARM
:pfok LDX #<MSGF1
 LDY #>MSGF1
 JSR PRSTR
 JSR GETLN1
 CPX #0
 BNE :hv1
 RTS
:hv1 STX PATH1
 LDY #0
:cp1 LDA $200,Y
 JSR UPC
 STA PATH1+1,Y
 INY
 DEX
 BNE :cp1
 LDX #<MSGF2
 LDY #>MSGF2
 JSR PRSTR
 JSR GETLN1
 CPX #0
 BNE :hv2
 RTS
:hv2 STX PATH2
 LDY #0
:cp2 LDA $200,Y
 JSR UPC
 STA PATH2+1,Y
 INY
 DEX
 BNE :cp2
* OPEN BOTH FILES
 JSR MLI
 DFB $C8 ; OPEN 1
 DA O1PARM
 BCC :o1
 JMP MERR
:o1 LDA O1REF
 STA R1REF
 JSR MLI
 DFB $C8 ; OPEN 2
 DA O2PARM
 BCC :o2
 JMP MERR
:o2 LDA O2REF
 STA R2REF
 LDA #0
 STA OFFL
 STA OFFH

* CHUNK LOOP: READ 512 FROM EACH
CHUNK LDA #0
 STA R1TRANS
 STA R1TRANS+1
 STA R2TRANS
 STA R2TRANS+1
 JSR MLI
 DFB $CA ; READ 1
 DA R1PARM
 BCC :r1
 CMP #$4C ; EOF IS FINE
 BEQ :r1
 JMP MERR
:r1 JSR MLI
 DFB $CA ; READ 2
 DA R2PARM
 BCC :r2
 CMP #$4C
 BEQ :r2
 JMP MERR
:r2
* CNT = MIN(T1,T2)
 LDA R1TRANS+1
 CMP R2TRANS+1
 BCC :t1
 BNE :t2
 LDA R1TRANS
 CMP R2TRANS
 BCC :t1
:t2 LDA R2TRANS
 STA CNTL
 LDA R2TRANS+1
 STA CNTH
 JMP :go
:t1 LDA R1TRANS
 STA CNTL
 LDA R1TRANS+1
 STA CNTH
:go LDA #<BUF1
 STA CP1+1
 LDA #>BUF1
 STA CP1+2
 LDA #<BUF2
 STA CP2+1
 LDA #>BUF2
 STA CP2+2

* COMPARE CNT BYTES. GLOBAL LABELS:
* SELF-MOD TARGETS END LOCAL SCOPE.
CMPLP LDA CNTL
 ORA CNTH
 BEQ CMPDN
CP1 LDA $FFFF
 STA B1V
CP2 LDA $FFFF
 CMP B1V
 BNE CDIFF
 INC CP1+1
 BNE CMA
 INC CP1+2
CMA INC CP2+1
 BNE CMB
 INC CP2+2
CMB INC OFFL
 BNE CMC
 INC OFFH
CMC LDA CNTL
 BNE CMD
 DEC CNTH
CMD DEC CNTL
 JMP CMPLP

* EQUAL SO FAR: EOF/LENGTH CHECKS
CMPDN LDA R1TRANS
 CMP R2TRANS
 BNE LENDIF
 LDA R1TRANS+1
 CMP R2TRANS+1
 BNE LENDIF
 CMP #2 ; FULL 512 = MORE
 BNE PASS
 JMP CHUNK

PASS LDX #<MSGOK
 LDY #>MSGOK
 JSR PRSTR
 LDA OFFH
 JSR PRBYTE
 LDA OFFL
 JSR PRBYTE
 LDX #<MSGBY
 LDY #>MSGBY
 JSR PRSTR
 JMP CLOSEA

CDIFF STA D2V
 LDA B1V
 STA D1V
 LDX #<MSGDF
 LDY #>MSGDF
 JSR PRSTR
 LDA OFFH
 JSR PRBYTE
 LDA OFFL
 JSR PRBYTE
 LDX #<MSGA
 LDY #>MSGA
 JSR PRSTR
 LDA D1V
 JSR PRBYTE
 LDX #<MSGB
 LDY #>MSGB
 JSR PRSTR
 LDA D2V
 JSR PRBYTE
 JSR CROUT
 JMP CLOSEA

LENDIF LDX #<MSGLD
 LDY #>MSGLD
 JSR PRSTR
 LDA OFFH
 JSR PRBYTE
 LDA OFFL
 JSR PRBYTE
 JSR CROUT

* CLOSE ANY OPEN REFS (GUARDED)
CLOSEA LDA O1REF
 BEQ CLA1
 STA C1REF
 LDA #0
 STA O1REF
 JSR MLI
 DFB $CC ; CLOSE 1
 DA C1PARM
CLA1 LDA O2REF
 BEQ CLA2
 STA C2REF
 LDA #0
 STA O2REF
 JSR MLI
 DFB $CC ; CLOSE 2
 DA C2PARM
CLA2 RTS

* A = MLI ERR (PRSTR EATS A)
MERR STA ERRB
 LDX #<MSGER
 LDY #>MSGER
 JSR PRSTR
 LDA ERRB
 JSR PRBYTE
 JSR CROUT
 JMP CLOSEA

* UPCASE 7-BIT CHAR IN A
UPC AND #$7F
 CMP #$61
 BCC UPCD
 CMP #$7B
 BCS UPCD
 AND #$5F
UPCD RTS

* PRINT ASCIIZ AT Y:X (SELF-MOD)
PRSTR STX PRS1+1
 STY PRS1+2
PRS1 LDA $FFFF
 BEQ PRSD
 JSR COUT
 INC PRS1+1
 BNE PRS1
 INC PRS1+2
 BNE PRS1
PRSD RTS

* MLI PARM BLOCKS
O1PARM DFB 3
 DA PATH1
 DA IOBUF1
O1REF DFB 0
O2PARM DFB 3
 DA PATH2
 DA IOBUF2
O2REF DFB 0
R1PARM DFB 4
R1REF DFB 0
 DA BUF1
 DA 512
R1TRANS DA 0
R2PARM DFB 4
R2REF DFB 0
 DA BUF2
 DA 512
R2TRANS DA 0
C1PARM DFB 1
C1REF DFB 0
C2PARM DFB 1
C2REF DFB 0
GPPARM DFB 1
 DA PFXBUF
OLPARM DFB 2
OLUNIT DFB 0
 DA OLBUF

PATH1 DS 65
PATH2 DS 65
PFXBUF DS 66
OLBUF DS 16

MSGF1 ASC "FILE 1: "
 DFB 0
MSGF2 ASC "FILE 2: "
 DFB 0
MSGOK ASC "PASS $"
 DFB 0
MSGBY ASC " BYTES"
 DFB $8D,0
MSGDF ASC "DIFF AT $"
 DFB 0
MSGA ASC " F1=$"
 DFB 0
MSGB ASC " F2=$"
 DFB 0
MSGLD ASC "LEN DIFF AT $"
 DFB 0
MSGER ASC "MLI ERR $"
 DFB 0
