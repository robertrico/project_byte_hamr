* A8.S - 8008 DEV ENVIRONMENT V1
* EDITOR + ASM8 + CARD LOADER.
* BRUN A8. ^Q QUITS TO BASIC.
* 80-COL DIRECT SCREEN, NO GETLN,
* NO ZERO PAGE (SELF-MOD ABS).
 ORG $2000
 JMP MAIN

* MEMORY MAP (UNDER BASIC.SYSTEM)
* $2000-57FF CODE
* $5800-87FF TEXT BUF (12KB)
* $8800-8FFF SYMBOLS
* $9000-93FF MLI IOBUF
* $9400-95FF AUX PAGE STAGE
* AUX $4000-6FFF 8008 OUTBUF
TEXT = $5800
TMAX = $3000
SYMTAB = $8800
SYMFUL = $8FF3
IOBUF = $9000
STAGEB = $9400
OUTMAX = $30
CR = $0D
ESC = $1B
MLI = $BF00
SETTXT = $FB39
HOME = $FC58
* SOFT SWITCHES
SS80OF = $C000
SS80ON = $C001
SC80OF = $C00C
SC80ON = $C00D
STXTON = $C051
SHIROF = $C056
SPG2OF = $C054
SPG2ON = $C055

* STATE
SPSAVE DS 1
TLENL DS 1
TLENH DS 1
CURSL DS 1
CURSH DS 1
TOPL DS 1
TOPH DS 1
CLSL DS 1
CLSH DS 1
CCOLL DS 1
CCOLH DS 1
HSL DS 1
HSH DS 1
CROW DS 1
OROW DS 1
CURLNL DS 1
CURLNH DS 1
DIRTY DS 1
ASMDON DS 1
HAVNAM DS 1
NEEDALL DS 1
MSGON DS 1
PROW DS 1
L80COL DS 1
L80INV DS 1
CSRIN DS 1
HLEFT DS 1
HRIGHT DS 1
RBCOL DS 1
RBCH DS 1
SKIPL DS 1
SKIPH DS 1
WOFFL DS 1
WOFFH DS 1
WSAVL DS 1
WSAVH DS 1
MVCL DS 1
MVCH DS 1
DVL DS 1
DVH DS 1
DIGV DS 1
DSTRT DS 1
INSC DS 1
LPCV DS 1
SVROW DS 1
GOALL DS 1
GOALH DS 1
PGCNT DS 1
PRPL DS 1
PRPH DS 1
ERRB DS 1
WLKL DS 1
WLKH DS 1
STGPG DS 1
ASPSAV DS 1
AEML DS 1
AEMH DS 1
GOTL DS 1
GOTH DS 1
PGIDX DS 1
REML DS 1
REMH DS 1
TROW DS 1
TCOL DS 1
TRMCH DS 1
CKSUM DS 1
AUXLO DS 1
AUXHI DS 1
RECN DS 1
LEN2L DS 1
LEN2H DS 1
SIDX DS 1
NBRAW DS 1
NBPRV DS 1
PRMODE DS 1
POSL DS 1
POSH DS 1
LIML DS 1
LIMH DS 1
LINE80 DS 80

MAIN TSX
 STX SPSAVE
* AUX READ STUB -> $130 (STACK PG
* IS MAIN RAM EVEN WITH RAMRD ON;
* CODE AT $2000 IS NOT)
 LDX #19
MST1 LDA AUXTPL,X
 STA $130,X
 DEX
 BPL MST1
 LDA #$FF
 STA STGPG
 JSR PFXINIT
 JSR SCRINIT
 JSR EDINIT
 JSR DRAWTIT
 JSR SYNCV
 JSR WREPANT
 LDA #0
 STA NEEDALL
 JSR DRAWST
KEYLP JSR KEYWAIT
 PHA
 LDA CROW
 STA OROW
 PLA
 JSR DOKEY
 JSR SYNCV
 LDA CROW
 CMP OROW
 BEQ KLP1
 LDA #1
 STA NEEDALL
KLP1 LDA NEEDALL
 BEQ KLP2
 JSR WREPANT
 LDA #0
 STA NEEDALL
 JMP KLP3
KLP2 JSR RENDCR
KLP3 JSR DRAWST
 JMP KEYLP

QUIT JSR SCREXIT
 LDX SPSAVE
 TXS
 RTS

* EDITOR STATE RESET (EMPTY BUF)
EDINIT LDA #0
 STA TLENL
 STA TLENH
 STA CURSL
 STA CURSH
 STA TOPL
 STA TOPH
 STA HSL
 STA HSH
 STA DIRTY
 STA ASMDON
 STA HAVNAM
 STA MSGON
 STA CURLNH
 LDA #1
 STA CURLNL
 STA CROW
 STA NEEDALL
 RTS

* ---- KEY DISPATCH ----
DOKEY CMP #$91 ; ^Q
 BNE DK1
 JMP DOQUIT
DK1 CMP #$8D ; RETURN
 BNE DK2
 LDA #CR
 JMP INSCH
DK2 CMP #$FF ; DELETE
 BNE DK3
 JMP DELCH
DK3 CMP #$88 ; LEFT
 BNE DK4
 JMP CULEFT
DK4 CMP #$95 ; RIGHT
 BNE DK5
 JMP CURT
DK5 CMP #$8B ; UP
 BNE DK6
 JMP CUUP
DK6 CMP #$8A ; DOWN
 BNE DK7
 JMP CUDN
DK7 CMP #$82 ; ^B TOP
 BNE DK8
 JMP CUTOP
DK8 CMP #$85 ; ^E BOTTOM
 BNE DK9
 JMP CUBOT
DK9 CMP #$90 ; ^P PG UP
 BNE DK10
 JMP CUPGUP
DK10 CMP #$96 ; ^V PG DN
 BNE DK11
 JMP CUPGDN
DK11 CMP #$93 ; ^S SAVE
 BNE DK12
 JMP DOSAVE
DK12 CMP #$8C ; ^L LOAD
 BNE DK13
 JMP DOLOAD
DK13 CMP #$8E ; ^N NEW
 BNE DK14
 JMP DONEW
DK14 CMP #$84 ; ^D DEL LINE
 BNE DK14A
 JMP DELLN
DK14A CMP #$81 ; ^A ASSEMBLE
 BNE DK14B
 JMP DOASM
DK14B CMP #$87 ; ^G LOAD+TTY
 BNE DK14C
 JMP DOGO
DK14C CMP #$86 ; ^F FIND
 BNE DK14D
 JMP DOFIND
DK14D CMP #$8F ; ^O GOTO LINE
 BNE DK15
 JMP DOGOTO
DK15 CMP #$A0
 BCC DKX
 AND #$7F
 JMP INSCH
DKX RTS

* WAIT FOR A KEYPRESS -> A
KEYWAIT LDA KBD
 BPL KEYWAIT
 STA KBDSTRB
 RTS

DOQUIT LDA DIRTY
 BEQ DQ1
 LDX #<MQUITQ
 LDY #>MQUITQ
 JSR GETYN
 BCC DQ1
 RTS
DQ1 JMP QUIT

DONEW LDA DIRTY
 BEQ DNW1
 LDX #<MLOSE
 LDY #>MLOSE
 JSR GETYN
 BCS DNWX
DNW1 JSR EDINIT
 LDA #1
 STA NEEDALL
DNWX RTS

* ---- INSERT A AT CURS ----
INSCH STA INSC
 LDA TLENH
 CMP #>TMAX
 BCC INS0
 LDX #<MFULL
 LDY #>MFULL
 JMP STMSG
INS0 SEC
 LDA TLENL
 SBC CURSL
 STA MVCL
 LDA TLENH
 SBC CURSH
 STA MVCH
 ORA MVCL
 BEQ INS2
* TAIL UP: SRC=TEXT+TLEN-1 DESC
 CLC
 LDA TLENL
 ADC #<TEXT
 STA MU1+1
 LDA TLENH
 ADC #>TEXT
 STA MU1+2
 LDA MU1+1
 BNE INS1
 DEC MU1+2
INS1 DEC MU1+1
 CLC
 LDA MU1+1
 ADC #1
 STA MU2+1
 LDA MU1+2
 ADC #0
 STA MU2+2
 JSR MVUP
INS2 LDA CURSL
 STA IST+1
 CLC
 LDA CURSH
 ADC #>TEXT
 STA IST+2
 LDA INSC
IST STA $FFFF
 INC TLENL
 BNE INS3
 INC TLENH
INS3 INC CURSL
 BNE INS4
 INC CURSH
INS4 LDA #1
 STA DIRTY
 LDA #0
 STA ASMDON
 LDA INSC
 CMP #CR
 BNE INS5
 INC CURLNL
 BNE INS6
 INC CURLNH
INS6 LDA #1
 STA NEEDALL
INS5 RTS

* DESC COPY MVC BYTES MU1->MU2
MVUP LDA MVCL
 ORA MVCH
 BEQ MVUD
MU1 LDA $FFFF
MU2 STA $FFFF
 LDA MU1+1
 BNE MVU1
 DEC MU1+2
MVU1 DEC MU1+1
 LDA MU2+1
 BNE MVU2
 DEC MU2+2
MVU2 DEC MU2+1
 LDA MVCL
 BNE MVU3
 DEC MVCH
MVU3 DEC MVCL
 JMP MVUP
MVUD RTS

* ASC COPY MVC BYTES MD1->MD2
MVDN LDA MVCL
 ORA MVCH
 BEQ MVDD
MD1 LDA $FFFF
MD2 STA $FFFF
 INC MD1+1
 BNE MVD1
 INC MD1+2
MVD1 INC MD2+1
 BNE MVD2
 INC MD2+2
MVD2 LDA MVCL
 BNE MVD3
 DEC MVCH
MVD3 DEC MVCL
 JMP MVDN
MVDD RTS

* ---- DELETE CHAR BEFORE CURS ----
DELCH LDA CURSL
 ORA CURSH
 BNE DEL1
 RTS
DEL1 SEC
 LDA CURSL
 SBC #1
 STA DEL2+1
 LDA CURSH
 SBC #0
 CLC
 ADC #>TEXT
 STA DEL2+2
DEL2 LDA $FFFF
 CMP #CR
 BNE DEL3
 LDA CURLNL
 BNE DEL4
 DEC CURLNH
DEL4 DEC CURLNL
 LDA #1
 STA NEEDALL
DEL3 SEC
 LDA TLENL
 SBC CURSL
 STA MVCL
 LDA TLENH
 SBC CURSH
 STA MVCH
 LDA CURSL
 STA MD1+1
 CLC
 LDA CURSH
 ADC #>TEXT
 STA MD1+2
 SEC
 LDA CURSL
 SBC #1
 STA MD2+1
 LDA CURSH
 SBC #0
 CLC
 ADC #>TEXT
 STA MD2+2
 JSR MVDN
 LDA TLENL
 BNE DEL5
 DEC TLENH
DEL5 DEC TLENL
 LDA CURSL
 BNE DEL6
 DEC CURSH
DEL6 DEC CURSL
 LDA #1
 STA DIRTY
 LDA #0
 STA ASMDON
 RTS

* ---- DELETE CURSOR LINE ----
DELLN JSR LINSTRT
 LDA CLSL
 STA WOFFL
 LDA CLSH
 STA WOFFH
 JSR NEXTLN
 SEC
 LDA WOFFL
 SBC CLSL
 STA GOALL
 LDA WOFFH
 SBC CLSH
 STA GOALH
 ORA GOALL
 BNE DLN1
 RTS
DLN1 SEC
 LDA TLENL
 SBC WOFFL
 STA MVCL
 LDA TLENH
 SBC WOFFH
 STA MVCH
 LDA WOFFL
 STA MD1+1
 CLC
 LDA WOFFH
 ADC #>TEXT
 STA MD1+2
 LDA CLSL
 STA MD2+1
 CLC
 LDA CLSH
 ADC #>TEXT
 STA MD2+2
 JSR MVDN
 SEC
 LDA TLENL
 SBC GOALL
 STA TLENL
 LDA TLENH
 SBC GOALH
 STA TLENH
 LDA CLSL
 STA CURSL
 LDA CLSH
 STA CURSH
 LDA #1
 STA DIRTY
 STA NEEDALL
 LDA #0
 STA ASMDON
 RTS

* ---- CURSOR MOVEMENT ----
CULEFT LDA CURSL
 ORA CURSH
 BNE CUL1
 RTS
CUL1 LDA CURSL
 BNE CUL2
 DEC CURSH
CUL2 DEC CURSL
 LDA CURSL
 STA CUL3+1
 CLC
 LDA CURSH
 ADC #>TEXT
 STA CUL3+2
CUL3 LDA $FFFF
 CMP #CR
 BNE CULX
 LDA CURLNL
 BNE CUL4
 DEC CURLNH
CUL4 DEC CURLNL
CULX RTS

CURT LDA CURSL
 CMP TLENL
 BNE CUR1
 LDA CURSH
 CMP TLENH
 BNE CUR1
 RTS
CUR1 LDA CURSL
 STA CUR2+1
 CLC
 LDA CURSH
 ADC #>TEXT
 STA CUR2+2
CUR2 LDA $FFFF
 CMP #CR
 BNE CUR3
 INC CURLNL
 BNE CUR3
 INC CURLNH
CUR3 INC CURSL
 BNE CURX
 INC CURSH
CURX RTS

* ADVANCE CURS <=GOAL COLS IN LINE
FWDCOL LDA CURSL
 STA FC1+1
 CLC
 LDA CURSH
 ADC #>TEXT
 STA FC1+2
FCLP LDA GOALL
 ORA GOALH
 BEQ FCDN
 LDA CURSL
 CMP TLENL
 BNE FC2
 LDA CURSH
 CMP TLENH
 BEQ FCDN
FC2
FC1 LDA $FFFF
 CMP #CR
 BEQ FCDN
 INC FC1+1
 BNE FC3
 INC FC1+2
FC3 INC CURSL
 BNE FC4
 INC CURSH
FC4 LDA GOALL
 BNE FC5
 DEC GOALH
FC5 DEC GOALL
 JMP FCLP
FCDN RTS

CUUP JSR LINSTRT
 LDA CLSL
 ORA CLSH
 BNE CUU1
 RTS
CUU1 SEC
 LDA CURSL
 SBC CLSL
 STA GOALL
 LDA CURSH
 SBC CLSH
 STA GOALH
 SEC
 LDA CLSL
 SBC #1
 STA CURSL
 LDA CLSH
 SBC #0
 STA CURSH
 LDA CURLNL
 BNE CUU2
 DEC CURLNH
CUU2 DEC CURLNL
 JSR LINSTRT
 LDA CLSL
 STA CURSL
 LDA CLSH
 STA CURSH
 JMP FWDCOL

CUDN JSR LINSTRT
 SEC
 LDA CURSL
 SBC CLSL
 STA GOALL
 LDA CURSH
 SBC CLSH
 STA GOALH
 LDA CLSL
 STA WOFFL
 LDA CLSH
 STA WOFFH
 JSR NEXTLN
 BCC CUD1
 RTS
CUD1 LDA WOFFL
 STA CURSL
 LDA WOFFH
 STA CURSH
 INC CURLNL
 BNE CUD2
 INC CURLNH
CUD2 JMP FWDCOL

CUTOP LDA #0
 STA CURSL
 STA CURSH
 STA CURLNH
 LDA #1
 STA CURLNL
 RTS

CUBOT LDA TLENL
 STA CURSL
 LDA TLENH
 STA CURSH
* CURLN = 1 + CRS BEFORE CURS
CNTLNS LDA #1
 STA CURLNL
 LDA #0
 STA CURLNH
 LDA CURSL
 STA MVCL
 LDA CURSH
 STA MVCH
 LDA #<TEXT
 STA CT1+1
 LDA #>TEXT
 STA CT1+2
CTLP LDA MVCL
 ORA MVCH
 BEQ CTDN
CT1 LDA $FFFF
 CMP #CR
 BNE CT2
 INC CURLNL
 BNE CT2
 INC CURLNH
CT2 INC CT1+1
 BNE CT3
 INC CT1+2
CT3 LDA MVCL
 BNE CT4
 DEC MVCH
CT4 DEC MVCL
 JMP CTLP
CTDN RTS

CUPGUP LDA #22
 STA PGCNT
CPU1 JSR CUUP
 DEC PGCNT
 BNE CPU1
 RTS

CUPGDN LDA #22
 STA PGCNT
CPD1 JSR CUDN
 DEC PGCNT
 BNE CPD1
 RTS

* ---- CURSOR GEOMETRY ----
* LINE START OF CURS -> CLS
LINSTRT LDA CURSL
 STA CLSL
 LDA CURSH
 STA CLSH
LST1 LDA CLSL
 ORA CLSH
 BEQ LSTD
 SEC
 LDA CLSL
 SBC #1
 STA LST2+1
 LDA CLSH
 SBC #0
 CLC
 ADC #>TEXT
 STA LST2+2
LST2 LDA $FFFF
 CMP #CR
 BEQ LSTD
 LDA CLSL
 BNE LST3
 DEC CLSH
LST3 DEC CLSL
 JMP LST1
LSTD RTS

* ADVANCE WOFF PAST NEXT CR.
* C=1 IF EOF HIT (NO CR).
NEXTLN LDA WOFFL
 STA NL1+1
 CLC
 LDA WOFFH
 ADC #>TEXT
 STA NL1+2
NL0 LDA WOFFL
 CMP TLENL
 BNE NL2
 LDA WOFFH
 CMP TLENH
 BNE NL2
 SEC
 RTS
NL2
NL1 LDA $FFFF
 INC NL1+1
 BNE NL3
 INC NL1+2
NL3 INC WOFFL
 BNE NL4
 INC WOFFH
NL4 CMP #CR
 BNE NL0
 CLC
 RTS

* ADVANCE TOP ONE LINE
TOPADV LDA WOFFL
 STA WSAVL
 LDA WOFFH
 STA WSAVH
 LDA TOPL
 STA WOFFL
 LDA TOPH
 STA WOFFH
 JSR NEXTLN
 LDA WOFFL
 STA TOPL
 LDA WOFFH
 STA TOPH
 LDA WSAVL
 STA WOFFL
 LDA WSAVH
 STA WOFFH
 RTS

* SYNC WINDOW TO CURSOR.
* SETS CLS CCOL HS CROW, MAY
* MOVE TOP (SETS NEEDALL).
SYNCV JSR LINSTRT
 SEC
 LDA CURSL
 SBC CLSL
 STA CCOLL
 LDA CURSH
 SBC CLSH
 STA CCOLH
* HS = MAX(0,CCOL-78)
 LDA #0
 STA HSL
 STA HSH
 SEC
 LDA CCOLL
 SBC #78
 TAX
 LDA CCOLH
 SBC #0
 BCC SYV1
 STX HSL
 STA HSH
SYV1
* CLS < TOP: JUMP WINDOW UP
 LDA CLSH
 CMP TOPH
 BCC SYV2
 BNE SYV3
 LDA CLSL
 CMP TOPL
 BCS SYV3
SYV2 LDA CLSL
 STA TOPL
 LDA CLSH
 STA TOPH
 LDA #1
 STA CROW
 STA NEEDALL
 RTS
* WALK ROWS FROM TOP TO CLS
SYV3 LDA TOPL
 STA WOFFL
 LDA TOPH
 STA WOFFH
 LDX #1
SYV4 LDA WOFFL
 CMP CLSL
 BNE SYV5
 LDA WOFFH
 CMP CLSH
 BNE SYV5
 STX CROW
 RTS
SYV5 STX SVROW
 JSR NEXTLN
 BCC SYV6
* EOF BEFORE CLS: RESYNC TOP
 LDA CLSL
 STA TOPL
 LDA CLSH
 STA TOPH
 LDA #1
 STA CROW
 STA NEEDALL
 RTS
SYV6 LDX SVROW
 INX
 CPX #23
 BCC SYV4
* PAST BOTTOM: SLIDE TOP DOWN
 JSR TOPADV
 LDA #1
 STA NEEDALL
 LDX #22
 JMP SYV4

* ---- SCREEN DRIVER ----
* ROW BASE TABLES (24 ROWS)
BASL DFB $00,$80,$00,$80
 DFB $00,$80,$00,$80
 DFB $28,$A8,$28,$A8
 DFB $28,$A8,$28,$A8
 DFB $50,$D0,$50,$D0
 DFB $50,$D0,$50,$D0
BASH DFB $04,$04,$05,$05
 DFB $06,$06,$07,$07
 DFB $04,$04,$05,$05
 DFB $06,$06,$07,$07
 DFB $04,$04,$05,$05
 DFB $06,$06,$07,$07

* BLAST LINE80 TO ROW PROW.
* EVEN COLS AUX, ODD MAIN.
RENDLIN LDX PROW
 LDA BASL,X
 STA RD1+1
 STA RD2+1
 LDA BASH,X
 STA RD1+2
 STA RD2+2
 STA SPG2ON
 LDX #0
 LDY #0
RDEV LDA LINE80,X
RD1 STA $0400,Y
 INX
 INX
 INY
 CPY #40
 BCC RDEV
 STA SPG2OF
 LDX #1
 LDY #0
RDOD LDA LINE80,X
RD2 STA $0400,Y
 INX
 INX
 INY
 CPY #40
 BCC RDOD
 RTS

* FILL LINE80 WITH A
L80FIL LDX #79
L80F1 STA LINE80,X
 DEX
 BPL L80F1
 RTS

* PUT ASCIIZ AT Y:X INTO LINE80
L80PUTS STX LP1+1
 STY LP1+2
LP1 LDA $FFFF
 BEQ LPSD
 JSR L80PUTC
 INC LP1+1
 BNE LP1
 INC LP1+2
 BNE LP1
LPSD RTS

* PUT CHAR A AT L80COL (L80INV).
* PRESERVES X (L80DEC LOOPS ON IT).
L80PUTC STA LPCV
 TXA
 PHA
 LDA LPCV
 AND #$7F
 LDX L80INV
 BEQ LPC1
 JSR UPC
 AND #$3F
 JMP LPC2
LPC1 ORA #$80
LPC2 LDX L80COL
 CPX #80
 BCS LPCD
 STA LINE80,X
 INC L80COL
LPCD PLA
 TAX
 RTS

* PUT 16-BIT DVL/DVH AS DECIMAL
L80DEC LDA #0
 STA DSTRT
 LDX #0
LDDL LDA #0
 STA DIGV
LDDS LDA DVH
 CMP DECHT,X
 BCC LDDN
 BNE LDDSU
 LDA DVL
 CMP DECLT,X
 BCC LDDN
LDDSU SEC
 LDA DVL
 SBC DECLT,X
 STA DVL
 LDA DVH
 SBC DECHT,X
 STA DVH
 INC DIGV
 JMP LDDS
LDDN LDA DIGV
 BNE LDDP
 LDA DSTRT
 BNE LDDP
 CPX #4
 BNE LDDK
LDDP LDA DIGV
 ORA #$30
 JSR L80PUTC
 LDA #1
 STA DSTRT
LDDK INX
 CPX #5
 BCC LDDL
 RTS
DECLT DFB $10,$E8,$64,$0A,$01
DECHT DFB $27,$03,$00,$00,$00

* UPCASE 7-BIT CHAR IN A
UPC CMP #$61
 BCC UPCD
 CMP #$7B
 BCS UPCD
 AND #$5F
UPCD RTS

* ---- COMPOSE BUFFER LINE ----
* LINE AT WOFF -> LINE80, WOFF
* PAST CR. CSRIN=1: HS + CURSOR.
RENDBL LDA #$A0
 JSR L80FIL
 LDA #0
 STA HLEFT
 STA HRIGHT
 STA RBCOL
 STA SKIPL
 STA SKIPH
 LDA CSRIN
 BEQ RB0
 LDA HSL
 STA SKIPL
 LDA HSH
 STA SKIPH
RB0 LDA WOFFL
 STA RB1+1
 CLC
 LDA WOFFH
 ADC #>TEXT
 STA RB1+2
RBLP LDA WOFFL
 CMP TLENL
 BNE RB2
 LDA WOFFH
 CMP TLENH
 BEQ RBDN
RB2
RB1 LDA $FFFF
 INC RB1+1
 BNE RB3
 INC RB1+2
RB3 INC WOFFL
 BNE RB4
 INC WOFFH
RB4 CMP #CR
 BEQ RBDN
 AND #$7F
 CMP #' '
 BCS RB5
 LDA #' '
RB5 STA RBCH
 LDA SKIPL
 ORA SKIPH
 BEQ RB6
 LDA SKIPL
 BNE RB7
 DEC SKIPH
RB7 DEC SKIPL
 LDA #1
 STA HLEFT
 JMP RBLP
RB6 LDX RBCOL
 CPX #80
 BCC RB8
 LDA #1
 STA HRIGHT
 JMP RBLP
RB8 LDA RBCH
 ORA #$80
 STA LINE80,X
 INC RBCOL
 JMP RBLP
RBDN LDA CSRIN
 BEQ RBX
 SEC
 LDA CCOLL
 SBC HSL
 TAX
 LDA LINE80,X
 AND #$7F
 JSR UPC
 AND #$3F
 STA LINE80,X
RBX RTS

* ---- WINDOW REPAINT ----
WREPANT LDA TOPL
 STA WOFFL
 LDA TOPH
 STA WOFFH
 LDA #1
 STA PROW
WRP1 LDA #0
 STA CSRIN
 LDA PROW
 CMP CROW
 BNE WRP2
 LDA #1
 STA CSRIN
WRP2 JSR RENDBL
 JSR RENDLIN
 INC PROW
 LDA PROW
 CMP #23
 BCC WRP1
 RTS

* CURSOR ROW ONLY (FAST PATH)
RENDCR LDA CLSL
 STA WOFFL
 LDA CLSH
 STA WOFFH
 LDA #1
 STA CSRIN
 LDA CROW
 STA PROW
 JSR RENDBL
 JMP RENDLIN

* ---- TITLE + STATUS ROWS ----
DRAWTIT LDA #1
 STA L80INV
 LDA #' '
 AND #$3F
 JSR L80FIL
 LDA #0
 STA L80COL
 LDX #<TITLES
 LDY #>TITLES
 JSR L80PUTS
 LDA #0
 STA PROW
 JMP RENDLIN

DRAWST LDA MSGON
 BEQ DST0
 DEC MSGON
 RTS
DST0 LDA #1
 STA L80INV
 LDA #' '
 AND #$3F
 JSR L80FIL
 LDA #0
 STA L80COL
 LDA HAVNAM
 BEQ DST1
 LDX #<FNAME1
 LDY #>FNAME1
 JSR L80PUTS
 JMP DST2
DST1 LDX #<MNONAME
 LDY #>MNONAME
 JSR L80PUTS
DST2 LDA DIRTY
 BEQ DST3
 LDA #'*'
 JSR L80PUTC
DST3 LDX #<MLINE
 LDY #>MLINE
 JSR L80PUTS
 LDA CURLNL
 STA DVL
 LDA CURLNH
 STA DVH
 JSR L80DEC
 LDX #<MCOL
 LDY #>MCOL
 JSR L80PUTS
 CLC
 LDA CCOLL
 ADC #1
 STA DVL
 LDA CCOLH
 ADC #0
 STA DVH
 JSR L80DEC
 LDA #76
 STA L80COL
 LDA HLEFT
 BEQ DST4
 LDA #'<'
 JSR L80PUTC
DST4 LDA #77
 STA L80COL
 LDA HRIGHT
 BEQ DST5
 LDA #'>'
 JSR L80PUTC
DST5 LDA #23
 STA PROW
 JMP RENDLIN

* COMPOSE+SHOW MSG ON STATUS ROW
MSGCOMP STX WSAVL
 STY WSAVH
 LDA #1
 STA L80INV
 LDA #$20
 JSR L80FIL
 LDA #0
 STA L80COL
 LDX WSAVL
 LDY WSAVH
 JSR L80PUTS
 LDA #23
 STA PROW
 JMP RENDLIN

* MSG THAT SURVIVES ONE DRAWST
STMSG JSR MSGCOMP
 LDA #1
 STA MSGON
 RTS

* Y/N PROMPT. C=0 ONLY ON Y.
GETYN JSR MSGCOMP
 JSR KEYWAIT
 CMP #$D9 ; Y
 BEQ GYY
 CMP #$F9 ; LC Y
 BEQ GYY
 SEC
 RTS
GYY CLC
 RTS

* ---- FILENAME PROMPT ----
* X/Y=PROMPT. RESULT IN NBUF.
* EMPTY INPUT = KEEP FNAME.
* C=1 CANCELLED.
PRFN STX PRPL
 STY PRPH
 LDA #0
 STA PRMODE
 STA NBUF
 STA NBUF+1
 BEQ PFLP
* PREFILLED ENTRY: CALLER SET
* PRMODE + NBUF CONTENT.
PRFNP STX PRPL
 STY PRPH
PFLP LDA #1
 STA L80INV
 LDA #$20
 JSR L80FIL
 LDA #0
 STA L80COL
 LDX PRPL
 LDY PRPH
 JSR L80PUTS
 LDX #<NBUF1
 LDY #>NBUF1
 JSR L80PUTS
 LDA #23
 STA PROW
 JSR RENDLIN
 JSR KEYWAIT
 CMP #$8D ; RETURN
 BEQ PFRET
 CMP #$9B ; ESC
 BEQ PFESC
 CMP #$FF ; DELETE
 BEQ PFDEL
 CMP #$88 ; LEFT ARROW = BS
 BEQ PFDEL
 AND #$7F
 JSR UPC
 LDX PRMODE
 BNE PFANY
 CMP #'.' ; ACCEPT . / 0-9
 BCC PFLP
 CMP #'9'+1
 BCC PFOK
 CMP #'A' ; AND A-Z
 BCC PFLP
 CMP #'Z'+1
 BCS PFLP
 BCC PFOK
PFANY CMP #' ' ; FREE TEXT MODE
 BCC PFLP
 CMP #$7F
 BCS PFLP
PFOK LDX NBUF
 CPX #64
 BCS PFLP
 STA NBUF+1,X
 LDA #0
 STA NBUF+2,X
 INC NBUF
 JMP PFLP
PFDEL LDX NBUF
 BEQ PFLP
 DEC NBUF
 LDX NBUF
 LDA #0
 STA NBUF+1,X
 JMP PFLP
PFESC SEC
 RTS
PFRET LDA NBUF
 BNE PFACC
 LDA PRMODE
 BNE PFESC
 LDA HAVNAM
 BEQ PFESC
 LDA FNAME
 STA NBUF
 LDX #0
PFC1 CPX FNAME
 BCS PFC2
 LDA FNAME+1,X
 STA NBUF+1,X
 INX
 BNE PFC1
PFC2 LDA #0
 STA NBUF+1,X
PFACC CLC
 RTS

* COMMIT NBUF -> FNAME
NCOMMIT LDA NBUF
 STA FNAME
 LDX #0
NC1 CPX NBUF
 BCS NC2
 LDA NBUF+1,X
 STA FNAME+1,X
 INX
 BNE NC1
NC2 LDA #0
 STA FNAME+1,X
 LDA #1
 STA HAVNAM
 RTS

* ---- MLI FILE OPS ----
* ^L LOAD FILE INTO BUFFER
DOLOAD LDA DIRTY
 BEQ DLD1
 LDX #<MLOSE
 LDY #>MLOSE
 JSR GETYN
 BCC DLD1
 RTS
DLD1 LDX #<MLOADP
 LDY #>MLOADP
 JSR PRFN
 BCC DLD2
 RTS
DLD2 JSR MLI
 DFB $C8 ; OPEN
 DA OPARM
 BCC DLD3
 JMP MERRA8
DLD3 LDA OREF
 STA RREF
 STA R2REF
 STA CLREF
 JSR MLI
 DFB $CA ; READ 12KB
 DA RPARM
 BCC DLD4
 CMP #$4C ; EOF OK
 BEQ DLD4
 JMP MERRA8
DLD4 LDA RTRANS
 STA TLENL
 LDA RTRANS+1
 STA TLENH
 CMP #>TMAX
 BCC DLD5
* FULL READ - ANYTHING LEFT?
 JSR MLI
 DFB $CA
 DA R2PARM
 BCS DLD5 ; EOF = EXACT FIT
 LDA R2TRANS
 BEQ DLD5
* TOO BIG: EMPTY BUFFER, ERROR
 JSR CLOSEF
 JSR EDINIT
 LDA #1
 STA NEEDALL
 LDX #<MTOOBIG
 LDY #>MTOOBIG
 JMP STMSG
DLD5 JSR CLOSEF
 JSR NORMBF
 JSR NCOMMIT
 LDA #0
 STA CURSL
 STA CURSH
 STA TOPL
 STA TOPH
 STA CURLNH
 STA DIRTY
 STA ASMDON
 LDA #1
 STA CURLNL
 STA NEEDALL
 RTS

* NORMALIZE LOADED TEXT IN PLACE:
* STRIP HI BITS (AC/MERLIN TXT IS
* HI-BIT ASCII, LINE END = $8D),
* LONE LF -> CR, CRLF -> CR.
NORMBF LDA #<TEXT
 STA NB1+1
 STA NB2+1
 LDA #>TEXT
 STA NB1+2
 STA NB2+2
 LDA TLENL
 STA MVCL
 LDA TLENH
 STA MVCH
 LDA #0
 STA TLENL
 STA TLENH
 STA NBPRV
NBLP LDA MVCL
 ORA MVCH
 BEQ NBDN
NB1 LDA $FFFF
 INC NB1+1
 BNE NB3
 INC NB1+2
NB3 AND #$7F
 STA NBRAW
 CMP #$0A
 BNE NBST
 LDA NBPRV
 CMP #CR
 BEQ NBSK ; CRLF: DROP LF
 LDA #CR ; LONE LF -> CR
 JMP NBST2
NBST LDA NBRAW
NBST2
NB2 STA $FFFF
 INC NB2+1
 BNE NB4
 INC NB2+2
NB4 INC TLENL
 BNE NBSK
 INC TLENH
NBSK LDA NBRAW
 STA NBPRV
 LDA MVCL
 BNE NB5
 DEC MVCH
NB5 DEC MVCL
 JMP NBLP
NBDN RTS

* ^S SAVE BUFFER TO FILE.
* ON-DISK FORMAT = HI-BIT ASCII
* (MATCHES MERLIN + AC IMPORTS):
* CHUNKS ORA #$80 THROUGH STAGEB,
* BUFFER ITSELF STAYS 7-BIT.
* PROMPT PREFILLED WITH CURRENT
* NAME SO IT CAN BE EDITED.
DOSAVE LDA #0
 STA PRMODE
 LDA FNAME
 STA NBUF
 LDX #0
DSVP1 CPX FNAME
 BCS DSVP2
 LDA FNAME+1,X
 STA NBUF+1,X
 INX
 BNE DSVP1
DSVP2 LDA #0
 STA NBUF+1,X
 LDX #<MSAVEP
 LDY #>MSAVEP
 JSR PRFNP
 BCC DSV1
 RTS
DSV1 JSR MLI
 DFB $C1 ; DESTROY STALE
 DA DPARM
 BCC DSV2
 CMP #$46 ; NOT FOUND = OK
 BEQ DSV2
 JMP MERRA8
DSV2 JSR MLI
 DFB $C0 ; CREATE TXT
 DA CRPARM
 BCC DSV3
 JMP MERRA8
DSV3 JSR MLI
 DFB $C8
 DA OPARM
 BCC DSV4
 JMP MERRA8
DSV4 LDA OREF
 STA W8REF
 STA CLREF
 LDA TLENL
 STA REML
 LDA TLENH
 STA REMH
 LDA #<TEXT
 STA SV1+1
 LDA #>TEXT
 STA SV1+2
DSVLP LDA REML
 ORA REMH
 BEQ DSV5
 LDA REMH
 BEQ DSVLST
 LDA #0
 STA W8CNT
 LDA #1
 STA W8CNT+1
 DEC REMH
 LDX #0 ; X=0 -> 256 BYTES
 JMP DSVCP
DSVLST LDA REML
 STA W8CNT
 LDA #0
 STA W8CNT+1
 STA REML
 LDX W8CNT
DSVCP LDY #0
DSVC1
SV1 LDA $FFFF,Y
 ORA #$80
 STA STAGEB,Y
 INY
 DEX
 BNE DSVC1
 JSR MLI
 DFB $CB ; WRITE CHUNK
 DA W8PARM
 BCC DSVNX
 JMP MERRA8
DSVNX INC SV1+2
 JMP DSVLP
DSV5 JSR CLOSEF
 JSR NCOMMIT
 LDA #0
 STA DIRTY
 LDX #<MSAVED
 LDY #>MSAVED
 JMP STMSG

* GUARDED CLOSE OF OPEN REF
CLOSEF LDA OREF
 BEQ CLFX
 STA CLREF
 LDA #0
 STA OREF
 JSR MLI
 DFB $CC
 DA CLPARM
CLFX RTS

* MLI ERROR: A=CODE. CLOSES.
MERRA8 STA ERRB
 JSR CLOSEF
 LDA #1
 STA L80INV
 LDA #$20
 JSR L80FIL
 LDA #0
 STA L80COL
 LDX #<MMLIE
 LDY #>MMLIE
 JSR L80PUTS
 LDA ERRB
 JSR L80HEX
 LDA #23
 STA PROW
 JSR RENDLIN
 LDA #1
 STA MSGON
 RTS

* PUT A AS 2 HEX DIGITS
L80HEX PHA
 LSR
 LSR
 LSR
 LSR
 JSR L80NIB
 PLA
 AND #$0F
L80NIB CMP #10
 BCC L80NI1
 ADC #6
L80NI1 ADC #'0'
 JMP L80PUTC

* ---- PRODOS PREFIX AT BOOT ----
* EMPTY PREFIX: BUILD /VOL FROM
* LAST DEVICE VIA ON_LINE.
PFXINIT JSR MLI
 DFB $C7 ; GET_PREFIX
 DA GPPARM
 LDA PFXBUF
 BNE PFXOK
 LDA $BF30
 STA OLUNIT
 JSR MLI
 DFB $C5 ; ON_LINE
 DA OLPARM
 BCS PFXOK
 LDA OLBUF
 AND #$0F
 BEQ PFXOK
 TAX
 LDY #0
PFX1 LDA OLBUF+1,Y
 STA PFXBUF+2,Y
 INY
 DEX
 BNE PFX1
 LDA #'/'
 STA PFXBUF+1
 LDA OLBUF
 AND #$0F
 CLC
 ADC #1
 STA PFXBUF
 JSR MLI
 DFB $C6 ; SET_PREFIX
 DA GPPARM
PFXOK RTS

* ---- SCREEN MODE ----
SCRINIT STA STXTON
 STA SHIROF
 STA SPG2OF
 STA SS80ON
 STA SC80ON
 LDA #$A0
 JSR L80FIL
 LDA #0
 STA PROW
SCI1 JSR RENDLIN
 INC PROW
 LDA PROW
 CMP #24
 BCC SCI1
 RTS

SCREXIT STA SPG2OF
 STA SS80OF
 STA SC80OF
 STA STXTON
 JSR SETTXT
 JSR HOME
 RTS

* ---- AUX MEMORY PLUMBING ----
* OWN RAMRD/RAMWR LOOPS - AUXMOVE
* IS BANNED (USES PRODOS ZP).
* RULES: NO SELF-MOD WRITES WHILE
* RAMWR IS ON (THEY LAND IN AUX);
* NO MLI/COUT WHILE EITHER IS ON.

* TEMPLATE COPIED TO $130. READS
* AUX PAGE (HI BYTE POKED AT $138)
* INTO STAGEB. POS-INDEPENDENT.
AUXTPL SEI
 STA $C003 ; RAMRD ON
 LDY #0
AUXTP1 LDA $4000,Y
 STA STAGEB,Y
 INY
 BNE AUXTP1
 STA $C002 ; RAMRD OFF
 CLI
 RTS

* PULL AUX PAGE A (0-2F) -> STAGEB
AUXRD CLC
 ADC #$40
 STA $138
 JMP $130

* PUSH STAGEB -> AUX PAGE A (0-2F)
AUXWR CLC
 ADC #$40
 STA AXW1+2 ; BEFORE RAMWR ON
 SEI
 STA $C005 ; RAMWR ON
 LDY #0
AXWL LDA STAGEB,Y
AXW1 STA $4000,Y
 INY
 BNE AXWL
 STA $C004 ; RAMWR OFF
 CLI
 RTS

* ZERO AUX $4000-6FFF. SELF-MOD
* OPERAND UPDATED WITH RAMWR OFF.
AUXZ LDA #$40
AXZ0 STA AXZ1+2
 SEI
 STA $C005
 LDA #0
 TAY
AXZL
AXZ1 STA $4000,Y
 INY
 BNE AXZL
 STA $C004
 CLI
 LDA AXZ1+2
 CLC
 ADC #1
 CMP #$70
 BCC AXZ0
 RTS

* ---- CORE SEAMS (A8 SIDE) ----
* SOURCE = THE TEXT BUFFER
SRCOPEN LDA #0
 STA WLKL
 STA WLKH
SRCDONE RTS
SRCLINE LDA #0
 STA LINEL
 LDA WLKL
 CMP TLENL
 BNE SL0
 LDA WLKH
 CMP TLENH
 BNE SL0
 SEC
 RTS
SL0 LDA WLKL
 STA SL1+1
 CLC
 LDA WLKH
 ADC #>TEXT
 STA SL1+2
SLLP LDA WLKL
 CMP TLENL
 BNE SL2
 LDA WLKH
 CMP TLENH
 BEQ SLDN ; EOF ENDS LINE
SL2
SL1 LDA $FFFF
 INC SL1+1
 BNE SL3
 INC SL1+2
SL3 INC WLKL
 BNE SL4
 INC WLKH
SL4 AND #$7F
 CMP #CR
 BEQ SLDN
 CMP #$0A
 BEQ SLLP
 CMP #9
 BNE SL5
 LDA #' '
SL5 JSR UPC
 LDX LINEL
 CPX #127
 BCS SLLONG
 STA LINEB,X
 INC LINEL
 JMP SLLP
SLLONG LDX #<ELONG
 LDY #>ELONG
 JMP ERRHOOK
SLDN CLC
 RTS

* OBJECT SINK: 256B MAIN STAGING
* PAGE, FLUSHED TO AUX ON PAGE
* CROSS. PAGES ARRIVE IN ORDER
* (ORG NEVER GOES BACKWARD) SO A
* FRESH PAGE IS ALWAYS ZEROS.
OINIT JSR AUXZ
 LDA #$FF
 STA STGPG
 RTS
OSTORE LDA OFH
 CMP STGPG
 BEQ OST2
 JSR STGFLS
 LDA OFH
 STA STGPG
 LDA #0
 LDX #0
OST1 STA STAGEB,X
 INX
 BNE OST1
OST2 LDX OFL
 LDA EMB
 STA STAGEB,X
 RTS
* FLUSH STAGEB TO AUX PAGE STGPG
STGFLS LDA STGPG
 CMP #$FF
 BEQ STGX
 JSR AUXWR
STGX RTS

* CORE ERRHOOK: X/Y=MSG. RESTORE
* SP, CURSOR TO ERROR LINE, MSG
* ON STATUS ROW. RETURNS TO THE
* DOASM CALLER WITH C=1.
ERRHOOK STX AEML
 STY AEMH
 LDX ASPSAV
 TXS
 LDA LINENO
 STA GOTL
 LDA LINENO+1
 STA GOTH
 JSR GOTOLN
 LDA #1
 STA NEEDALL
 STA L80INV
 LDA #$20
 JSR L80FIL
 LDA #0
 STA L80COL
 LDX #<MLINE2
 LDY #>MLINE2
 JSR L80PUTS
 LDA LINENO
 STA DVL
 LDA LINENO+1
 STA DVH
 JSR L80DEC
 LDX #<MCOLON
 LDY #>MCOLON
 JSR L80PUTS
 LDX AEML
 LDY AEMH
 JSR L80PUTS
 LDA #23
 STA PROW
 JSR RENDLIN
 LDA #1
 STA MSGON
 SEC
 RTS

* CURSOR TO LINE GOTL/GOTH
GOTOLN LDA #0
 STA CURSL
 STA CURSH
 STA CURLNH
 LDA #1
 STA CURLNL
GTL1 LDA CURLNL
 CMP GOTL
 BNE GTL2
 LDA CURLNH
 CMP GOTH
 BEQ GTLX
GTL2 LDA CURSL
 STA WOFFL
 LDA CURSH
 STA WOFFH
 JSR NEXTLN
 BCS GTLX
 LDA WOFFL
 STA CURSL
 LDA WOFFH
 STA CURSH
 INC CURLNL
 BNE GTL1
 INC CURLNH
 JMP GTL1
GTLX RTS

* ---- ^A ASSEMBLE BUFFER ----
* C=0 OK, C=1 ERROR (MSG SHOWN).
* OBJECT ALSO WRITTEN TO DISK
* (KEEPS B8RUN/B8CMP INTEROP).
DOASM LDA HAVNAM
 BNE DAS1
 LDX #<MNONM
 LDY #>MNONM
 JSR STMSG
 SEC
 RTS
DAS1 LDX #<MASMG
 LDY #>MASMG
 JSR MSGCOMP
 TSX
 STX ASPSAV
 JSR ASMGO
 JSR STGFLS
 LDA #$FF
 STA STGPG
 JSR WROBJ8
 BCC DAS2
 RTS
DAS2 LDA #1
 STA ASMDON
 JSR ASMOK
 CLC
 RTS

* SUCCESS BANNER: OK $LEN AT $ORG
ASMOK LDA #1
 STA L80INV
 LDA #$20
 JSR L80FIL
 LDA #0
 STA L80COL
 LDX #<MOK1
 LDY #>MOK1
 JSR L80PUTS
 LDA OENDH
 JSR L80HEX
 LDA OENDL
 JSR L80HEX
 LDX #<MOK2
 LDY #>MOK2
 JSR L80PUTS
 LDA ORGH
 JSR L80HEX
 LDA ORGL
 JSR L80HEX
 LDA #23
 STA PROW
 JSR RENDLIN
 LDA #1
 STA MSGON
 RTS

* OBJ NAME = FNAME MINUS .EXT
MKOBJ8 LDX #0
MK8C CPX FNAME
 BCS MK8S
 LDA FNAME+1,X
 STA OPATH8+1,X
 INX
 BNE MK8C
MK8S LDX FNAME
MK81 LDA OPATH8,X
 CMP #'.'
 BEQ MK8DOT
 CMP #'/'
 BEQ MK8AP
 DEX
 BNE MK81
MK8AP LDX FNAME
 INX
 LDA #'.'
 STA OPATH8,X
 INX
 LDA #'B'
 STA OPATH8,X
 STX OPATH8
 RTS
MK8DOT DEX
 STX OPATH8
 RTS

* WRITE AUX OUTBUF AS BIN AUX=ORG
* VIA STAGEB PAGE PULLS. C=1 ERR.
WROBJ8 JSR MKOBJ8
 JSR MLI
 DFB $C1 ; DESTROY STALE
 DA DP8PARM
 BCC W8CR
 CMP #$46
 BEQ W8CR
W8ERR JSR MERRA8
 SEC
 RTS
W8CR LDA ORGL
 STA CR8AUX
 LDA ORGH
 STA CR8AUX+1
 JSR MLI
 DFB $C0 ; CREATE BIN
 DA CR8PARM
 BCS W8ERR
 JSR MLI
 DFB $C8
 DA OP8PARM
 BCS W8ERR
 LDA OP8REF
 STA OREF
 STA CLREF
 STA W8REF
 LDA OENDL
 STA REML
 LDA OENDH
 STA REMH
 LDA #0
 STA PGIDX
W8LP LDA REML
 ORA REMH
 BEQ W8DN
 LDA PGIDX
 JSR AUXRD
 LDA REMH
 BEQ W8LST
 LDA #0
 STA W8CNT
 LDA #1
 STA W8CNT+1
 DEC REMH
 JMP W8GO
W8LST LDA REML
 STA W8CNT
 LDA #0
 STA W8CNT+1
 STA REML
W8GO JSR MLI
 DFB $CB ; WRITE 256/REM
 DA W8PARM
 BCS W8ERR
 INC PGIDX
 JMP W8LP
W8DN JSR CLOSEF
 CLC
 RTS

* ---- ^F FIND ----
* FORWARD FROM CURSOR+1, WRAPS,
* CASE-INSENSITIVE. PROMPT COMES
* PREFILLED WITH THE LAST PATTERN.
DOFIND LDA FBUF
 STA NBUF
 LDX #0
DFP1 CPX FBUF
 BCS DFP2
 LDA FBUF+1,X
 STA NBUF+1,X
 INX
 BNE DFP1
DFP2 LDA #0
 STA NBUF+1,X
 LDA #1
 STA PRMODE
 LDX #<MFINDP
 LDY #>MFINDP
 JSR PRFNP
 BCC DFF0
 RTS
DFF0 LDA NBUF
 BNE DFF1
 RTS
DFF1 LDA NBUF
 STA FBUF
 LDX #0
DFF2 CPX NBUF
 BCS DFF3
 LDA NBUF+1,X
 STA FBUF+1,X
 INX
 BNE DFF2
DFF3 SEC
 LDA TLENL
 SBC FBUF
 STA LIML
 LDA TLENH
 SBC #0
 STA LIMH
 BCS DFF4
 JMP DFNF ; PATTERN > TEXT
DFF4 CLC
 LDA CURSL
 ADC #1
 STA POSL
 LDA CURSH
 ADC #0
 STA POSH
 CLC
 LDA TLENL
 ADC #1
 STA MVCL
 LDA TLENH
 ADC #0
 STA MVCH
DFLP LDA MVCL
 ORA MVCH
 BEQ DFNF
 LDA POSL
 CMP TLENL
 BNE DFW1
 LDA POSH
 CMP TLENH
 BNE DFW1
 LDA #0
 STA POSL
 STA POSH
DFW1 LDA POSH
 CMP LIMH
 BCC DFCMP
 BNE DFNXT
 LDA POSL
 CMP LIML
 BCC DFCMP
 BEQ DFCMP
 JMP DFNXT
DFCMP LDA POSL
 STA DFC1+1
 CLC
 LDA POSH
 ADC #>TEXT
 STA DFC1+2
 LDY #0
DFC1 LDA $FFFF,Y
 AND #$7F
 JSR UPC
 CMP FBUF+1,Y
 BNE DFNXT
 INY
 CPY FBUF
 BCC DFC1
* MATCH AT POS
 LDA POSL
 STA CURSL
 LDA POSH
 STA CURSH
 JSR CNTLNS
 LDA #1
 STA NEEDALL
 RTS
DFNXT INC POSL
 BNE DFN1
 INC POSH
DFN1 LDA MVCL
 BNE DFN2
 DEC MVCH
DFN2 DEC MVCL
 JMP DFLP
DFNF LDX #<MNOTF
 LDY #>MNOTF
 JMP STMSG

* ---- ^O GOTO LINE ----
DOGOTO LDX #<MGOTOP
 LDY #>MGOTOP
 JSR PRFN
 BCC DGT1
 RTS
DGT1 LDA #0
 STA GOTL
 STA GOTH
 LDX #0
DGT2 CPX NBUF
 BCS DGT4
 LDA NBUF+1,X
 CMP #'0'
 BCC DGT4
 CMP #'9'+1
 BCS DGT4
 SEC
 SBC #'0'
 PHA
 LDA GOTL
 STA DVL
 LDA GOTH
 STA DVH
 ASL GOTL
 ROL GOTH
 ASL GOTL
 ROL GOTH
 CLC
 LDA GOTL
 ADC DVL
 STA GOTL
 LDA GOTH
 ADC DVH
 STA GOTH
 ASL GOTL
 ROL GOTH
 PLA
 CLC
 ADC GOTL
 STA GOTL
 LDA GOTH
 ADC #0
 STA GOTH
 INX
 BNE DGT2
DGT4 LDA GOTL
 ORA GOTH
 BNE DGT5
 RTS ; NO NUMBER
DGT5 JSR GOTOLN
 LDA #1
 STA NEEDALL
 RTS

* ---- TERMINAL (ROWS 1-22) ----
* GLASS TTY FOR ^G. NEVER COUT -
* THAT WRITES 40-COL PAGE1 OVER
* OUR 80-COL SCREEN.
TRMCLR LDA #$A0
 JSR L80FIL
 LDA #1
 STA PROW
TCL1 JSR RENDLIN
 INC PROW
 LDA PROW
 CMP #23
 BCC TCL1
 LDA #1
 STA TROW
 LDA #0
 STA TCOL
 RTS

* PUT VIDEO BYTE A AT TROW/TCOL
TRMPCH STA TRMCH
 LDX TROW
 LDA BASL,X
 STA TP1+1
 LDA BASH,X
 STA TP1+2
 LDA TCOL
 LSR ; C=1 ODD COL (MAIN)
 TAY
 LDA TRMCH
 BCS TPODD
 STA SPG2ON
 JSR TPS
 STA SPG2OF
 RTS
TPODD JMP TPS
TPS
TP1 STA $0400,Y
 RTS

* TERMINAL CHAR OUT (7-BIT A)
TRMPUT CMP #CR
 BNE TRP1
 JMP TRMNL
TRP1 CMP #$0A
 BNE TRP2
 RTS
TRP2 CMP #' '
 BCS TRP3
 RTS ; OTHER CTRLS DROPPED
TRP3 ORA #$80
 JSR TRMPCH
 INC TCOL
 LDA TCOL
 CMP #80
 BCC TRPX
 JMP TRMNL
TRPX RTS

TRMNL LDA #0
 STA TCOL
 INC TROW
 LDA TROW
 CMP #23
 BCC TRNX
 JSR TRMSCR
 LDA #22
 STA TROW
TRNX RTS

* SCROLL ROWS 2-22 UP ONE
TRMSCR LDA #1
 STA SVROW
TSC1 LDX SVROW
 INX
 LDA BASL,X
 STA TS1+1
 STA TS3+1
 LDA BASH,X
 STA TS1+2
 STA TS3+2
 LDX SVROW
 LDA BASL,X
 STA TS2+1
 STA TS4+1
 LDA BASH,X
 STA TS2+2
 STA TS4+2
 STA SPG2ON
 LDY #39
TSL1
TS1 LDA $0400,Y
TS2 STA $0400,Y
 DEY
 BPL TSL1
 STA SPG2OF
 LDY #39
TSL2
TS3 LDA $0400,Y
TS4 STA $0400,Y
 DEY
 BPL TSL2
 INC SVROW
 LDA SVROW
 CMP #22
 BCC TSC1
 LDA #$A0
 JSR L80FIL
 LDA #22
 STA PROW
 JMP RENDLIN

* ASCIIZ AT Y:X -> TERMINAL
TRMPUTS STX TPS1+1
 STY TPS1+2
TPS1 LDA $FFFF
 BEQ TPSD
 JSR TRMPUT
 INC TPS1+1
 BNE TPS1
 INC TPS1+2
 BNE TPS1
TPSD RTS

* A AS TWO HEX CHARS -> TERMINAL
TRMHEX PHA
 LSR
 LSR
 LSR
 LSR
 JSR THNIB
 PLA
 AND #$0F
THNIB CMP #10
 BCC THN1
 ADC #6
THN1 ADC #'0'
 JMP TRMPUT

* A -> TWO HEX CHARS TO RX FIFO,
* SUMMED INTO CKSUM (B8RUN LIFT)
HEXOUT PHA
 CLC
 ADC CKSUM
 STA CKSUM
 PLA
 PHA
 LSR
 LSR
 LSR
 LSR
 JSR HONIB
 PLA
 AND #$0F
HONIB CMP #10
 BCC HON1
 ADC #6
HON1 ADC #'0'
 JMP B8_RXPUT

* ---- ^G LOAD TO CARD + TTY ----
* ASSEMBLE IF DIRTY/STALE, STREAM
* AUX OUTBUF AS INTEL HEX L RECS,
* LAND AT THE MONITOR. NO AUTO-G:
* USER INSPECTS (D/H), TYPES G.
DOGO LDA DIRTY
 BNE DGA
 LDA ASMDON
 BNE DG0
DGA JSR DOASM
 BCC DG0
 RTS ; ASSEMBLE FAILED
DG0 JSR B8_PRESENT
 BCC DG1
 LDX #<MNOCARD
 LDY #>MNOCARD
 JMP STMSG
DG1 JSR TRMCLR
 LDX #<MSEND
 LDY #>MSEND
 JSR TRMPUTS
 LDA #CR
 JSR TRMPUT
 LDA #'L'
 JSR B8_RXPUT
 LDA #CR
 JSR B8_RXPUT
 LDA ORGL
 STA AUXLO
 LDA ORGH
 STA AUXHI
 LDA OENDL
 STA LEN2L
 LDA OENDH
 STA LEN2H
 LDA #0
 STA PGIDX
 STA SIDX
* 16-BYTE RECORDS. 256 IS A
* MULTIPLE OF 16 SO A RECORD
* NEVER STRADDLES A PAGE PULL.
DGREC LDA LEN2L
 ORA LEN2H
 BNE DGR0
 JMP DGEOF
DGR0 LDA SIDX
 BNE DGR1
 LDA PGIDX
 JSR AUXRD
 INC PGIDX
DGR1 LDA LEN2H
 BNE DGN16
 LDA LEN2L
 CMP #16
 BCS DGN16
 STA RECN
 JMP DGLEN
DGN16 LDA #16
 STA RECN
DGLEN LDA #0
 STA CKSUM
 LDA #':'
 JSR B8_RXPUT
 LDA RECN
 JSR HEXOUT
 LDA AUXHI
 JSR HEXOUT
 LDA AUXLO
 JSR HEXOUT
 LDA #0
 JSR HEXOUT
 LDX RECN
 LDY SIDX
DGDAT LDA STAGEB,Y
 JSR HEXOUT
 INY
 INC AUXLO
 BNE DGD1
 INC AUXHI
DGD1 LDA LEN2L
 BNE DGD2
 DEC LEN2H
DGD2 DEC LEN2L
 DEX
 BNE DGDAT
 STY SIDX
 LDA #0
 SEC
 SBC CKSUM
 JSR HEXOUT
 LDA #CR
 JSR B8_RXPUT
* DRAIN TX EACH RECORD (64-BYTE
* FIFO ATE THE TAIL UNATTENDED)
DGDRN JSR B8_TXGET
 BCS DGRJ
 AND #$7F
 JSR TRMPUT
 JMP DGDRN
DGRJ JMP DGREC
* EOF RECORD, ESC, SETTLE, DRAIN
DGEOF LDA #':'
 JSR B8_RXPUT
 LDA #0
 STA CKSUM
 LDA #0
 JSR HEXOUT
 LDA #0
 JSR HEXOUT
 LDA #0
 JSR HEXOUT
 LDA #1
 JSR HEXOUT
 LDA #$FF
 JSR HEXOUT
 LDA #CR
 JSR B8_RXPUT
 LDA #ESC
 JSR B8_RXPUT
 LDX #250
DGEDL LDY #0
DGEDY DEY
 BNE DGEDY
 DEX
 BNE DGEDL
DGEDR JSR B8_TXGET
 BCS DGEDD
 AND #$7F
 JSR TRMPUT
 JMP DGEDR
DGEDD LDA #CR
 JSR TRMPUT
 LDX #<MLOAD1
 LDY #>MLOAD1
 JSR TRMPUTS
 LDA OENDH
 JSR TRMHEX
 LDA OENDL
 JSR TRMHEX
 LDX #<MLOAD2
 LDY #>MLOAD2
 JSR TRMPUTS
 LDA ORGH
 JSR TRMHEX
 LDA ORGL
 JSR TRMHEX
 LDX #<MLOAD3
 LDY #>MLOAD3
 JSR TRMPUTS
 LDA ORGH
 JSR TRMHEX
 LDA ORGL
 JSR TRMHEX
 LDX #<MLOAD4
 LDY #>MLOAD4
 JSR TRMPUTS
 LDA #CR
 JSR TRMPUT
 LDX #<MTTY
 LDY #>MTTY
 JSR TRMPUTS
 LDA #CR
 JSR TRMPUT
* GLASS TTY. ^Q BACK TO EDITOR.
A8TTY LDA KBD
 BPL ATT1
 STA KBDSTRB
 CMP #$91 ; ^Q
 BEQ ATTQ
 AND #$7F
 JSR B8_RXPUT
ATT1 JSR B8_TXGET
 BCS A8TTY
 AND #$7F
 JSR TRMPUT
 JMP A8TTY
ATTQ LDA #1
 STA NEEDALL
 RTS

* ---- MLI PARM BLOCKS ----
GPPARM DFB 1
 DA PFXBUF
OLPARM DFB 2
OLUNIT DFB 0
 DA OLBUF
OPARM DFB 3
 DA NBUF
 DA IOBUF
OREF DFB 0
RPARM DFB 4
RREF DFB 0
 DA TEXT
 DA TMAX
RTRANS DA 0
R2PARM DFB 4
R2REF DFB 0
 DA OVFB
 DA 1
R2TRANS DA 0
CLPARM DFB 1
CLREF DFB 0
DPARM DFB 1
 DA NBUF
CRPARM DFB 7
 DA NBUF
 DFB $C3 ; ACCESS
 DFB $04 ; TXT
 DA 0 ; AUX
 DFB $01 ; SEEDLING
 DA 0
 DA 0
DP8PARM DFB 1
 DA OPATH8
CR8PARM DFB 7
 DA OPATH8
 DFB $C3 ; ACCESS
 DFB $06 ; BIN
CR8AUX DA 0
 DFB $01 ; SEEDLING
 DA 0
 DA 0
OP8PARM DFB 3
 DA OPATH8
 DA IOBUF
OP8REF DFB 0
W8PARM DFB 4
W8REF DFB 0
 DA STAGEB
W8CNT DA 0
W8TR DA 0

* ---- STRINGS ----
TITLES ASC 'A8 ^S SAVE ^L LOAD ^N NEW'
 ASC ' ^D DELLN ^F FIND ^O GOTO'
 ASC ' ^A ASM ^G RUN ^Q QUIT'
 DFB 0
MNONAME ASC 'NEW'
 DFB 0
MLINE ASC ' L='
 DFB 0
MCOL ASC ' C='
 DFB 0
MFULL ASC 'BUFFER FULL'
 DFB 0
MLOADP ASC 'LOAD: '
 DFB 0
MSAVEP ASC 'SAVE: '
 DFB 0
MLOSE ASC 'LOSE CHANGES? Y/N'
 DFB 0
MQUITQ ASC 'UNSAVED. QUIT? Y/N'
 DFB 0
MTOOBIG ASC 'FILE OVER 12KB'
 DFB 0
MSAVED ASC 'SAVED'
 DFB 0
MMLIE ASC 'MLI ERR $'
 DFB 0
MNONM ASC 'NO NAME. ^S FIRST'
 DFB 0
MASMG ASC 'ASSEMBLING...'
 DFB 0
MOK1 ASC 'OK $'
 DFB 0
MOK2 ASC ' AT $'
 DFB 0
MLINE2 ASC 'LINE '
 DFB 0
MCOLON ASC ': '
 DFB 0
MNOCARD ASC 'NO B8008 CARD IN SLOT 4'
 DFB 0
MSEND ASC 'SENDING HEX'
 DFB 0
MLOAD1 ASC 'LOADED $'
 DFB 0
MLOAD2 ASC ' AT $'
 DFB 0
MLOAD3 ASC ' - G '
 DFB 0
MLOAD4 ASC ' WHEN READY'
 DFB 0
MTTY ASC '8008 TTY. ^Q TO EDITOR'
 DFB 0
MFINDP ASC 'FIND: '
 DFB 0
MGOTOP ASC 'LINE: '
 DFB 0
MNOTF ASC 'NOT FOUND'
 DFB 0

* ---- BUFFERS ----
FNAME DS 66
FNAME1 = FNAME+1
NBUF DS 66
NBUF1 = NBUF+1
PFXBUF DS 66
OLBUF DS 16
OVFB DS 1
OPATH8 DS 68
FBUF DS 66

 PUT B8LIB
* CORE + TABLE (MUST BE ADJACENT:
* DIRTAB ENDS THE CORE, ASM8TAB
* CONTINUES THE SAME SCAN REGION)
 PUT ASM8CORE
 PUT ASM8TAB
