* ASM8CORE.S - 8008 ASSEMBLER CORE
* PUT-INCLUDE LIBRARY. NO ORG, NO
* ZERO PAGE, NO MLI, NO COUT.
* DRIVER PROVIDES:
*  SRCOPEN  START A SOURCE PASS
*  SRCLINE  NEXT LINE -> LINEB
*           (7-BIT UPCASED, NO CR)
*           C=1 AT END OF SOURCE
*  SRCDONE  END OF PASS CLEANUP
*  OINIT    ZERO OBJECT SINK
*  OSTORE   STORE EMB AT OFL/OFH
*  ERRHOOK  X/Y=MSG, NO RETURN
* AND EQUATES: SYMTAB SYMFUL OUTMAX
* ENTRY: ASMGO = FULL TWO-PASS RUN.
* RESULT: ORGL/H OENDL/H VALID.
* DIRTAB MUST END THIS FILE - THE
* DRIVER MUST PUT ASM8TAB DIRECTLY
* AFTER (CONTIGUOUS TABLE SCAN).

* CORE STATE
PASSNO DS 1
LINEL DS 1
LINEP DS 1
LINENO DS 2
PCL DS 1
PCH DS 1
ORGL DS 1
ORGH DS 1
ORGSET DS 1
ENDF DS 1
OENDL DS 1
OENDH DS 1
P1PCL DS 1
P1PCH DS 1
EVL DS 1
EVH DS 1
TVL DS 1
TVH DS 1
T2L DS 1
T2H DS 1
OPC DS 1
UNDEF DS 1
HAVLBL DS 1
MNCLS DS 1
MNBASE DS 1
REGD DS 1
REGS2 DS 1
REGT DS 1
EMB DS 1
OFL DS 1
OFH DS 1
HEXN DS 1
GNL DS 1
STRN DS 1
SYMCL DS 1
SYMCH DS 1
LBLB DS 13
* TOKB+DEFV MUST STAY CONTIGUOUS:
* SYMADD COPIES 14 FROM TOKB+1
TOKB DS 13
DEFVL DS 1
DEFVH DS 1
LINEB DS 128

* ---- TWO-PASS DRIVER ----
ASMGO LDA #<SYMTAB
 STA SYMCL
 LDA #>SYMTAB
 STA SYMCH
 LDA #1
 STA PASSNO
 JSR DOPASS
 LDA PCL
 STA P1PCL
 LDA PCH
 STA P1PCH
 LDA #0
 STA OENDL
 STA OENDH
 JSR OINIT
 LDA #2
 STA PASSNO
 JSR DOPASS
 LDA ORGSET
 BNE AGO1
 LDX #<ENOORG
 LDY #>ENOORG
 JMP ERRHOOK
AGO1 LDA PCL
 CMP P1PCL
 BNE AGOPH
 LDA PCH
 CMP P1PCH
 BNE AGOPH
 RTS
AGOPH LDX #<EPHASE
 LDY #>EPHASE
 JMP ERRHOOK

* ONE FULL PASS OVER THE SOURCE
DOPASS LDA #0
 STA PCL
 STA PCH
 STA ORGSET
 STA ENDF
 STA LINENO
 STA LINENO+1
 JSR SRCOPEN
DPLP INC LINENO
 BNE DPL1
 INC LINENO+1
DPL1 JSR SRCLINE
 BCS DPDN
 JSR STMT
 LDA ENDF
 BEQ DPLP
DPDN JMP SRCDONE

* ---- STATEMENT PARSER ----
STMT LDA #0
 STA LINEP
 STA HAVLBL
 LDA LINEL
 BNE STM1
 RTS
STM1 LDA LINEB
 CMP #';'
 BEQ STMX
 CMP #'*'
 BEQ STMX
 CMP #' '
 BEQ STNL
 JSR GETIDENT
 BCC STM2
 LDX #<EBADLB
 LDY #>EBADLB
 JMP ERRHOOK
STM2 LDX #12
STM3 LDA TOKB,X
 STA LBLB,X
 DEX
 BPL STM3
 INC HAVLBL
 JSR PEEKC
 BCS STNL
 CMP #':'
 BNE STNL
 INC LINEP
STNL JSR ATEND
 BCC STMN
 LDA HAVLBL
 BEQ STMX
 JSR DEFPC
STMX RTS
STMN JSR SKIPSP
 JSR GETIDENT
 BCS STBM
 LDA TOKB
 CMP #5
 BCS STBM
 JSR MNFIND
 BCC STM4
STBM LDX #<EBADMN
 LDY #>EBADMN
 JMP ERRHOOK
STM4 LDA MNCLS
 CMP #10 ; EQU: LABEL=EXPR
 BNE STM5
 LDA HAVLBL
 BNE STM6
 LDX #<EEQUL
 LDY #>EEQUL
 JMP ERRHOOK
STM6 JSR NEEDEXPR
 LDA EVL
 STA DEFVL
 LDA EVH
 STA DEFVH
 JSR DEFLBL
 JMP STEND
STM5 LDA HAVLBL
 BEQ STM7
 JSR DEFPC
STM7 LDA MNCLS
 ASL
 TAX
 LDA CLSJMP,X
 STA STJ+1
 LDA CLSJMP+1,X
 STA STJ+2
STJ JMP $FFFF

CLSJMP DA ENC0
 DA ENC1
 DA ENC2
 DA ENC3
 DA ENC4
 DA ENC5
 DA ENC6
 DA ENC7
 DA ENC8
 DA ENC9
 DA STMX ; EQU (HANDLED ABOVE)
 DA DORG
 DA DDB
 DA DDW
 DA DDS
 DA DEND
 DA STMX ; CPU IGNORED
 DA STMX ; PAGE IGNORED

* REST OF LINE MUST BE EMPTY/COMMENT
STEND JSR ATEND
 BCC STE1
 RTS
STE1 LDX #<EBADOP
 LDY #>EBADOP
 JMP ERRHOOK

* DEFINE LABEL: DEFV=PC OR EQU VAL.
* PASS1 ADDS, PASS2 PHASE-VERIFIES.
DEFPC LDA PCL
 STA DEFVL
 LDA PCH
 STA DEFVH
DEFLBL LDX #12
DFL1 LDA LBLB,X
 STA TOKB,X
 DEX
 BPL DFL1
 LDA PASSNO
 CMP #2
 BEQ DFL2
 JSR SYMFIND
 BCS DFL3
 LDX #<EDUP
 LDY #>EDUP
 JMP ERRHOOK
DFL3 JMP SYMADD
DFL2 JSR SYMFIND
 BCS DFL4
 LDA TVL
 CMP DEFVL
 BNE DFL4
 LDA TVH
 CMP DEFVH
 BNE DFL4
 RTS
DFL4 LDX #<EPHASE
 LDY #>EPHASE
 JMP ERRHOOK

* ---- ENCODERS (CLASS 0-9) ----
ENC0 LDA MNBASE
 JSR EMIT
 JMP STEND
ENC1 JSR GETREG
 CMP #0 ; INR/DCR A = HLT
 BNE ENC1A
 JMP ENCRG
ENC1A JSR R8BASE
 JSR EMIT
 JMP STEND
R8BASE ASL
 ASL
 ASL
 CLC
 ADC MNBASE
 RTS
ENC2 JSR GETREG
 CLC
 ADC MNBASE
 JSR EMIT
 JMP STEND
ENC3 JSR GETREG
 STA REGD
 JSR NCOMMA
 JSR GETREG
 STA REGS2
 CMP #7 ; MOV M,M = HLT
 BNE ENC3A
 LDA REGD
 CMP #7
 BNE ENC3A
 JMP ENCRG
ENC3A LDA REGD
 ASL
 ASL
 ASL
 CLC
 ADC REGS2
 ADC #$C0
 JSR EMIT
 JMP STEND
ENC4 JSR GETREG
 STA REGD
 JSR NCOMMA
 JSR EXPR
 LDA REGD
 JSR R8BASE
 JSR EMIT
 LDA EVL
 JSR EMIT
 JMP STEND
ENC5 JSR EXPR
 LDA MNBASE
 JSR EMIT
 LDA EVL
 JSR EMIT
 JMP STEND
ENC6 JSR EXPR
 LDA MNBASE
 JSR EMIT
 LDA EVL
 JSR EMIT
 LDA EVH
 JSR EMIT
 JMP STEND
ENC7 JSR EXPR
 LDA EVH
 BNE ENCRG
 LDA EVL
 CMP #8
 BCS ENCRG
 JSR R8BASE
 JSR EMIT
 JMP STEND
ENC8 JSR EXPR
 LDA EVH
 BNE ENCRG
 LDA EVL
 CMP #8
 BCS ENCRG
ENC8A ASL
 CLC
 ADC MNBASE
 JSR EMIT
 JMP STEND
ENC9 JSR EXPR
 LDA EVH
 BNE ENCRG
 LDA EVL
 CMP #8
 BCC ENCRG
 CMP #32
 BCS ENCRG
 BCC ENC8A
ENCRG LDX #<ERANGE
 LDY #>ERANGE
 JMP ERRHOOK

* ---- DIRECTIVES ----
DORG JSR NEEDEXPR
 LDA ORGSET
 BNE DOR1
 LDA EVL
 STA ORGL
 LDA EVH
 STA ORGH
 INC ORGSET
 JMP DOR2
DOR1 LDA EVH
 CMP ORGH
 BCC DOR3
 BNE DOR2
 LDA EVL
 CMP ORGL
 BCC DOR3
DOR2 LDA EVL
 STA PCL
 LDA EVH
 STA PCH
 JMP STEND
DOR3 LDX #<EORGBK
 LDY #>EORGBK
 JMP ERRHOOK
DDS JSR NEEDEXPR
 CLC
 LDA PCL
 ADC EVL
 STA PCL
 LDA PCH
 ADC EVH
 STA PCH
 JMP STEND
DEND INC ENDF
 RTS
DDB JSR SKIPSP
 JSR PEEKC
 BCS DBEX
 CMP #$22 ; QUOTE
 BNE DBEX
 INC LINEP
 LDA #0
 STA STRN
DBS1 JSR PEEKC
 BCS DBER ; EOL IN STRING
 INC LINEP
 CMP #$22
 BEQ DBS2
 JSR EMIT
 INC STRN
 JMP DBS1
DBS2 LDA STRN
 BEQ DBER ; EMPTY STRING
 JMP DBNX
DBEX JSR EXPR
 LDA EVL
 JSR EMIT
DBNX JSR COMMA
 BCC DDB
 JMP STEND
DBER LDX #<ESTR
 LDY #>ESTR
 JMP ERRHOOK
DDW JSR EXPR
 LDA EVL
 JSR EMIT
 LDA EVH
 JSR EMIT
 JSR COMMA
 BCC DDW
 JMP STEND

* ---- EXPRESSIONS ----
* FLAT LEFT-TO-RIGHT: + - & | << >>
* PARENS RECURSE. RESULT IN EV.
EXPR JSR TERM
 LDA TVL
 STA EVL
 LDA TVH
 STA EVH
EXLP JSR SKIPSP
 JSR PEEKC
 BCS EXDN
 LDX #0
 CMP #'+'
 BEQ EXOP
 INX
 CMP #'-'
 BEQ EXOP
 INX
 CMP #'&'
 BEQ EXOP
 INX
 CMP #'|'
 BEQ EXOP
 CMP #'<'
 BEQ EXSHL
 CMP #'>'
 BEQ EXSHR
EXDN RTS
EXSHL LDX LINEP
 INX
 CPX LINEL
 BCS EXDN
 LDA LINEB,X
 CMP #'<'
 BNE EXDN
 INC LINEP
 LDX #4
 JMP EXOP
EXSHR LDX LINEP
 INX
 CPX LINEL
 BCS EXDN
 LDA LINEB,X
 CMP #'>'
 BNE EXDN
 INC LINEP
 LDX #5
EXOP INC LINEP
 LDA EVL
 PHA
 LDA EVH
 PHA
 TXA
 PHA
 JSR TERM
 PLA
 STA OPC
 PLA
 STA EVH
 PLA
 STA EVL
 LDA OPC
 BNE EXO1
 CLC ; +
 LDA EVL
 ADC TVL
 STA EVL
 LDA EVH
 ADC TVH
 STA EVH
 JMP EXLP
EXO1 CMP #1
 BNE EXO2
 SEC ; -
 LDA EVL
 SBC TVL
 STA EVL
 LDA EVH
 SBC TVH
 STA EVH
 JMP EXLP
EXO2 CMP #2
 BNE EXO3
 LDA EVL ; &
 AND TVL
 STA EVL
 LDA EVH
 AND TVH
 STA EVH
 JMP EXLP
EXO3 CMP #3
 BNE EXO4
 LDA EVL ; |
 ORA TVL
 STA EVL
 LDA EVH
 ORA TVH
 STA EVH
 JMP EXLP
EXO4 CMP #4
 BNE EXO5
 LDX TVL ; <<
 BEQ EXLPJ
EXSL ASL EVL
 ROL EVH
 DEX
 BNE EXSL
 JMP EXLP
EXO5 LDX TVL ; >>
 BEQ EXLPJ
EXSR LSR EVH
 ROR EVL
 DEX
 BNE EXSR
EXLPJ JMP EXLP

* TERM: NUMBER/CHAR/LABEL/(EXPR)
* RESULT IN TV.
TERM JSR SKIPSP
 JSR PEEKC
 BCC TM0
 LDX #<EMISSV
 LDY #>EMISSV
 JMP ERRHOOK
TM0 CMP #'('
 BNE TM1
 INC LINEP
 JSR EXPR
 JSR SKIPSP
 JSR PEEKC
 BCS TMPE
 CMP #')'
 BNE TMPE
 INC LINEP
 LDA EVL
 STA TVL
 LDA EVH
 STA TVH
 RTS
TMPE LDX #<EPAREN
 LDY #>EPAREN
 JMP ERRHOOK
TM1 CMP #'$'
 BNE TM2
 INC LINEP
 LDA #0
 STA TVL
 STA TVH
 STA HEXN
TMH JSR PEEKC
 BCS TMHE
 JSR HEXV
 BCC TMHE
 INC LINEP
 STA T2L
 ASL TVL
 ROL TVH
 ASL TVL
 ROL TVH
 ASL TVL
 ROL TVH
 ASL TVL
 ROL TVH
 LDA TVL
 ORA T2L
 STA TVL
 INC HEXN
 JMP TMH
TMHE LDA HEXN
 BNE TMRT
 JMP GNBAD
TMRT RTS
TM2 CMP #$27 ; APOSTROPHE
 BNE TM3
 INC LINEP
 JSR PEEKC
 BCS TMCB
 STA TVL
 LDA #0
 STA TVH
 INC LINEP
 JSR PEEKC
 BCS TMCB
 CMP #$27
 BNE TMCB
 INC LINEP
 RTS
TMCB LDX #<ECHR
 LDY #>ECHR
 JMP ERRHOOK
TM3 CMP #'0'
 BCC TM4
 CMP #'9'+1
 BCS TM4
 JMP GETNUM
TM4 JSR GETIDENT
 BCC TM5
 LDX #<EBADOP
 LDY #>EBADOP
 JMP ERRHOOK
TM5 JSR SYMFIND
 BCS TM6
 RTS
TM6 LDA PASSNO
 CMP #1
 BNE TM7
 LDA #1
 STA UNDEF
 LDA #0
 STA TVL
 STA TVH
 RTS
TM7 LDX #<EUNDEF
 LDY #>EUNDEF
 JMP ERRHOOK

* NUMBER RUN: DECIMAL OR NNH HEX
GETNUM LDA #0
 STA TOKB
GN1 JSR PEEKC
 BCS GN2
 JSR IDCH
 BCC GN2
 INC LINEP
 LDX TOKB
 CPX #12
 BCS GN1
 STA TOKB+1,X
 INC TOKB
 JMP GN1
GN2 LDX TOKB
 BNE GN2A
 JMP GNBAD
GN2A LDA TOKB,X
 CMP #'H'
 BEQ GNHEX
 LDA #0
 STA TVL
 STA TVH
 LDX #1 ; Z=0: BNE ALWAYS
 BNE GND
GNBADJ JMP GNBAD
GND LDA TOKB,X
 CMP #'9'+1
 BCS GNBADJ
 CMP #'0'
 BCC GNBADJ
 PHA
 ASL TVL ; TV = TV*10
 ROL TVH
 LDA TVL
 STA T2L
 LDA TVH
 STA T2H
 ASL TVL
 ROL TVH
 ASL TVL
 ROL TVH
 CLC
 LDA TVL
 ADC T2L
 STA TVL
 LDA TVH
 ADC T2H
 STA TVH
 PLA
 SEC
 SBC #'0'
 CLC
 ADC TVL
 STA TVL
 LDA TVH
 ADC #0
 STA TVH
 INX
 CPX TOKB
 BCC GND
 BEQ GND
 RTS
GNHEX DEX ; DROP TRAILING H
 BNE GNH0
 JMP GNBAD
GNH0 STX GNL
 LDA #0
 STA TVL
 STA TVH
 LDX #1
GNH1 LDA TOKB,X
 JSR HEXV
 BCC GNBAD
 STA T2L
 ASL TVL
 ROL TVH
 ASL TVL
 ROL TVH
 ASL TVL
 ROL TVH
 ASL TVL
 ROL TVH
 LDA TVL
 ORA T2L
 STA TVL
 INX
 CPX GNL
 BCC GNH1
 BEQ GNH1
 RTS
GNBAD LDX #<EBADNM
 LDY #>EBADNM
 JMP ERRHOOK

* EXPR THAT MUST RESOLVE IN PASS 1
NEEDEXPR LDA #0
 STA UNDEF
 JSR EXPR
 LDA UNDEF
 BEQ NEX1
 LDX #<EFWD
 LDY #>EFWD
 JMP ERRHOOK
NEX1 RTS

* ---- LINE CURSOR HELPERS ----
* PEEKC: A=CHAR, C=1 AT EOL
PEEKC LDX LINEP
 CPX LINEL
 BCS PKEOL
 LDA LINEB,X
 CLC
 RTS
PKEOL LDA #0
 SEC
 RTS
SKIPSP JSR PEEKC
 BCS SKSD
 CMP #' '
 BNE SKSD
 INC LINEP
 JMP SKIPSP
SKSD RTS
* ATEND: C=1 IF ONLY EOL/COMMENT
ATEND JSR SKIPSP
 JSR PEEKC
 BCS ATE1
 CMP #';'
 BEQ ATE1
 CLC
 RTS
ATE1 SEC
 RTS
COMMA JSR SKIPSP
 JSR PEEKC
 BCS CMN
 CMP #$2C ; COMMA
 BNE CMN
 INC LINEP
 CLC
 RTS
CMN SEC
 RTS
NCOMMA JSR COMMA
 BCC NCM1
 LDX #<ENEEDC
 LDY #>ENEEDC
 JMP ERRHOOK
NCM1 RTS

* IDENT -> TOKB (LEN + 12 PADDED)
GETIDENT JSR PEEKC
 BCS GINO
 JSR ALCH
 BCS GI0
GINO SEC
 RTS
GI0 LDA #' '
 LDX #12
GIC STA TOKB,X
 DEX
 BNE GIC
 STX TOKB
GI1 JSR PEEKC
 BCS GIDN
 JSR IDCH
 BCC GIDN
 INC LINEP
 LDX TOKB
 CPX #12
 BCS GI1 ; KEEP FIRST 12
 STA TOKB+1,X
 INC TOKB
 JMP GI1
GIDN CLC
 RTS
* IDCH: C=1 IF A IN 0-9 A-Z _
IDCH CMP #'_'
 BEQ IDY
 CMP #'0'
 BCC IDN
 CMP #'9'+1
 BCC IDY
* ALCH: C=1 IF A IN A-Z _
ALCH CMP #'_'
 BEQ IDY
 CMP #'A'
 BCC IDN
 CMP #'Z'+1
 BCC IDY
IDN CLC
 RTS
IDY SEC
 RTS
* HEXV: A=CHAR -> C=1 A=VALUE
HEXV CMP #'0'
 BCC HXN
 CMP #'9'+1
 BCS HX1
 SEC
 SBC #'0'
 RTS
HX1 CMP #'A'
 BCC HXN
 CMP #'F'+1
 BCS HXN
 SEC
 SBC #'A'-10
 RTS
HXN CLC
 RTS

* REGISTER A B C D E H L M -> 0-7
GETREG JSR SKIPSP
 JSR PEEKC
 BCS GRBAD
 LDX #7
GRL CMP REGSTR,X
 BEQ GRF
 DEX
 BPL GRL
GRBAD LDX #<EBADRG
 LDY #>EBADRG
 JMP ERRHOOK
GRF STX REGT
 INC LINEP
 JSR PEEKC
 BCS GROK
 JSR IDCH
 BCS GRBAD
GROK LDA REGT
 RTS
REGSTR ASC 'ABCDEHLM'

* ---- MNEMONIC TABLE LOOKUP ----
* SCANS DIRTAB THEN ASM8TAB (ONE
* CONTIGUOUS 6-BYTE-ENTRY REGION)
MNFIND LDA #<DIRTAB
 STA MF1+1
 LDA #>DIRTAB
 STA MF1+2
MFLP LDY #0
 JSR MF1RD
 BEQ MFNO ; TABLE END
MFC JSR MF1RD
 CMP TOKB+1,Y
 BNE MFNX
 INY
 CPY #4
 BCC MFC
 LDY #4
 JSR MF1RD
 STA MNCLS
 LDY #5
 JSR MF1RD
 STA MNBASE
 CLC
 RTS
MFNX LDA MF1+1
 CLC
 ADC #6
 STA MF1+1
 LDA MF1+2
 ADC #0
 STA MF1+2
 JMP MFLP
MFNO SEC
 RTS
MF1RD
MF1 LDA $FFFF,Y
 RTS

* ---- SYMBOL TABLE ----
* 14B ENTRY: 12 NAME + 16-BIT VALUE
* FIND TOKB: C=0 FOUND, VAL IN TV
SYMFIND LDA #<SYMTAB
 STA SF1+1
 LDA #>SYMTAB
 STA SF1+2
SFLP LDA SF1+1
 CMP SYMCL
 BNE SFCK
 LDA SF1+2
 CMP SYMCH
 BNE SFCK
 SEC
 RTS
SFCK LDY #0
SFC1 JSR SF1RD
 CMP TOKB+1,Y
 BNE SFNX
 INY
 CPY #12
 BCC SFC1
 LDY #12
 JSR SF1RD
 STA TVL
 LDY #13
 JSR SF1RD
 STA TVH
 CLC
 RTS
SFNX LDA SF1+1
 CLC
 ADC #14
 STA SF1+1
 LDA SF1+2
 ADC #0
 STA SF1+2
 JMP SFLP
SF1RD
SF1 LDA $FFFF,Y
 RTS
* ADD TOKB=DEFV AT SYMCUR
SYMADD LDA SYMCL
 STA SA1+1
 LDA SYMCH
 STA SA1+2
 LDY #0
SAL LDA TOKB+1,Y
SA1 STA $FFFF,Y
 INY
 CPY #14
 BCC SAL
 LDA SYMCL
 CLC
 ADC #14
 STA SYMCL
 LDA SYMCH
 ADC #0
 STA SYMCH
 CMP #>SYMFUL
 BCC SAOK
 BNE SAFULL
 LDA SYMCL
 CMP #<SYMFUL
 BCC SAOK
SAFULL LDX #<ESYMF
 LDY #>ESYMF
 JMP ERRHOOK
SAOK RTS

* ---- EMIT ONE OBJECT BYTE ----
* PASS2 CALLS OSTORE WITH OFFSET
* IN OFL/OFH, BYTE IN EMB. BOTH
* PASSES ADVANCE PC.
EMIT STA EMB
 LDA ORGSET
 BNE EMI0
 LDX #<ENOORG
 LDY #>ENOORG
 JMP ERRHOOK
EMI0 LDA PASSNO
 CMP #2
 BNE EMADV
 SEC
 LDA PCL
 SBC ORGL
 STA OFL
 LDA PCH
 SBC ORGH
 STA OFH
 CMP #OUTMAX
 BCS EMOVF
 JSR OSTORE
* OEND = MAX(OEND,OFF+1)
 LDA OFL
 CLC
 ADC #1
 STA T2L
 LDA OFH
 ADC #0
 STA T2H
 CMP OENDH
 BCC EMADV
 BNE EMUP
 LDA T2L
 CMP OENDL
 BCC EMADV
EMUP LDA T2L
 STA OENDL
 LDA T2H
 STA OENDH
EMADV INC PCL
 BNE EMDN
 INC PCH
EMDN RTS
EMOVF LDX #<EOVFL
 LDY #>EOVFL
 JMP ERRHOOK

* ---- ERROR MESSAGES ----
EBADLB ASC 'BAD LABEL'
 DFB 0
EBADMN ASC 'BAD MNEMONIC'
 DFB 0
EBADOP ASC 'BAD OPERAND'
 DFB 0
EBADRG ASC 'BAD REGISTER'
 DFB 0
EBADNM ASC 'BAD NUMBER'
 DFB 0
EUNDEF ASC 'UNDEFINED SYMBOL'
 DFB 0
EDUP ASC 'DUPLICATE LABEL'
 DFB 0
EFWD ASC 'FWD REF IN DIRECTIVE'
 DFB 0
ENOORG ASC 'CODE BEFORE ORG'
 DFB 0
EORGBK ASC 'ORG BACKWARD'
 DFB 0
EOVFL ASC 'OUTPUT OVER 12K'
 DFB 0
ESTR ASC 'BAD STRING'
 DFB 0
ELONG ASC 'LINE OVER 127'
 DFB 0
EPHASE ASC 'PHASE ERROR'
 DFB 0
ERANGE ASC 'VALUE OUT OF RANGE'
 DFB 0
ENEEDC ASC 'MISSING COMMA'
 DFB 0
EPAREN ASC 'MISSING )'
 DFB 0
ECHR ASC 'BAD CHAR LITERAL'
 DFB 0
ESYMF ASC 'SYMBOL TABLE FULL'
 DFB 0
EEQUL ASC 'EQU NEEDS LABEL'
 DFB 0
EMISSV ASC 'MISSING VALUE'
 DFB 0

* DIRECTIVE TABLE: SAME SHAPE AS
* ASM8TAB, SCANNED AS ONE REGION.
* CLASSES 10-17 = DIRECTIVES.
* MUST BE LAST IN THIS FILE - THE
* DRIVER PUTS ASM8TAB RIGHT AFTER.
DIRTAB ASC 'EQU '
 DFB 10,0
 ASC 'ORG '
 DFB 11,0
 ASC 'DB  '
 DFB 12,0
 ASC 'DW  '
 DFB 13,0
 ASC 'DS  '
 DFB 14,0
 ASC 'END '
 DFB 15,0
 ASC 'CPU '
 DFB 16,0
 ASC 'PAGE'
 DFB 17,0
