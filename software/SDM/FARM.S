* FARM.S - FARM/MARKET GAME, //e HOST SIDE
* ORG $2000. BRUN FARM. (relocated from $6000:
* game is lo-res/text only, never uses hi-res
* pages $2000-$5FFF - verified free on bench -
* so ORG $2000 reclaims them: ceiling ~$9600
* gives ~30 KB program space vs ~13.8 KB).
* GR MIXED MODE: 20x20 PLOTS AS 2x2 LO-RES
* BLOCKS (ROWS 0-39), HUD TEXT ROWS 20-23.
* COPROC GAMETASK (SKILL 2) IS WORLD AUTHORITY.
* ZOMBIE-SLOT CAVEAT (ACCEPTED V1): COLD START
* OVER A SLOW-BUT-ALIVE GAMETASK LEAKS ITS
* CP SLOT (4 LEAKS -> CP_CALL $FF -> MSGDEAD)
* AND RELOADS $2000 UNDER IT. 3S PROBE MAKES
* THIS REMOTE.
 TYP $06
 DSK FARM.bin
 ORG $2000

 JMP MAIN
 PUT FARMEQU
 PUT SDRAMLIB
 PUT CPLIB
 PUT NPCBASE

* --- SOFT SWITCHES ---
S80VOFF = $C00C
DHIROFF = $C05F
S80SOFF = $C000
PAGE2OF = $C054
GRAPH = $C050
LORES = $C056
MIXED = $C053
TEXTSW = $C051
KBD = $C000
KBDSTR = $C010

* --- ZP (NON-PRODOS TRANSIENT) ---
LINEP = $06
SHADP = $08
MSGPTR = $0A
SRC = $0C

* --- STATE ---
TAIL DS 1
EXPSEQ DS 1
CURX DS 1
CURY DS 1
CASHL DS 1
CASHH DS 1
SEED4 DS 4
CROP4 DS 4
PRICE4 DS 4
LASTP4 DS 4
SELCROP DS 1
SCREEN DS 1
HCROP DS 1
RESCNT DS 1
TMO DS 2
T16 DS 2
NTMP DS 1
GRLO DS 24
GRHI DS 24
SHADOW DS 800
RSTRCT DS 2
PRCOL DS 1
CNT DS 2
EVT DS 1
EVA DS 1
EVB DS 1
PLOTC DS 1
PLOTCR DS 1
DCCROP DS 1
DCSTG DS 1
RSCROP DS 1
RSSTAGE DS 1
DECV DS 5
DAX DS 1
DAY DS 1
SHADV DS 1
OLDCROP DS 1
TAIL2 DS 1
EXPSEQ2 DS 1
WSKILLV DS 1
WDISCV DS 8
MIXBUF DS 4
MIXN DS 1
STREC DS 8
WRES1V DS 1
CMDOP2 DS 1
CMDA02 DS 1
CMDA12 DS 1
CMDA22 DS 1
CMDA32 DS 1
RECLO2 DS 1
RSEQ2 DS 1
RSTWT DS 2
SHOPIDX DS 1
WGOODS DS 12
PREVSCR DS 1
INVPAGE DS 1
INVCUR DS 1
INVOFF DS 1
INVSELL DS 1
NIDX DS 1
NPI DS 1
NCI DS 1
NEEDW DS 1
NEEDC DS 1
NEEDB DS 1
NEEDP DS 1
TRNPC DS 1
TRCUR DS 1
TRTYP DS 1
TRIDX DS 1
TRNI DS 1
TRADL DS 1
TRPRV DS 1
TRHAV DS 1
TRROWN DS 1
QPMODE DS 1
TRADEOP DS 1
TRADETYP DS 1
TRADENPC DS 1
TRADEITEM DS 1
TRPC DS 16
TRKDRT DS 1
* === GRON: UNDO ALL, LO-RES MIXED ===
GRON
 STA S80VOFF
 STA DHIROFF
 STA S80SOFF
 STA PAGE2OF
 STA GRAPH
 STA LORES
 STA MIXED
 RTS

* === GRINIT: BUILD 24-ENTRY TEXT-LINE TABLE ===
* TEXTBASE(Y) = $400 + (Y&7)*$80 + (Y>>3)*$28
GRINIT
 LDX #0
GILP
 TXA
 AND #7
 STA NTMP
 LSR
 CLC
 ADC #4
 STA GRHI,X
 LDA NTMP
 AND #1
 BEQ GILO0
 LDA #$80
 JMP GISETL
GILO0
 LDA #0
GISETL
 STA GRLO,X
 TXA
 LSR
 LSR
 LSR
 TAY
 BEQ GIDONE
GIADD
 LDA GRLO,X
 CLC
 ADC #$28
 STA GRLO,X
 DEY
 BNE GIADD
GIDONE
 INX
 CPX #24
 BNE GILP
 RTS

* === GRCLR: clear GR rows 0-19 (40 bytes each),
* space-fill text rows 20-23. line table only -
* NEVER blanket $400-$7FF (screen holes).
GRCLR
 LDX #0
GCROW
 LDA GRLO,X
 STA LINEP
 LDA GRHI,X
 STA LINEP+1
 CPX #20
 BCS GCTXT
 LDA #0
 JMP GCFILL
GCTXT
 LDA #$A0
GCFILL
 LDY #0
GCCOL
 STA (LINEP),Y
 INY
 CPY #40
 BNE GCCOL
 INX
 CPX #24
 BNE GCROW
 RTS

* === CLRMSG: row 21 all 40 cols ===
CLRMSG
 LDX #21
 LDA GRLO,X
 STA LINEP
 LDA GRHI,X
 STA LINEP+1
 LDA #$A0
 LDY #0
CMLP
 STA (LINEP),Y
 INY
 CPY #40
 BNE CMLP
 RTS

* === CLRROW20: row 20 cols 0-28 ===
* (CASH owns cols 29-39 - never wipe it)
CLRROW20
 LDX #20
 LDA GRLO,X
 STA LINEP
 LDA GRHI,X
 STA LINEP+1
 LDA #$A0
 LDY #0
CR20LP
 STA (LINEP),Y
 INY
 CPY #29
 BNE CR20LP
 RTS

* crop ripe colors: wheat carrot berry pumpkn
CROPC DFB $0D,$09,$03,$0C

* === PLOTDRAW: X=px Y=py A=stage PLOTCR=crop ->
* crop color from stg1; growth fill; checker
* stg0: blk; 1-5: fill; 6(STRIPE): chk; 7: dead
PLOTDRAW
 STX PLOTC
 STA NTMP
* crop color from PLOTCR -> T16+1
 LDA PLOTCR
 AND #3
 TAX
 LDA CROPC,X
 STA T16+1
* stage dispatch (A was stage on entry, in NTMP)
 LDA NTMP
 AND #7
 BEQ PDST0
 CMP #STRIPE
 BEQ PDST6
 CMP #7
 BNE PDGROW
 JMP PDST7
PDGROW
* stages 1-5: precompute color*$11 -> T16
 STA NTMP
 LDA T16+1
 ASL
 ASL
 ASL
 ASL
 ORA T16+1
 STA T16
 LDA NTMP
 CMP #1
 BEQ PDST1
 CMP #2
 BEQ PDST2
 CMP #3
 BEQ PDST3
 CMP #4
 BEQ PDST4
* stage 5: solid crop both cells
 LDA T16
 STA NTMP
 LDA T16
 JMP PDGO
PDST0
 LDA #0
 STA NTMP
 LDA #0
 JMP PDGO
PDST1
* tilled soil: full gray block (bounds)
 LDA #$55
 STA NTMP
 LDA #$55
 JMP PDGO
PDST2
* bottom-left crop, rest soil
 LDA T16
 AND #$F0
 ORA #$05
 STA NTMP
 LDA #$55
 JMP PDGO
PDST3
* bottom row crop, top soil
 LDA T16
 AND #$F0
 ORA #$05
 STA NTMP
 JMP PDGO
PDST4
* left col full, right bottom crop
 LDA T16
 STA NTMP
 LDA T16
 AND #$F0
 ORA #$05
 JMP PDGO
PDST6
* ripe: cell0=color|$F0, cell1=$0F|color<<4
 LDA T16+1
 ORA #$F0
 STA NTMP
 LDA T16+1
 ASL
 ASL
 ASL
 ASL
 ORA #$0F
 JMP PDGO
PDST7
* dead: magenta $1 solid
 LDA #$11
 STA NTMP
 LDA #$11
PDGO
* A=cell1, NTMP=cell0, Y=py from entry
 STA T16
 LDA GRLO,Y
 STA LINEP
 LDA GRHI,Y
 STA LINEP+1
 LDA PLOTC
 ASL
 TAY
 LDA NTMP
 STA (LINEP),Y
 INY
 LDA T16
 STA (LINEP),Y
 RTS

* === CURSDRAW: XOR $FF both bytes CURX,CURY ===
CURSDRAW
 LDY CURY
 LDA GRLO,Y
 STA LINEP
 LDA GRHI,Y
 STA LINEP+1
 LDA CURX
 ASL
 TAY
 LDA (LINEP),Y
 EOR #$FF
 STA (LINEP),Y
 INY
 LDA (LINEP),Y
 EOR #$FF
 STA (LINEP),Y
 RTS

* === PRSTR: 0-term hi-ASCII string (MSGPTR)
* to text row Y at column PRCOL ===
PRSTR
 LDA GRLO,Y
 STA LINEP
 LDA GRHI,Y
 STA LINEP+1
 LDA LINEP
 CLC
 ADC PRCOL
 STA LINEP
 LDA LINEP+1
 ADC #0
 STA LINEP+1
 LDY #0
PRLP
 LDA (MSGPTR),Y
 BEQ PRDONE
 STA (LINEP),Y
 INY
 JMP PRLP
PRDONE
 RTS

* === DIGITS: T16 -> DECV[0..4] ===
DIGITS
 LDX #0
PDLP
 LDA #0
 STA DECV,X
PDSUB
 LDA T16
 SEC
 SBC DECTL,X
 PHA
 LDA T16+1
 SBC DECTH,X
 BCC PDNXT
 STA T16+1
 PLA
 STA T16
 INC DECV,X
 JMP PDSUB
PDNXT
 PLA
 INX
 CPX #5
 BNE PDLP
 RTS

* === PRDEC: 16-bit T16 -> 5 digits at
* (X=col, Y=textrow) ===
PRDEC
 TYA
 PHA
 TXA
 PHA
 JSR DIGITS
 PLA
 TAX
 PLA
 TAY
 LDA GRLO,Y
 STA LINEP
 LDA GRHI,Y
 STA LINEP+1
 TXA
 TAY
 LDX #0
PDPRT
 LDA DECV,X
 ORA #$B0
 STA (LINEP),Y
 INY
 INX
 CPX #5
 BNE PDPRT
 RTS

* === PRDEC3: 8-bit T16 -> 3 digits at
* (X=col, Y=textrow); prints DECV[2..4] ===
PRDEC3
 TYA
 PHA
 TXA
 PHA
 JSR DIGITS
 PLA
 TAX
 PLA
 TAY
 LDA GRLO,Y
 STA LINEP
 LDA GRHI,Y
 STA LINEP+1
 TXA
 TAY
 LDX #2
PD3PRT
 LDA DECV,X
 ORA #$B0
 STA (LINEP),Y
 INY
 INX
 CPX #5
 BNE PD3PRT
 RTS

DECTL
 DFB $10,$E8,$64,$0A,$01
DECTH
 DFB $27,$03,$00,$00,$00

* === HUDDRAW: row 20 seed+cash ===
* row 20 cols 0-28: SEED <name> <count>
* row 20 cols 29+: CASH label + value
HUDDRAW
* clear row 20 cols 0-28 first
 JSR CLRROW20
* SEED label col 0
 LDA #<SSEED
 STA MSGPTR
 LDA #>SSEED
 STA MSGPTR+1
 LDA #0
 STA PRCOL
 LDY #20
 JSR PRSTR
* crop name col 5
 LDX SELCROP
 LDA SNAML,X
 STA MSGPTR
 LDA SNAMH,X
 STA MSGPTR+1
 LDA #5
 STA PRCOL
 LDY #20
 JSR PRSTR
* seed count col 12 (3 digits, max 255)
 LDX SELCROP
 LDA SEED4,X
 STA T16
 LDA #0
 STA T16+1
 LDX #12
 LDY #20
 JSR PRDEC3
* row 20 cols 23-26: workshop widget W:xx
* x per station: . idle, * cooking, ! done
 LDY #20
 LDA GRLO,Y
 STA LINEP
 LDA GRHI,Y
 STA LINEP+1
 LDA #$D7 ; 'W'
 LDY #23
 STA (LINEP),Y
 LDA #$BA ; ':'
 LDY #24
 STA (LINEP),Y
* station 0 glyph col 25
 LDX #0
 JSR WGGLYPH
 LDY #25
 STA (LINEP),Y
* station 1 glyph col 26
 LDX #4
 JSR WGGLYPH
 LDY #26
 STA (LINEP),Y
* CASH label col 29, value col 34
* (HUDCASH: cash-only entry - workshop row
* 20 shows cash without the farm SEED block)
HUDCASH
 LDA #<SCASH
 STA MSGPTR
 LDA #>SCASH
 STA MSGPTR+1
 LDA #29
 STA PRCOL
 LDY #20
 JSR PRSTR
 LDA CASHL
 STA T16
 LDA CASHH
 STA T16+1
 LDX #34
 LDY #20
 JSR PRDEC
 RTS

* === WGGLYPH: X=STREC offset -> A glyph
* 0=idle '.', 1=cooking '*', 2=done '!'
WGGLYPH
 LDA STREC,X
 CMP #1
 BEQ WGGCK
 CMP #2
 BEQ WGGDN
 LDA #$AE ; '.'
 RTS
WGGCK
 LDA #$AA ; '*'
 RTS
WGGDN
 LDA #$A1 ; '!'
 RTS

* --- STRINGS (HI-ASCII, 0-TERM) ---
SCASH ASC "CASH "
 DFB 0
SSEED ASC "SEED  "
 DFB 0
SYIELD ASC "YIELD "
 DFB 0
* key letters inverse ($00-$1F = inverse
* uppercase, none collide with 0 terminator)
SHELP DFB $10
 ASC "LANT "
 DFB $08
 ASC "ARVEST "
 DFB $0D
 ASC "ARKET "
 DFB $11
 ASC "UIT "
 ASC "1-4 SEED"
 DFB 0
SMKT ASC "MARKET"
 DFB 0
SMHDR ASC "NAME    COST PRICE SEED CROP"
 DFB 0
SMHINT ASC "1-4 PICK CROP, B BUY, S SELL"
 DFB 0
* MUST MATCH SEEDC IN FARMTASK.S
SEEDCT DFB 2,4,7,12
SMHELP DFB $02
 ASC "UY "
 DFB $13
 ASC "ELL "
 DFB $12
 ASC "ECIPE 1-4 ESC"
 DFB 0
SDEAD ASC "DEAD-C COLDSTART/CTRL-RESET"
 DFB 0
SNORESP ASC "COPROC NOT RESPONDING"
 DFB 0
SRIPE ASC "RIPE!"
 DFB 0
SOK ASC "OK"
 DFB 0
SLOST ASC "CROP DIED!"
 DFB 0
SERR ASC "ERR "
 DFB 0
SQTYS ASC "SELL QTY:"
 DFB 0
SQTYB ASC "BUY QTY:"
 DFB 0
* crop name strings + address tables
SNAMW ASC "WHEAT"
 DFB 0
SNAMC ASC "CARROT"
 DFB 0
SNAMB ASC "BERRY"
 DFB 0
SNAMP ASC "PUMPKN"
 DFB 0
SNAML DFB <SNAMW,<SNAMC,<SNAMB,<SNAMP
SNAMH DFB >SNAMW,>SNAMC,>SNAMB,>SNAMP
SQTYWD ASC "DEP QTY:"
 DFB 0
SDEPC ASC "DEP 1-4? (CROP)"
 DFB 0
SWKSHP ASC "WORKSHOP"
 DFB 0
SSKILL ASC "SKILL"
 DFB 0
SPANT ASC "CROPS  W"
 DFB 0
SCLETC ASC "C"
 DFB 0
SCLETB ASC "B"
 DFB 0
SCLETP ASC "P"
 DFB 0
SSTA1 ASC "1"
 DFB 0
SSTA2 ASC "2"
 DFB 0
SIDLE ASC "IDLE"
 DFB 0
SCOOKIN ASC "COOKING"
 DFB 0
SDONE ASC "DONE"
 DFB 0
SPRESSC ASC " PRESS C"
 DFB 0
SMIX ASC "MIX:"
 DFB 0
SUNKNOWN ASC "?????"
 DFB 0
SWKLEG ASC "1-4 MIX RTN CRAFT I INV ESC"
 DFB 0
SCOOKING ASC "COOKING..."
 DFB 0
SRUINED ASC "RUINED!"
 DFB 0
SNEEDS ASC "NEED CROPS"
 DFB 0
SFULL ASC "STATIONS FULL"
 DFB 0
SRECIPE ASC "RECIPE "
 DFB 0
SBUYP ASC "BUY "
 DFB 0
SNEEDC ASC "NEED CASH"
 DFB 0
SBADOP ASC "OP FAIL - CTRL-RESET"
 DFB 0
SLERR ASC "LEARN ERR "
 DFB 0
SALLOWN ASC "RECIPES: ALL OWNED"
 DFB 0
SLEARN ASC "LEARNED "
 DFB 0
SCFAIL ASC "CRAFT FAILED"
 DFB 0
SNOTDONE ASC "NOT DONE"
 DFB 0
SCRAFTD ASC "CRAFT DONE!"
 DFB 0
SCOLLPT ASC "COLLECT 1 OR 2:"
 DFB 0
SSOLD ASC "SOLD "
 DFB 0
SBOUGHT ASC "BOUGHT"
 DFB 0
SPLUS ASC " +"
 DFB 0
SRESP2 ASC "TASKS RESPAWNED"
 DFB 0
VROWS = 16
SINVT ASC "INVENTORY"
 DFB 0
SPSEED ASC "SEEDS"
 DFB 0
SPCROP ASC "CROPS"
 DFB 0
SPGOOD ASC "GOODS"
 DFB 0
SINVLEG ASC "UP/DN TAB-PAGE S-SELL ESC"
 DFB 0
* crop letters for workshop: W C B P
CROPLETS DFB $D7,$C3,$C2,$D0

* === FRD: read GBANK, A=lo Y=hi -> SDM_VAL ===
FRD
 STA SDM_ADDR
 STY SDM_ADDR+1
 LDA #GBANK
 STA SDM_BANK
 LDA #0
 STA SDM_BANK+1
 JSR SDM_READ
 RTS

* === FWR: write SDM_VAL to GBANK, A=lo Y=hi ===
FWR
 STA SDM_ADDR
 STY SDM_ADDR+1
 LDA #GBANK
 STA SDM_BANK
 LDA #0
 STA SDM_BANK+1
 JSR SDM_WRITE
 RTS

* === WFRD: read WBANK, A=lo Y=hi -> SDM_VAL ===
WFRD
 STA SDM_ADDR
 STY SDM_ADDR+1
 LDA #WBANK
 STA SDM_BANK
 LDA #0
 STA SDM_BANK+1
 JSR SDM_READ
 RTS

* === WFWR: write SDM_VAL to WBANK, A=lo Y=hi ===
WFWR
 STA SDM_ADDR
 STY SDM_ADDR+1
 LDA #WBANK
 STA SDM_BANK
 LDA #0
 STA SDM_BANK+1
 JSR SDM_WRITE
 RTS

* === SENDCMD: TOP/TA0/TA1/TA2 staged by caller
* in CMDOP/CMDA0/CMDA1/CMDA2. RETURNS A=RESULT,
* C=1 TIMEOUT. PRE: WAIT FLAG=0 (POST-TIMEOUT
* OWNERSHIP RULE). TIMEOUT = $0000 WRAP OF
* 16-BIT COUNTER OF FLAG POLLS (~1-3S).
CMDOP DS 1
CMDA0 DS 1
CMDA1 DS 1
CMDA2 DS 1
ERRCODE DS 1
QVAL DS 1
QDIG DS 1
QPCROP DS 1
SENDCMD
* never write while FLAG=1
 LDA #0
 STA TMO
 STA TMO+1
SCWAIT0
 LDA #<FMFLAG
 LDY #>FMFLAG
 JSR FRD
 LDA SDM_VAL
 BEQ SCWRITE
 INC TMO
 BNE SCWAIT0
 INC TMO+1
 BNE SCWAIT0
 SEC
 RTS
SCWRITE
 LDA CMDOP
 STA SDM_VAL
 LDA #<FMOP
 LDY #>FMOP
 JSR FWR
 LDA CMDA0
 STA SDM_VAL
 LDA #<FMA0
 LDY #>FMA0
 JSR FWR
 LDA CMDA1
 STA SDM_VAL
 LDA #<FMA1
 LDY #>FMA1
 JSR FWR
 LDA CMDA2
 STA SDM_VAL
 LDA #<FMA2
 LDY #>FMA2
 JSR FWR
 LDA #1
 STA SDM_VAL
 LDA #<FMFLAG
 LDY #>FMFLAG
 JSR FWR
* poll clear
 LDA #0
 STA TMO
 STA TMO+1
SCPOLL
 LDA #<FMFLAG
 LDY #>FMFLAG
 JSR FRD
 LDA SDM_VAL
 BEQ SCRES
 INC TMO
 BNE SCPOLL
 INC TMO+1
 BNE SCPOLL
 SEC
 RTS
SCRES
 LDA #<FMRES
 LDY #>FMRES
 JSR FRD
 LDA SDM_VAL
 CLC
 RTS

* === WSENDCMD: workshop mailbox cmd ===
* CMDOP2/CMDA02-32 staged by caller.
* Returns A=result WRES1V=RES1 C=1 timeout.
WSENDCMD
 LDA #0
 STA TMO
 STA TMO+1
WSCWT
 LDA #<WBFLAG
 LDY #>WBFLAG
 JSR WFRD
 LDA SDM_VAL
 BEQ WSCWR
 INC TMO
 BNE WSCWT
 INC TMO+1
 BNE WSCWT
 SEC
 RTS
WSCWR
 LDA CMDOP2
 STA SDM_VAL
 LDA #<WBOP
 LDY #>WBOP
 JSR WFWR
 LDA CMDA02
 STA SDM_VAL
 LDA #<WBI0
 LDY #>WBI0
 JSR WFWR
 LDA CMDA12
 STA SDM_VAL
 LDA #<WBI1
 LDY #>WBI1
 JSR WFWR
 LDA CMDA22
 STA SDM_VAL
 LDA #<WBI2
 LDY #>WBI2
 JSR WFWR
 LDA CMDA32
 STA SDM_VAL
 LDA #<WBI3
 LDY #>WBI3
 JSR WFWR
 LDA #1
 STA SDM_VAL
 LDA #<WBFLAG
 LDY #>WBFLAG
 JSR WFWR
 LDA #0
 STA TMO
 STA TMO+1
WSCPL
 LDA #<WBFLAG
 LDY #>WBFLAG
 JSR WFRD
 LDA SDM_VAL
 BEQ WSCRES
 INC TMO
 BNE WSCPL
 INC TMO+1
 BNE WSCPL
 SEC
 RTS
WSCRES
 LDA #<WBRES
 LDY #>WBRES
 JSR WFRD
 LDA SDM_VAL
 PHA
 LDA #<WBRES1
 LDY #>WBRES1
 JSR WFRD
 LDA SDM_VAL
 STA WRES1V
 PLA
 CLC
 RTS

* === RDMKT: refresh CASH/PRICE4/SEED4/CROP4
* cash tear-guard: re-read both bytes ===
RDMKT
RMAGN
 LDA #<FCASHL
 LDY #>FCASHL
 JSR FRD
 LDA SDM_VAL
 STA CASHL
 LDA #<FCASHH
 LDY #>FCASHH
 JSR FRD
 LDA SDM_VAL
 STA CASHH
 LDA #<FCASHL
 LDY #>FCASHL
 JSR FRD
 LDA SDM_VAL
 CMP CASHL
 BNE RMAGN
 LDA #<FCASHH
 LDY #>FCASHH
 JSR FRD
 LDA SDM_VAL
 CMP CASHH
 BNE RMAGN
* read 4 prices: FMKT+crop*3 (c*3=c+c*2)
 LDX #0
RMPRC
 TXA
 STA NTMP
 ASL
 CLC
 ADC NTMP
 CLC
 ADC #<FMKT
 LDY #>FMKT
 JSR FRD
 LDA SDM_VAL
 STA PRICE4,X
 INX
 CPX #4
 BNE RMPRC
* read 4 seed counts
 LDX #0
RMSEED
 TXA
 CLC
 ADC #<FSEEDS
 LDY #>FSEEDS
 JSR FRD
 LDA SDM_VAL
 STA SEED4,X
 INX
 CPX #4
 BNE RMSEED
* read 4 crop counts
 LDX #0
RMCROP
 TXA
 CLC
 ADC #<FCROPS
 LDY #>FCROPS
 JSR FRD
 LDA SDM_VAL
 STA CROP4,X
 INX
 CPX #4
 BNE RMCROP
* sync LASTP4 on full resync
 LDX #0
RMLP4
 LDA PRICE4,X
 STA LASTP4,X
 INX
 CPX #4
 BNE RMLP4
 RTS

* === DRAIN: consume ring TAIL..HEAD ===
RECLO DS 1
RSEQ DS 1
DRAIN
 LDA #<FHEAD
 LDY #>FHEAD
 JSR FRD
 LDA SDM_VAL
 CMP TAIL
 BEQ DRDONE
* record lo = TAIL*4, hi = >FRING (ring is
* page-aligned at $0100 - no carry ever)
 LDA TAIL
 ASL
 ASL
 STA RECLO
 LDY #>FRING
 LDA RECLO
 JSR FRD
 LDA SDM_VAL
 STA RSEQ
 LDA RECLO
 CLC
 ADC #1
 LDY #>FRING
 JSR FRD
 LDA SDM_VAL
 STA EVT
 LDA RECLO
 CLC
 ADC #2
 LDY #>FRING
 JSR FRD
 LDA SDM_VAL
 STA EVA
 LDA RECLO
 CLC
 ADC #3
 LDY #>FRING
 JSR FRD
 LDA SDM_VAL
 STA EVB
* seqlock tear guard: re-read SEQ byte
 LDA RECLO
 LDY #>FRING
 JSR FRD
 LDA SDM_VAL
 CMP RSEQ
 BNE DRLAP
 LDA RSEQ
 CMP EXPSEQ
 BNE DRLAP
 JSR EVDISP
 INC EXPSEQ
 LDA TAIL
 CLC
 ADC #1
 AND #$3F
 STA TAIL
 JMP DRAIN
DRLAP
 JSR RESYNC
DRDONE
 RTS

* === EVDISP: dispatch EVT/EVA/EVB ===
EVDISP
 LDA EVT
 CMP #EVRIPE
 BNE EVD2
* set stage (byte1) ripe, preserve flags
 JSR SHADGET1
 AND #$F0 ; keep flags(hi nib), clear stage
 ORA #STRIPE
 STA SHADV
 JSR SHADSET1
* skip screen paint while in text mode
 LDA SCREEN
 BNE EVRMSG
* paint on GR screen: crop=byte0, stage=SHADV
 JSR SHADGET
 STA PLOTCR
 LDA SHADV
 LDX EVA
 LDY EVB
 JSR PLOTDRAW
* ripe plot under cursor? re-apply XOR
 LDA EVA
 CMP CURX
 BNE EVRMSG
 LDA EVB
 CMP CURY
 BNE EVRMSG
 JSR CURSDRAW
EVRMSG
 LDA SCREEN
 CMP #3
 BEQ EVDONE
 JSR CLRMSG
 LDA #<SRIPE
 STA MSGPTR
 LDA #>SRIPE
 STA MSGPTR+1
 LDA #0
 STA PRCOL
 LDY #21
 JSR PRSTR
 RTS
EVD2
 CMP #EVPRICE
 BNE EVDONE
 LDX EVA
 LDA PRICE4,X
 STA LASTP4,X
 LDA EVB
 STA PRICE4,X
 LDA SCREEN
 CMP #1
 BNE EVDONE
 LDX EVA
 STX NTMP
 JSR MKDRAWROW
EVDONE
 RTS

* === SHADADR: SHADP -> SHADOW[EVB*20+EVA] ===
* clobbers T16, SHADP (ZP). EVA/EVB unchanged.
SHADADR
 LDA EVB
 STA T16
 LDA #0
 STA T16+1
 ASL T16
 ROL T16+1
 ASL T16
 ROL T16+1
 LDA T16
 STA SHADP
 LDA T16+1
 STA SHADP+1
 ASL T16
 ROL T16+1
 ASL T16
 ROL T16+1
 LDA T16
 CLC
 ADC SHADP
 STA T16
 LDA T16+1
 ADC SHADP+1
 STA T16+1
 LDA T16
 CLC
 ADC EVA
 STA T16
 LDA T16+1
 ADC #0
 STA T16+1
* itr4.1 2-byte plots: double offset before base
 ASL T16
 ROL T16+1
 LDA T16
 CLC
 ADC #<SHADOW
 STA SHADP
 LDA T16+1
 ADC #>SHADOW
 STA SHADP+1
 RTS

* === SHADSET: SHADOW[EVB*20+EVA] = A ===
SHADSET
 STA SHADV
 JSR SHADADR
 LDY #0
 LDA SHADV
 STA (SHADP),Y
 RTS

* === SHADGET: A = SHADOW[EVB*20+EVA] ===
SHADGET
 JSR SHADADR
 LDY #0
 LDA (SHADP),Y
 RTS

* === SHADGET1: A = SHADOW byte1 (stage) ===
SHADGET1
 JSR SHADADR
 LDY #1
 LDA (SHADP),Y
 RTS

* === SHADSET1: SHADOW byte1 (stage) = A ===
SHADSET1
 STA SHADV
 JSR SHADADR
 LDY #1
 LDA SHADV
 STA (SHADP),Y
 RTS

* === RESYNC: stable (SEQCTR,HEAD) pair, full
* state re-read + redraw ===
RESYNC
RSAGN
 LDA #<FSEQC
 LDY #>FSEQC
 JSR FRD
 LDA SDM_VAL
 STA EXPSEQ
 LDA #<FHEAD
 LDY #>FHEAD
 JSR FRD
 LDA SDM_VAL
 STA TAIL
 LDA #<FSEQC
 LDY #>FSEQC
 JSR FRD
 LDA SDM_VAL
 CMP EXPSEQ
 BNE RSAGN
 JSR RDMKT
 JSR RDGRID
 JSR DRAWALL
 JSR HUDDRAW
 RTS

* === RDGRID: stream 800 bytes -> SHADOW ===
RDGRID
 LDA #GBANK
 STA SDM_BANK
 LDA #0
 STA SDM_BANK+1
 JSR SDM_SETBANK
 LDA #<FGRID
 STA SDM_ADDR
 LDA #>FGRID
 STA SDM_ADDR+1
 JSR SDM_SETADDR
 LDA #<SHADOW
 STA SHADP
 LDA #>SHADOW
 STA SHADP+1
 LDA #<800
 STA CNT
 LDA #>800
 STA CNT+1
 LDY #0
RGLP
 JSR SDM_RDNEXT
 LDA SDM_VAL
 STA (SHADP),Y
 INY
 BNE RGDEC
 INC SHADP+1
RGDEC
 LDA CNT
 SEC
 SBC #1
 STA CNT
 LDA CNT+1
 SBC #0
 STA CNT+1
 ORA CNT
 BNE RGLP
 RTS

* === MAIN ===
MAIN
 JSR SDM_READY
 BCC MRDY
 RTS
MRDY
 JSR GRINIT
 JSR GRON
 JSR GRCLR
 LDA #0
 STA SELCROP
 STA SCREEN
 STA MIXN
* farm SIG present?
 LDA #<FSIG0
 LDY #>FSIG0
 JSR FRD
 LDA SDM_VAL
 CMP #SIGF
 BEQ SIG0OK
 JMP COLDST
SIG0OK
 LDA #<FSIG1
 LDY #>FSIG1
 JSR FRD
 LDA SDM_VAL
 CMP #SIGM
 BEQ SIG1OK
 JMP COLDST
SIG1OK
* farm CVER gate (itr4.1): mismatch -> COLDST.
* without this, a pre-relay 'FM' world passes SIG
* and corrupts against the new layout.
 LDA #<FBCVER
 LDY #>FBCVER
 JSR FRD
 LDA SDM_VAL
 CMP #CVERNUM
 BEQ FCVOK
 JMP COLDST
FCVOK
* farm probe: STATUS 3 tries
 LDX #3
PRLOOP
 LDA #OPSTAT
 STA CMDOP
 JSR SENDCMD
 BCC PROBED
 DEX
 BNE PRLOOP
* farm probe dead: check CP_ACTIVE
 LDA CP_ACTIVE
 BNE PRDEAD
* CP_ACTIVE==0: respawn both tasks
 JSR RSTWAIT
 JSR CHKWK
 JSR LOADF
 JSR LOADW
 JSR STAGEF
 JSR STAGEW
 JSR RINGF
 BCS PRDEAD
 JSR RINGW
 BCS PRDEAD
* write SIG33 after all rings
 LDA #SIGW
 STA SDM_VAL
 LDA #<WBSIG0
 LDY #>WBSIG0
 JSR WFWR
 LDA #SIGK
 STA SDM_VAL
 LDA #<WBSIG1
 LDY #>WBSIG1
 JSR WFWR
 JSR RESYNC
 JSR WSYNC
 JSR MSGRESP
 JMP MLOOP
PRDEAD
 JSR MSGDEAD
PRKEY
 LDA KBD
 BPL PRKEY
 STA KBDSTR
 CMP #$C3 ; 'C'
 BEQ COLDST
 JMP QUIT
PROBED
 CMP #ROK
 BNE COLDST
* farm alive: probe workshop
 LDA #WOPSTAT
 STA CMDOP2
 LDA #0
 STA CMDA02
 STA CMDA12
 STA CMDA22
 STA CMDA32
 JSR WSENDCMD
 BCS WKPFAIL
 CMP #ROK
 BNE WKPFAIL
* both alive: warm entry
 JSR RESYNC
 JSR WSYNC
 JMP MLOOP
WKPFAIL
* workshop dead: check if farm slot busy
 LDA CP_ACTIVE
 BNE PRDEAD
* no slots busy: respawn both
 JSR RSTWAIT
 JSR CHKWK
 JSR LOADF
 JSR LOADW
 JSR STAGEF
 JSR STAGEW
 JSR RINGF
 BCS PRDEAD
 JSR RINGW
 BCS PRDEAD
 LDA #SIGW
 STA SDM_VAL
 LDA #<WBSIG0
 LDY #>WBSIG0
 JSR WFWR
 LDA #SIGK
 STA SDM_VAL
 LDA #<WBSIG1
 LDY #>WBSIG1
 JSR WFWR
 JSR RESYNC
 JSR WSYNC
 JSR MSGRESP
 JMP MLOOP

COLDST
* full cold start: RSTWAIT first
 JSR RSTWAIT
* zero header event-state $0002-$000F
 LDA #GBANK
 STA SDM_BANK
 LDA #0
 STA SDM_BANK+1
 JSR SDM_SETBANK
 LDA #<FSEQC
 STA SDM_ADDR
 LDA #>FSEQC
 STA SDM_ADDR+1
 JSR SDM_SETADDR
 LDA #0
 STA SDM_VAL
 LDA #14
 STA CNT
 LDA #0
 STA CNT+1
CZHLP
 JSR SDM_WRNEXT
 DEC CNT
 BNE CZHLP
* zero $0200-$0AFF: mailbox+market+cash+seeds+
* crops + full 2 KB grid reserve (one sweep)
 LDA #<FMFLAG
 STA SDM_ADDR
 LDA #>FMFLAG
 STA SDM_ADDR+1
 JSR SDM_SETADDR
 LDA #0
 STA SDM_VAL
 LDA #<$0900
 STA CNT
 LDA #>$0900
 STA CNT+1
CZLP
 JSR SDM_WRNEXT
 LDA CNT
 SEC
 SBC #1
 STA CNT
 LDA CNT+1
 SBC #0
 STA CNT+1
 ORA CNT
 BNE CZLP
* market base prices (PRICE lo of crops 0-3)
 LDA #8
 STA SDM_VAL
 LDA #<FMKT ;wheat 8
 LDY #>FMKT
 JSR FWR
 LDA #14
 STA SDM_VAL
 LDA #<FMKT+3 ;carrot 14
 LDY #>FMKT
 JSR FWR
 LDA #24
 STA SDM_VAL
 LDA #<FMKT+6 ;berry 24
 LDY #>FMKT
 JSR FWR
 LDA #40
 STA SDM_VAL
 LDA #<FMKT+9 ;pumpkn 40
 LDY #>FMKT
 JSR FWR
* cash + starting seeds[0]
 LDA #CASH0
 STA SDM_VAL
 LDA #<FCASHL
 LDY #>FCASHL
 JSR FWR
 LDA #SEEDS0
 STA SDM_VAL
 LDA #<FSEEDS
 LDY #>FSEEDS
 JSR FWR
* seed NPC tables (bank 32) + cold-seed bank 33
 JSR SEEDNPC
 JSR SEED33
* quiesce: all BRAM loads first
 JSR LOADF
 JSR LOADW
* stage both mailboxes before any ring
 JSR STAGEF
 JSR STAGEW
* then both rings
 JSR RINGF
 BCC CSPOK
 JSR MSGDEAD
 JMP QUIT
CSPOK
 JSR RINGW
 BCC CS2OK
 JSR MSGDEAD
 JMP QUIT
CS2OK
* SIGs last: 33 first then 32
 LDA #SIGW
 STA SDM_VAL
 LDA #<WBSIG0
 LDY #>WBSIG0
 JSR WFWR
 LDA #SIGK
 STA SDM_VAL
 LDA #<WBSIG1
 LDY #>WBSIG1
 JSR WFWR
 LDA #SIGF
 STA SDM_VAL
 LDA #<FSIG0
 LDY #>FSIG0
 JSR FWR
 LDA #SIGM
 STA SDM_VAL
 LDA #<FSIG1
 LDY #>FSIG1
 JSR FWR
* farm CVER last (gate reads this)
 LDA #CVERNUM
 STA SDM_VAL
 LDA #<FBCVER
 LDY #>FBCVER
 JSR FWR
 JSR RESYNC
 JSR WSYNC
 JMP MLOOP

* === MLOOP ===
MLOOP
 JSR DRAIN
 JSR DRAIN2
 LDA SCREEN
 CMP #5
 BNE MNOTR
 JSR TRADETICK
MNOTR
* periodic re-stream
 INC RSTRCT
 BNE MNOST
 INC RSTRCT+1
 BNE MNOST
 JSR RESTREAM
MNOST
 LDA KBD
 BPL MLOOP
 STA KBDSTR
 LDX SCREEN
 BEQ KFARM
 CPX #2
 BEQ JWKKEY
 CPX #3
 BEQ JINVKEY
 CPX #4
 BEQ JTRKEY
 CPX #5
 BEQ JTRDKEY
 JMP MKKEY
JWKKEY
 JMP WKKEY
JINVKEY
 JMP INVKEY
JTRKEY
 JMP TRKEY
JTRDKEY
 JMP TRDKEY
KFARM
* arrow handlers: CURSDRAW (XOR undo at old
* pos) BEFORE mutate, CURSDRAW (apply) at KDONE
 CMP #$88 ; left
 BNE K2
 JSR CURSDRAW
 DEC CURX
 BPL KD1
 LDA #19
 STA CURX
KD1
 JMP KDONE
K2
 CMP #$95 ; right
 BNE K3
 JSR CURSDRAW
 INC CURX
 LDA CURX
 CMP #20
 BNE KD2
 LDA #0
 STA CURX
KD2
 JMP KDONE
K3
 CMP #$8B ; up
 BNE K4
 JSR CURSDRAW
 DEC CURY
 BPL KD3
 LDA #19
 STA CURY
KD3
 JMP KDONE
K4
 CMP #$8A ; down
 BNE K5
 JSR CURSDRAW
 INC CURY
 LDA CURY
 CMP #20
 BNE KD4
 LDA #0
 STA CURY
KD4
 JMP KDONE
K5
 CMP #$D0 ; P
 BNE K6
 LDA #OPPLANT
 JSR DOCMDXYC
 JMP MLOOP
K6
 CMP #$C8 ; H
 BNE K8
 LDA #OPHARV
 JSR DOCMDXY
 JMP MLOOP
* keys 1-4: select crop (hi-bit set: $B1-$B4)
K8
 CMP #$B1 ; '1'
 BCC K9
 CMP #$B5 ; above '4'
 BCS KM
 SEC
 SBC #$B1
 STA SELCROP
 JSR HUDDRAW
 JMP MLOOP
KM
 CMP #$CD ; M -> market (NPC)
 BNE KW
 JSR TRENTER
 JMP MLOOP
KW
 CMP #$D7 ; W -> workshop
 BNE K9
 JSR WKENTER
 JMP MLOOP
K9
 CMP #$D1 ; Q
 BNE KI
QUIT
 STA TEXTSW
 RTS
KI
 CMP #$C9 ; I -> inventory
 BNE KNONE
 LDA #0
 STA PREVSCR
 JSR INVENTER
 JMP MLOOP
KNONE
 JMP MLOOP
KDONE
 JSR CURSDRAW
 JMP MLOOP

* === MKKEY: market screen keys ===
MKKEY
 CMP #$9B ; ESC
 BNE MK1
 JSR MKEXIT
 JMP MLOOP
MK1
 CMP #$B1 ; '1'-'4' select
 BCC MK2
 CMP #$B5
 BCS MK2
 SEC
 SBC #$B1
 STA SELCROP
 JSR MKDRAW
 JMP MLOOP
MK2
 CMP #$C2 ; B buy
 BNE MK3
 LDA #OPBUY
 STA CMDOP
 LDA #<SQTYB
 STA MSGPTR
 LDA #>SQTYB
 STA MSGPTR+1
 LDA SELCROP
 STA QPCROP
 JSR QTYPROMPT
* re-read after op feeds MKDRAW
 JSR RDMKT
 JSR MKDRAW
 JMP MLOOP
MK3
 CMP #$D3 ; S sell
 BNE MK4
 LDA #OPSELL
 STA CMDOP
 LDA #<SQTYS
 STA MSGPTR
 LDA #>SQTYS
 STA MSGPTR+1
 LDA SELCROP
 STA QPCROP
 JSR QTYPROMPT
* re-read after op feeds MKDRAW
 JSR RDMKT
 JSR MKDRAW
 JMP MLOOP
MK4
 CMP #$D7 ; W -> workshop
 BNE MK5
 JSR WKENTER
 JMP MLOOP
MK5
 CMP #$D2 ; R buy recipe
 BNE MKI
 JSR SHOPBUY
 JSR RDMKT
 JSR MKDRAW
 JMP MLOOP
MKI
 CMP #$C9 ; I -> inventory
 BNE MKNONE
 LDA #1
 STA PREVSCR
 JSR INVENTER
 JMP MLOOP
MKNONE
 JMP MLOOP

* === DOCMDXY: A=op, args = cursor pos ===
DOCMDXY
 STA CMDOP
 LDA CURX
 STA CMDA0
 LDA CURY
 STA CMDA1
 LDA #0
 STA CMDA2
 JMP DOCMD
* === DOCMDXYC: like DOCMDXY + A2=SELCROP ===
DOCMDXYC
 STA CMDOP
 LDA CURX
 STA CMDA0
 LDA CURY
 STA CMDA1
 LDA SELCROP
 STA CMDA2
 JMP DOCMD
* === DOCMD1: A=op, qty=1 ===
DOCMD1
 STA CMDOP
 LDA #1
 STA CMDA0
 LDA #0
 STA CMDA1
 STA CMDA2
DOCMD
 JSR SENDCMD
 BCC DCRES
 LDA #<SNORESP
 STA MSGPTR
 LDA #>SNORESP
 STA MSGPTR+1
 JMP DCMSG
DCRES
 CMP #ROK
 BNE DCBAD
 JMP DCOK
DCBAD
 STA ERRCODE
 LDA #<SERR
 STA MSGPTR
 LDA #>SERR
 STA MSGPTR+1
 JMP DCERR
DCMSG
 JSR CLRMSG
 LDA #0
 STA PRCOL
 LDY #21
 JSR PRSTR
 RTS
DCERR
 JSR CLRMSG
 LDA #0
 STA PRCOL
 LDY #21
 JSR PRSTR
* PRHEX: 2 hex digits at col 4, row 21
 LDA ERRCODE
 LSR
 LSR
 LSR
 LSR
 JSR NIBA
 STA (LINEP),Y
 INY
 LDA ERRCODE
 AND #$0F
 JSR NIBA
 STA (LINEP),Y
 RTS
NIBA
 ORA #$B0
 CMP #$BA
 BCC NIBDONE
 ADC #6
NIBDONE
 RTS
* === QTYPROMPT/TQTYPROMPT: 3-digit qty modal ===
* QTYPROMPT (mode 0, market): caller sets CMDOP +
* MSGPTR + QPCROP; commit -> DOCMD.
* TQTYPROMPT (mode 1, trade): caller sets MSGPTR +
* TRADEOP/TRADETYP/TRADENPC/TRADEITEM; commit ->
* TRADEGO. ESC or qty 0 cancels. Clamps 255.
* modal: no DRAIN.
TQTYPROMPT
 LDA #1
 STA QPMODE
 JMP QTYBODY
QTYPROMPT
 LDA #0
 STA QPMODE
QTYBODY
 JSR CLRMSG
 LDA #0
 STA PRCOL
 LDY #21
 JSR PRSTR
 LDA #0
 STA QVAL
 STA QDIG
SQKEY
 LDA KBD
 BPL SQKEY
 STA KBDSTR
 CMP #$9B ; ESC
 BNE SQNOTESC
 JMP SQCAN
SQNOTESC
 CMP #$8D ; RETURN
 BEQ SQGO
 CMP #$B0 ; below '0'
 BCC SQKEY
 CMP #$BA ; above '9'
 BCS SQKEY
 LDX QDIG
 CPX #3
 BCS SQKEY
* 3rd digit (QDIG==2): clamp to max 255
 CPX #2
 BNE SQNOCLMP
 PHA ;save hi-ascii key
 AND #$0F ;strip to digit value
 STA NTMP
 LDA QVAL
 CMP #26
 BCS SQCREJ ;QVAL>=26 -> 260+, reject
 CMP #25
 BNE SQCOK ;QVAL<25, allow any digit
*QVAL==25: only digits 0-5 allowed
 LDA NTMP
 CMP #6
 BCS SQCREJ ;digit>=6 -> 256+, reject
SQCOK
 PLA ;restore hi-ascii digit
 JMP SQNOCLMP
SQCREJ
 PLA
 JMP SQKEY
SQNOCLMP
* echo digit at row 21 col 10+QDIG
 PHA
 LDY #21
 LDA GRLO,Y
 STA LINEP
 LDA GRHI,Y
 STA LINEP+1
 LDA LINEP
 CLC
 ADC #10
 STA LINEP
 LDA LINEP+1
 ADC #0
 STA LINEP+1
 PLA
 LDY QDIG
 STA (LINEP),Y
* QVAL = QVAL*10 + digit
 AND #$0F
 PHA
 LDA QVAL
 ASL
 STA QVAL
 ASL
 ASL
 CLC
 ADC QVAL
 STA QVAL
 PLA
 CLC
 ADC QVAL
 STA QVAL
 INC QDIG
 JMP SQKEY
SQGO
 LDA QVAL
 BNE SQGODO
 JMP SQCAN
SQGODO
 LDX QPMODE
 BEQ SQMKT
 JMP TRADEGO
SQMKT
 STA CMDA1
 LDA QPCROP
 STA CMDA0
 LDA #0
 STA CMDA2
 JMP DOCMD
SQCAN
 JMP CLRMSG
DCOK
 LDA CMDOP
 CMP #OPPLANT
 BNE DCH
* paint: crop=SELCROP, stage 1
 LDA SELCROP
 STA DCCROP
 LDA #1
 JSR DCPAINT
 JMP DCMKT
DCH
 CMP #OPHARV
 BNE DCHWK
 JMP DCHARV
DCHWK
 JMP DCMKT
DCHARV
* read crop id (byte0) from shadow before clear
 LDA CURX
 STA EVA
 LDA CURY
 STA EVB
 JSR SHADGET
 STA HCROP
 LDA #0
 STA DCCROP
 JSR DCPAINT
DCMKT
* save pre-RDMKT crop count for yield delta
 LDX HCROP
 LDA CROP4,X
 STA OLDCROP
 JSR RDMKT
 JSR HUDDRAW
 JSR CLRMSG
* harvest: delta 0 -> "CROP DIED!",
* delta >= 2 -> "YIELD n!", else OK
 LDA CMDOP
 CMP #OPHARV
 BNE DCOKM
 LDX HCROP
 LDA CROP4,X
 SEC
 SBC OLDCROP
 BEQ DCDIED
 CMP #2
 BCC DCOKM
 PHA
 LDA #<SYIELD
 STA MSGPTR
 LDA #>SYIELD
 STA MSGPTR+1
 LDA #0
 STA PRCOL
 LDY #21
 JSR PRSTR
* digit + '!' at cols 6,7 (LINEP=row 21)
 PLA
 ORA #$B0
 LDY #6
 STA (LINEP),Y
 INY
 LDA #$A1
 STA (LINEP),Y
 RTS
DCDIED
 LDA #<SLOST
 STA MSGPTR
 LDA #>SLOST
 STA MSGPTR+1
 LDA #0
 STA PRCOL
 LDY #21
 JSR PRSTR
 RTS
DCOKM
 LDA #<SOK
 STA MSGPTR
 LDA #>SOK
 STA MSGPTR+1
 LDA #0
 STA PRCOL
 LDY #21
 JSR PRSTR
 RTS
* === DCPAINT: DCCROP=crop, A=stage -> set both
* shadow bytes at cursor, repaint, re-XOR cursor ===
DCPAINT
 STA DCSTG
 LDA CURX
 STA EVA
 LDA CURY
 STA EVB
 LDA DCCROP
 JSR SHADSET
 LDA DCSTG
 JSR SHADSET1
 LDA DCCROP
 STA PLOTCR
 LDA DCSTG
 LDX CURX
 LDY CURY
 JSR PLOTDRAW
 JSR CURSDRAW
 RTS

* === MSGDEAD ===
MSGDEAD
 JSR CLRMSG
 LDA #<SDEAD
 STA MSGPTR
 LDA #>SDEAD
 STA MSGPTR+1
 LDA #0
 STA PRCOL
 LDY #21
 JSR PRSTR
 RTS

* === DRAWALL: repaint grid from SHADOW,
* help row, cursor ===
DRAWALL
 LDA #<SHADOW
 STA SHADP
 LDA #>SHADOW
 STA SHADP+1
 LDA #0
 STA DAY
DAROW
 LDA #0
 STA DAX
DACOL
 LDY #0
 LDA (SHADP),Y
 STA PLOTCR
 LDY #1
 LDA (SHADP),Y
 LDX DAX
 LDY DAY
 JSR PLOTDRAW
 LDA SHADP
 CLC
 ADC #2
 STA SHADP
 BCC DANC
 INC SHADP+1
DANC
 INC DAX
 LDA DAX
 CMP #GCOLS
 BNE DACOL
 INC DAY
 LDA DAY
 CMP #GROWSN
 BNE DAROW
* clear row 23 before farm legend (no stale tail)
 LDX #23
 LDA GRLO,X
 STA LINEP
 LDA GRHI,X
 STA LINEP+1
 LDA #$A0
 LDY #0
DAR23LP
 STA (LINEP),Y
 INY
 CPY #40
 BNE DAR23LP
 LDA #<SHELP
 STA MSGPTR
 LDA #>SHELP
 STA MSGPTR+1
 LDA #0
 STA PRCOL
 LDY #23
 JSR PRSTR
 JSR CURSDRAW
 RTS

* === RESTREAM: re-read grid, repaint diffs,
* preserve cursor XOR ===
RESTREAM
 LDA #GBANK
 STA SDM_BANK
 LDA #0
 STA SDM_BANK+1
 JSR SDM_SETBANK
 LDA #<FGRID
 STA SDM_ADDR
 LDA #>FGRID
 STA SDM_ADDR+1
 JSR SDM_SETADDR
 LDA #<SHADOW
 STA SHADP
 LDA #>SHADOW
 STA SHADP+1
 LDA #0
 STA DAY
RSROW2
 LDA #0
 STA DAX
RSCOL2
* read both SDRAM bytes (crop, stage)
 JSR SDM_RDNEXT
 LDA SDM_VAL
 STA RSCROP
 JSR SDM_RDNEXT
 LDA SDM_VAL
 STA RSSTAGE
* changed vs shadow pair?
 LDY #0
 LDA (SHADP),Y
 CMP RSCROP
 BNE RSCHG
 LDY #1
 LDA (SHADP),Y
 CMP RSSTAGE
 BEQ RSSAME
RSCHG
 LDA RSCROP
 LDY #0
 STA (SHADP),Y
 LDA RSSTAGE
 LDY #1
 STA (SHADP),Y
* skip GR paint on market (text) screen
 LDA SCREEN
 BNE RSSAME
 LDA RSCROP
 STA PLOTCR
 LDA RSSTAGE
 LDX DAX
 LDY DAY
 JSR PLOTDRAW
 LDA DAX
 CMP CURX
 BNE RSSAME
 LDA DAY
 CMP CURY
 BNE RSSAME
 JSR CURSDRAW
RSSAME
 LDA SHADP
 CLC
 ADC #2
 STA SHADP
 BCC RSNC
 INC SHADP+1
RSNC
 INC DAX
 LDA DAX
 CMP #GCOLS
 BNE RSCOL2
 INC DAY
 LDA DAY
 CMP #GROWSN
 BNE RSROW2
 RTS

* === LOADF: farm blob $2000 + TABLE[2] poke ===
LOADF
 JSR LOADBLOB
 LDA #$04
 STA CP_LADDRLO
 LDA #$02
 STA CP_LADDRHI
 LDA #$00
 STA CP_WDATA
 LDA #$20
 STA CP_WDATA
 RTS

* === RINGF: raw ring slot 0 (farm task) ===
* C=0 always; caller pre-confirmed CP_ACTIVE=0
RINGF
 LDA #0
 STA CP_RING
 CLC
 RTS

* === LOADW: workshop blob $4000 + TABLE[3] ===
LOADW
 JSR LOADWBLOB
 LDA #$06
 STA CP_LADDRLO
 LDA #$02
 STA CP_LADDRHI
 LDA #$00
 STA CP_WDATA
 LDA #$40
 STA CP_WDATA
 RTS

* === RINGW: raw ring slot 1 (workshop task) ===
* C=0 always; caller pre-confirmed CP_ACTIVE=0
RINGW
 LDA #1
 STA CP_RING
 CLC
 RTS

* === STAGEF: stage slot 0 mailbox ===
* skill 2, budget 0, arg0 0 (farm task)
* mirrors CP_CALL layout: mbox=$0F80
STAGEF
 LDA #$80
 STA CP_LADDRLO
 LDA #$0F
 STA CP_LADDRHI
 LDA #2
 STA CP_WDATA
 LDA #0
 STA CP_WDATA
 STA CP_WDATA
 RTS

* === STAGEW: stage slot 1 mailbox ===
* skill 3, budget 0, arg0 0 (workshop task)
* mirrors CP_CALL layout: mbox=$0FA0
STAGEW
 LDA #$A0
 STA CP_LADDRLO
 LDA #$0F
 STA CP_LADDRHI
 LDA #3
 STA CP_WDATA
 LDA #0
 STA CP_WDATA
 STA CP_WDATA
 RTS

* === LOADWBLOB: WSKILL -> coproc $4000 ===
LOADWBLOB
 LDA #$00
 STA CP_LADDRLO
 LDA #$40
 STA CP_LADDRHI
 LDA #<WSKILL
 STA SRC
 LDA #>WSKILL
 STA SRC+1
 LDA #<WSKLEN
 STA CNT
 LDA #>WSKLEN
 STA CNT+1
 LDY #0
WBLP
 LDA (SRC),Y
 STA CP_WDATA
 INC SRC
 BNE WBDEC
 INC SRC+1
WBDEC
 LDA CNT
 SEC
 SBC #1
 STA CNT
 LDA CNT+1
 SBC #0
 STA CNT+1
 ORA CNT
 BNE WBLP
 RTS

* === RSTWAIT: poll CP_FSTAT bit 1 ===
* 16-bit counter RSTWT (not ZP)
RSTWAIT
 LDA #0
 STA RSTWT
 STA RSTWT+1
RSWLP
 LDA CP_FSTAT
 AND #2
 BNE RSWDN
 INC RSTWT
 BNE RSWLP
 INC RSTWT+1
 BNE RSWLP
RSWDN
 RTS

* === CHKWK: bad SIG -> SEED33 (cold).
* valid SIG + CVER mismatch -> SEED33. ===
CHKWK
 LDA #<WBSIG0
 LDY #>WBSIG0
 JSR WFRD
 LDA SDM_VAL
 CMP #SIGW
 BNE CHKSEED
 LDA #<WBSIG1
 LDY #>WBSIG1
 JSR WFRD
 LDA SDM_VAL
 CMP #SIGK
 BNE CHKSEED
 LDA #<WBCVER
 LDY #>WBCVER
 JSR WFRD
 LDA SDM_VAL
 CMP #CVERNUM
 BEQ CHKWKDN
* CVER mismatch -> full SEED33 (no migrate)
 JSR SEED33
 JMP CHKWKDN
CHKSEED
 JSR SEED33
CHKWKDN
 RTS

* === SEED33: cold-seed bank 33 (no SIG) ===
* caller writes SIG after all rings
SEED33
* zero header $0002-$000F (CVER set below)
 LDA #WBANK
 STA SDM_BANK
 LDA #0
 STA SDM_BANK+1
 JSR SDM_SETBANK
 LDA #<WBSEQC
 STA SDM_ADDR
 LDA #>WBSEQC
 STA SDM_ADDR+1
 JSR SDM_SETADDR
 LDA #0
 STA SDM_VAL
 LDA #14
 STA CNT
CS33HLP
 JSR SDM_WRNEXT
 DEC CNT
 BNE CS33HLP
* zero $0200-$04FF: mailbox + skill + disc(8) +
* mode + stations(16) + goods(64) + recipe(512)
 LDA #<WBFLAG
 STA SDM_ADDR
 LDA #>WBFLAG
 STA SDM_ADDR+1
 JSR SDM_SETADDR
 LDA #0
 STA SDM_VAL
 LDA #<$0300
 STA CNT
 LDA #>$0300
 STA CNT+1
CS33ZLP
 JSR SDM_WRNEXT
 LDA CNT
 SEC
 SBC #1
 STA CNT
 LDA CNT+1
 SBC #0
 STA CNT+1
 ORA CNT
 BNE CS33ZLP
* CVER = CVERNUM
 LDA #CVERNUM
 STA SDM_VAL
 LDA #<WBCVER
 LDY #>WBCVER
 JSR WFWR
* recipe table: stream 96 bytes to $0300
 LDA #WBANK
 STA SDM_BANK
 LDA #0
 STA SDM_BANK+1
 JSR SDM_SETBANK
 LDA #<WBRECIP
 STA SDM_ADDR
 LDA #>WBRECIP
 STA SDM_ADDR+1
 JSR SDM_SETADDR
 LDA #<RECTAB
 STA SRC
 LDA #>RECTAB
 STA SRC+1
 LDA #96
 STA CNT
 LDA #0
 STA CNT+1
SD33RLP
 LDY #0
 LDA (SRC),Y
 STA SDM_VAL
 JSR SDM_WRNEXT
 INC SRC
 BNE SD33DC
 INC SRC+1
SD33DC
 LDA CNT
 SEC
 SBC #1
 STA CNT
 LDA CNT+1
 SBC #0
 STA CNT+1
 ORA CNT
 BNE SD33RLP
 JSR SEEDNPG
 RTS
* seed crop-NPC tables (bank 32): current+base =
* NPCBASE, NPC n crop c at $0B00/$0C00 + n*32+c*2
SEEDNPC
 LDA #0
 STA NIDX
 STA NPI
SNNP
 LDA #0
 STA NCI
SNCR
 LDA NPI
 ASL
 ASL
 ASL
 ASL
 ASL
 STA NTMP
 LDA NCI
 ASL
 CLC
 ADC NTMP
 STA NTMP
 LDX NIDX
 LDA NPCBASE,X
 STA SDM_VAL
 LDA NTMP
 LDY #>FNPC
 JSR FWR
 LDX NIDX
 LDA NPCBASE,X
 STA SDM_VAL
 LDA NTMP
 LDY #>FNPCB
 JSR FWR
 INC NIDX
 INC NCI
 LDA NCI
 CMP #NCROPS
 BNE SNCR
 INC NPI
 LDA NPI
 CMP #NCNPC
 BNE SNNP
 RTS
* seed goods-NPC tables (bank 33): current+base =
* NPGBASE, NPC n good g at $0500/$0600 + n*128+g*2
SEEDNPG
 LDA #0
 STA NIDX
 STA NPI
SGNP
 LDA #0
 STA NCI
SGGD
* offset = NPC*128 + good*2 (NGNPC=2: 0,1 only)
 LDA #0
 STA NTMP
 LDA NPI
 BEQ SGN0
 LDA #128
 STA NTMP
SGN0
 LDA NCI
 ASL
 CLC
 ADC NTMP
 STA NTMP
 LDX NIDX
 LDA NPGBASE,X
 STA SDM_VAL
 LDA NTMP
 LDY #>WBNPC
 JSR WFWR
 LDX NIDX
 LDA NPGBASE,X
 STA SDM_VAL
 LDA NTMP
 LDY #>WBNPCB
 JSR WFWR
 INC NIDX
 INC NCI
 LDA NCI
 CMP #NRECIP
 BNE SGGD
 INC NPI
 LDA NPI
 CMP #NGNPC
 BNE SGNP
 RTS

* === WSYNC: stable pair bank 33 + state re-read ===
WSYNC
WSAGN
 LDA #<WBSEQC
 LDY #>WBSEQC
 JSR WFRD
 LDA SDM_VAL
 STA EXPSEQ2
 LDA #<WBHEAD
 LDY #>WBHEAD
 JSR WFRD
 LDA SDM_VAL
 STA TAIL2
 LDA #<WBSEQC
 LDY #>WBSEQC
 JSR WFRD
 LDA SDM_VAL
 CMP EXPSEQ2
 BNE WSAGN
* skill
 LDA #<WBSKILL
 LDY #>WBSKILL
 JSR WFRD
 LDA SDM_VAL
 STA WSKILLV
* disc 8 bytes (64-bit bitmap)
 LDX #0
WSDLP
 TXA
 CLC
 ADC #<WBDISC
 LDY #>WBDISC
 JSR WFRD
 LDA SDM_VAL
 STA WDISCV,X
 INX
 CPX #8
 BNE WSDLP
* stations 8 bytes
 LDX #0
WSSTA
 TXA
 CLC
 ADC #<WBSTA
 LDY #>WBSTA
 JSR WFRD
 LDA SDM_VAL
 STA STREC,X
 INX
 CPX #8
 BNE WSSTA
* goods 12 bytes -> WGOODS
 LDX #0
WSYNG
 TXA
 CLC
 ADC #<WBGOODS
 LDY #>WBGOODS
 JSR WFRD
 LDA SDM_VAL
 STA WGOODS,X
 INX
 CPX #12
 BNE WSYNG
 RTS

* === WSYNC_STA: re-read stations only ===
WSYNC_STA
 LDX #0
WSSTALP
 TXA
 CLC
 ADC #<WBSTA
 LDY #>WBSTA
 JSR WFRD
 LDA SDM_VAL
 STA STREC,X
 INX
 CPX #8
 BNE WSSTALP
 RTS

* === DRAIN2: consume bank-33 ring ===
DRAIN2
 LDA #<WBHEAD
 LDY #>WBHEAD
 JSR WFRD
 LDA SDM_VAL
 CMP TAIL2
 BEQ DR2DONE
 LDA TAIL2
 ASL
 ASL
 STA RECLO2
 LDA RECLO2
 LDY #>WBRING
 JSR WFRD
 LDA SDM_VAL
 STA RSEQ2
 LDA RECLO2
 CLC
 ADC #1
 LDY #>WBRING
 JSR WFRD
 LDA SDM_VAL
 STA EVT
 LDA RECLO2
 CLC
 ADC #2
 LDY #>WBRING
 JSR WFRD
 LDA SDM_VAL
 STA EVA
 LDA RECLO2
 CLC
 ADC #3
 LDY #>WBRING
 JSR WFRD
 LDA SDM_VAL
 STA EVB
* seqlock tear guard
 LDA RECLO2
 LDY #>WBRING
 JSR WFRD
 LDA SDM_VAL
 CMP RSEQ2
 BNE DR2LAP
 LDA RSEQ2
 CMP EXPSEQ2
 BNE DR2LAP
 JSR WEVDISP
 INC EXPSEQ2
 LDA TAIL2
 CLC
 ADC #1
 AND #$3F
 STA TAIL2
 JMP DRAIN2
DR2LAP
 JSR WSYNC
DR2DONE
 RTS

* === WEVDISP: dispatch bank-33 events ===
WEVDISP
 LDA EVT
 CMP #WEVDONE
 BNE WEVDN
* re-read stations
 JSR WSYNC_STA
 LDA SCREEN
 CMP #2
 BEQ WEVSCR
 CMP #3
 BEQ WEVDRT
* not workshop: show CRAFT DONE row 21
 JSR CLRMSG
 LDA #<SCRAFTD
 STA MSGPTR
 LDA #>SCRAFTD
 STA MSGPTR+1
 LDA #0
 STA PRCOL
 LDY #21
 JSR PRSTR
* farm screen: refresh widget + bell
 LDA SCREEN
 BNE WEVDRT
 JSR $FBDD ; BELL
 JSR HUDDRAW
WEVDRT
 RTS
WEVSCR
 JSR WKDRAW_STA
WEVDN
 RTS

* === MSGRESP: tasks-respawned notice ===
MSGRESP
 JSR CLRMSG
 LDA #<SRESP2
 STA MSGPTR
 LDA #>SRESP2
 STA MSGPTR+1
 LDA #0
 STA PRCOL
 LDY #21
 JSR PRSTR
 RTS

* === LOADBLOB: FSKILL -> coproc $2000 ===
LOADBLOB
 LDA #$00
 STA CP_LADDRLO
 LDA #$20
 STA CP_LADDRHI
 LDA #<FSKILL
 STA SRC
 LDA #>FSKILL
 STA SRC+1
 LDA #<FSKLEN
 STA CNT
 LDA #>FSKLEN
 STA CNT+1
 LDY #0
LBLP
 LDA (SRC),Y
 STA CP_WDATA
 INC SRC
 BNE LBDEC
 INC SRC+1
LBDEC
 LDA CNT
 SEC
 SBC #1
 STA CNT
 LDA CNT+1
 SBC #0
 STA CNT+1
 ORA CNT
 BNE LBLP
 RTS

* === MKENTER: -> text mode market screen ===
MKENTER
 LDA #1
 STA SCREEN
 STA TEXTSW
 JSR CLRMSG
 LDA #<SMHINT
 STA MSGPTR
 LDA #>SMHINT
 STA MSGPTR+1
 LDA #0
 STA PRCOL
 LDY #21
 JSR PRSTR
 JSR MKDRAW
 RTS
* === MKEXIT: -> GR farm screen ===
MKEXIT
 LDA #0
 STA SCREEN
 STA GRAPH
* DRAWALL already applies cursor XOR -
* a second CURSDRAW here ERASES it and
* phase-inverts every later toggle (ghosts)
 JSR DRAWALL
 JSR HUDDRAW
 RTS

* === WKENTER: -> text workshop screen ===
WKENTER
 LDA #2
 STA SCREEN
 STA TEXTSW
* no hint print: row 23 legend covers it
 JSR CLRMSG
 JSR RDMKT
 JSR WSYNC
 JSR WKDRAW
 RTS

* === WKEXIT: -> GR farm screen ===
* DRAWALL applies cursor XOR - no extra CURSDRAW
WKEXIT
 LDA #0
 STA SCREEN
 STA GRAPH
 JSR DRAWALL
 JSR HUDDRAW
 RTS

* === WKDRAW: full workshop screen repaint ===
WKDRAW
 JSR MKCLR
* row 23 clear
 LDX #23
 LDA GRLO,X
 STA LINEP
 LDA GRHI,X
 STA LINEP+1
 LDA #$A0
 LDY #0
WKR23LP
 STA (LINEP),Y
 INY
 CPY #40
 BNE WKR23LP
* row 0: "WORKSHOP"
 LDA #<SWKSHP
 STA MSGPTR
 LDA #>SWKSHP
 STA MSGPTR+1
 LDA #0
 STA PRCOL
 LDY #0
 JSR PRSTR
* row 0: "SKILL"
 LDA #<SSKILL
 STA MSGPTR
 LDA #>SSKILL
 STA MSGPTR+1
 LDA #10
 STA PRCOL
 LDY #0
 JSR PRSTR
* row 0: skill digits col 16
 LDA WSKILLV
 STA T16
 LDA #0
 STA T16+1
 LDX #16
 LDY #0
 JSR PRDEC3
* row 2: CROPS available (from farm CROP4 -
* craft pulls these; lets player see qty)
 LDA #<SPANT
 STA MSGPTR
 LDA #>SPANT
 STA MSGPTR+1
 LDA #0
 STA PRCOL
 LDY #2
 JSR PRSTR
 LDA CROP4+0
 STA T16
 LDA #0
 STA T16+1
 LDX #8
 LDY #2
 JSR PRDEC3
 LDY #2
 LDA GRLO,Y
 STA LINEP
 LDA GRHI,Y
 STA LINEP+1
 LDA #$C3
 LDY #12
 STA (LINEP),Y
 LDA CROP4+1
 STA T16
 LDA #0
 STA T16+1
 LDX #13
 LDY #2
 JSR PRDEC3
 LDY #2
 LDA GRLO,Y
 STA LINEP
 LDA GRHI,Y
 STA LINEP+1
 LDA #$C2
 LDY #17
 STA (LINEP),Y
 LDA CROP4+2
 STA T16
 LDA #0
 STA T16+1
 LDX #18
 LDY #2
 JSR PRDEC3
 LDY #2
 LDA GRLO,Y
 STA LINEP
 LDA GRHI,Y
 STA LINEP+1
 LDA #$D0
 LDY #22
 STA (LINEP),Y
 LDA CROP4+3
 STA T16
 LDA #0
 STA T16+1
 LDX #23
 LDY #2
 JSR PRDEC3
* rows 4-5: stations
 JSR WKDRAW_STA
* rows 7-12: recipe book
 JSR WKDRAW_REC
* row 19: MIX buffer
 JSR WKDRAW_MIX
* row 20: cash only (farm SEED row is
* stale context here - clear + HUDCASH)
 JSR CLRROW20
 JSR HUDCASH
* row 23: legend (cleared at WKDRAW top)
 LDA #<SWKLEG
 STA MSGPTR
 LDA #>SWKLEG
 STA MSGPTR+1
 LDA #0
 STA PRCOL
 LDY #23
 JSR PRSTR
 RTS

* === WKDRAW_STA: draw station rows 4-5 ===
* STREC[0..7]: sta0 state/recipe/timer/pad,
*              sta1 state/recipe/timer/pad
WKDRAW_STA
 LDA #0
 STA NTMP
WKDST_LP
* blank row 4+NTMP
 LDA NTMP
 CLC
 ADC #4
 TAY
 LDA GRLO,Y
 STA LINEP
 LDA GRHI,Y
 STA LINEP+1
 LDA #$A0
 LDY #0
WKDST_BL
 STA (LINEP),Y
 INY
 CPY #40
 BNE WKDST_BL
* station number "1" or "2"
 LDA NTMP
 CLC
 ADC #4
 TAY
 LDA GRLO,Y
 STA LINEP
 LDA GRHI,Y
 STA LINEP+1
 LDA NTMP
 CLC
 ADC #$B1
 LDY #0
 STA (LINEP),Y
* get state byte: STREC[NTMP*4]
 LDA NTMP
 ASL
 ASL
 TAX
 LDA STREC,X
 STA EVT
* col 2: state text
 LDA NTMP
 CLC
 ADC #4
 TAY
 LDA GRLO,Y
 STA LINEP
 LDA GRHI,Y
 STA LINEP+1
 LDA EVT
 BEQ WKDST_ID
* state 1: COOKING + recipe name
 LDA #<SCOOKIN
 STA MSGPTR
 LDA #>SCOOKIN
 STA MSGPTR+1
 LDA #2
 STA PRCOL
 LDA NTMP
 CLC
 ADC #4
 TAY
 JSR PRSTR
* recipe name col 10
 LDA NTMP
 ASL
 ASL
 TAX
 LDA STREC+1,X
 STA EVA
 JSR WKRNAME
 LDA #10
 STA PRCOL
 LDA NTMP
 CLC
 ADC #4
 TAY
 JSR PRSTR
 JMP WKDST_NX
WKDST_ID
* state 0: IDLE
 LDA #<SIDLE
 STA MSGPTR
 LDA #>SIDLE
 STA MSGPTR+1
 LDA #2
 STA PRCOL
 LDA NTMP
 CLC
 ADC #4
 TAY
 JSR PRSTR
 JMP WKDST_NX
WKDST_NX
 INC NTMP
 LDA NTMP
 CMP #NSLOTS
 BEQ WKDST_DN2
 JMP WKDST_LP
WKDST_DN2
 RTS

* === WKRNAME: EVA=recipe -> MSGPTR ===
WKRNAME
 LDX EVA
 LDA RNAML,X
 STA MSGPTR
 LDA RNAMH,X
 STA MSGPTR+1
 RTS

* === WKDRAW_REC: recipe book rows 7-12 ===
* WKDREC trashes NTMP; recover via EVT-7
WKDRAW_REC
 LDA #0
 STA NTMP
WKRECLP
 LDA NTMP
 CLC
 ADC #7
 STA EVT
 LDA NTMP
 STA EVA
 LDA #0
 STA PRCOL
 JSR WKDREC
* EVT=7+NTMP still; recover NTMP from EVT
 LDA EVT
 SEC
 SBC #7
 CLC
 ADC #6
 STA EVA
 LDA #20
 STA PRCOL
 JSR WKDREC
* recover NTMP from EVT again
 LDA EVT
 SEC
 SBC #7
 STA NTMP
 INC NTMP
 LDA NTMP
 CMP #6
 BNE WKRECLP
 RTS

* === WKDREC: draw recipe EVA at row EVT col PRCOL ===
* uses SHADP(ZP) SHADV DAX NTMP T16.
* NTMP trashed; EVT preserved.
WKDREC
* check discovered bit (64-bit: byte=EVA>>3)
 LDA EVA
 AND #7
 TAX
 LDA #1
WKDR_SHL
 CPX #0
 BEQ WKDR_MK
 ASL
 DEX
 JMP WKDR_SHL
WKDR_MK
 STA NTMP
 LDA EVA
 LSR
 LSR
 LSR
 TAX
 LDA WDISCV,X
 AND NTMP
 BNE WKDR_KNW
 JMP WKDR_UNK
WKDR_KNW
* known: print name at PRCOL, row EVT
 STA SHADV
 JSR WKRNAME
 LDY EVT
 JSR PRSTR
* SHADP -> RECTAB[EVA*8]
 LDA EVA
 ASL
 ASL
 ASL
 CLC
 ADC #<RECTAB
 STA SHADP
 LDA #>RECTAB
 ADC #0
 STA SHADP+1
* LINEP = row EVT base + PRCOL + 8
 LDY EVT
 LDA GRLO,Y
 STA LINEP
 LDA GRHI,Y
 STA LINEP+1
 LDA LINEP
 CLC
 ADC PRCOL
 STA LINEP
 LDA LINEP+1
 ADC #0
 STA LINEP+1
 LDA LINEP
 CLC
 ADC #8
 STA LINEP
 LDA LINEP+1
 ADC #0
 STA LINEP+1
* ingredient letters: SHADV=byte_idx NTMP=out_col
 LDA #0
 STA SHADV
 STA NTMP
WKDR_ING
 LDA SHADV
 CMP #4
 BCS WKDR_IDN
 TAY
 LDA (SHADP),Y
 CMP #$FF
 BEQ WKDR_INX
 TAY
 LDA CROPLETS,Y
 PHA
 LDA NTMP
 TAY
 PLA
 STA (LINEP),Y
 INC NTMP
WKDR_INX
 INC SHADV
 JMP WKDR_ING
WKDR_IDN
* value (byte 5) at col PRCOL+13
 LDY #5
 LDA (SHADP),Y
 STA T16
 LDA #0
 STA T16+1
 LDA PRCOL
 CLC
 ADC #13
 TAX
 LDY EVT
 JSR PRDEC3
 RTS
WKDR_UNK
* unknown: "?????"
 LDA #<SUNKNOWN
 STA MSGPTR
 LDA #>SUNKNOWN
 STA MSGPTR+1
 LDY EVT
 JSR PRSTR
 RTS

* === WKDRAW_MIX: row 19 MIX display ===
WKDRAW_MIX
* blank row 19
 LDX #19
 LDA GRLO,X
 STA LINEP
 LDA GRHI,X
 STA LINEP+1
 LDA #$A0
 LDY #0
WKMXBL
 STA (LINEP),Y
 INY
 CPY #40
 BNE WKMXBL
* "MIX:" at col 0
 LDA #<SMIX
 STA MSGPTR
 LDA #>SMIX
 STA MSGPTR+1
 LDA #0
 STA PRCOL
 LDY #19
 JSR PRSTR
* recompute LINEP for row 19
 LDX #19
 LDA GRLO,X
 STA LINEP
 LDA GRHI,X
 STA LINEP+1
* slots 0-3
 LDX #0
WKMXLP
 LDA #$DF ; '_'
 CPX MIXN
 BCS WKMXS
 LDY MIXBUF,X
 LDA CROPLETS,Y
WKMXS
* keep char in A across col calc
 PHA
 TXA
 CLC
 ADC #5
 TAY
 PLA
 STA (LINEP),Y
 INX
 CPX #4
 BNE WKMXLP
 RTS

* === WKKEY: workshop screen keys ===
WKKEY
 CMP #$9B ; ESC
 BNE WKK1
 LDA MIXN
 BEQ WKESC_X
 LDA #0
 STA MIXN
 JSR WKDRAW
 JMP MLOOP
WKESC_X
 JSR WKEXIT
 JMP MLOOP
WKK1
* keys 1-4: append crop id to MIXBUF
 CMP #$B1
 BCC WKK2
 CMP #$B5
 BCS WKK2
 LDX MIXN
 CPX #4
 BCS WKK2
 SEC
 SBC #$B1
 STA MIXBUF,X
 INC MIXN
 JSR WKDRAW_MIX
 JMP MLOOP
WKK2
 CMP #$8D ; RETURN -> craft
 BNE WKK3
 LDA MIXN
 BEQ WKKNONE
 JSR WKCRAFT
 JMP MLOOP
WKK3
 CMP #$C9 ; I -> inventory
 BNE WKKNONE
 LDA #2
 STA PREVSCR
 JSR INVENTER
 JMP MLOOP
WKKNONE
 JMP MLOOP

* === WKCRAFT: sort MIXBUF, send OPCRAFT ===
WKCRAFT
* insertion sort MIXBUF[0..MIXN-1] ascending
* pad to 4 with $FF
 LDA MIXN
 STA EVT
 LDX EVT
WKST_PAD
 CPX #4
 BCS WKST_SORT
 LDA #$FF
 STA MIXBUF,X
 INX
 JMP WKST_PAD
WKST_SORT
* 4-element insertion sort
 LDX #1
WKISRT
 CPX #4
 BCS WKISDN
 LDA MIXBUF,X
 STA EVA
 TXA
 TAY
WKIMV
 CPY #0
 BEQ WKIPL
 LDA MIXBUF-1,Y
 CMP EVA
 BCC WKIPL
 STA MIXBUF,Y
 DEY
 JMP WKIMV
WKIPL
 LDA EVA
 STA MIXBUF,Y
 INX
 JMP WKISRT
WKISDN
* refresh STREC so a just-freed station
* (WEVDONE not yet drained) isn't seen busy
 JSR WSYNC_STA
* precheck a free station (STREC+0, STREC+4)
* before debiting crops - RERRFULL after
* OPWITHDRAW loses crops (debit-first fix)
 LDA STREC+0
 BEQ WKHAVST
 LDA STREC+4
 BEQ WKHAVST
* both busy -> STATIONS FULL, no debit
 LDA #0
 STA MIXN
 JSR CLRMSG
 LDA #<SFULL
 STA MSGPTR
 LDA #>SFULL
 STA MSGPTR+1
 LDA #0
 STA PRCOL
 LDY #21
 JSR PRSTR
 JSR WKDRAW
 RTS
WKHAVST
* per-crop needs from MIXBUF (0-3; $FF=pad)
* use Y as loop counter, TAX for INC NEEDW,X
 LDA #0
 STA NEEDW
 STA NEEDC
 STA NEEDB
 STA NEEDP
 LDY #0
WKNDLP
 LDA MIXBUF,Y
 CMP #4
 BCS WKNDNX
 TAX
 INC NEEDW,X
WKNDNX
 INY
 CPY #4
 BNE WKNDLP
* check CROP4 mirror covers needs
 LDX #0
WKCKLP
 LDA NEEDW,X
 BEQ WKCKNX
 CMP CROP4,X
 BEQ WKCKNX
 BCS WKNOCROP
WKCKNX
 INX
 CPX #4
 BNE WKCKLP
* debit each needed crop from farm mailbox
 LDX #0
WKDBLP
 LDA NEEDW,X
 BEQ WKDBNX
 STX EVT
 STA CMDA1
 STX CMDA0
 LDA #OPWDRAW
 STA CMDOP
 JSR SENDCMD
 LDX EVT
WKDBNX
 INX
 CPX #4
 BNE WKDBLP
 JMP WKCRAFT_GO
WKNOCROP
 LDA #0
 STA MIXN
 JSR CLRMSG
 LDA #<SNEEDS
 STA MSGPTR
 LDA #>SNEEDS
 STA MSGPTR+1
 LDA #0
 STA PRCOL
 LDY #21
 JSR PRSTR
 JSR WKDRAW
 RTS
WKCRAFT_GO
* send OPCRAFT
 LDA #WOPCRAFT
 STA CMDOP2
 LDA MIXBUF+0
 STA CMDA02
 LDA MIXBUF+1
 STA CMDA12
 LDA MIXBUF+2
 STA CMDA22
 LDA MIXBUF+3
 STA CMDA32
 LDA #0
 STA MIXN
 JSR WSENDCMD
 BCC WKCNT0
 JMP WKCRAFT_TO
WKCNT0
 CMP #ROK
 BEQ WKCRAFT_OK
 CMP #RRUIN
 BEQ WKCRAFT_RU
 CMP #RFAIL
 BEQ WKCRAFT_CF
 CMP #RERRCROP
 BEQ WKCRAFT_NC
 CMP #RERRFULL
 BNE WKCRAFT_OK
* stations full
 JSR CLRMSG
 LDA #<SFULL
 STA MSGPTR
 LDA #>SFULL
 STA MSGPTR+1
 LDA #0
 STA PRCOL
 LDY #21
 JSR PRSTR
 JMP WKCRAFT_UPD
WKCRAFT_NC
 JSR CLRMSG
 LDA #<SNEEDS
 STA MSGPTR
 LDA #>SNEEDS
 STA MSGPTR+1
 LDA #0
 STA PRCOL
 LDY #21
 JSR PRSTR
 JMP WKCRAFT_UPD
WKCRAFT_RU
 JSR CLRMSG
 LDA #<SRUINED
 STA MSGPTR
 LDA #>SRUINED
 STA MSGPTR+1
 LDA #0
 STA PRCOL
 LDY #21
 JSR PRSTR
 JMP WKCRAFT_UPD
WKCRAFT_CF
 JSR CLRMSG
 LDA #<SCFAIL
 STA MSGPTR
 LDA #>SCFAIL
 STA MSGPTR+1
 LDA #0
 STA PRCOL
 LDY #21
 JSR PRSTR
 JMP WKCRAFT_UPD
WKCRAFT_OK
 JSR CLRMSG
 LDA #<SCOOKING
 STA MSGPTR
 LDA #>SCOOKING
 STA MSGPTR+1
 LDA #0
 STA PRCOL
 LDY #21
 JSR PRSTR
 JMP WKCRAFT_UPD
WKCRAFT_TO
 JSR CLRMSG
 LDA #<SNORESP
 STA MSGPTR
 LDA #>SNORESP
 STA MSGPTR+1
 LDA #0
 STA PRCOL
 LDY #21
 JSR PRSTR
WKCRAFT_UPD
 JSR RDMKT
 JSR WSYNC
 JSR WKDRAW
 RTS

* === SHOPLOW: A=lowest unowned recipe
* idx, $FF if all owned ===
SHOPLOW
 LDX #0
SHLP
 TXA
 JSR DISCSET
 BEQ SHFOUND
 INX
 CPX #12
 BNE SHLP
 LDA #$FF
 RTS
SHFOUND
 TXA
 RTS
* === DISCSET: A=idx -> Z=1 not owned,
* Z=0 owned. 64-bit: byte=idx>>3. Uses NTMP. ===
DISCSET
 STA NTMP
 AND #7
 TAX
 LDA #1
DSSHL
 CPX #0
 BEQ DSMK
 ASL
 DEX
 JMP DSSHL
DSMK
 STA SHADV
 LDA NTMP
 LSR
 LSR
 LSR
 TAX
 LDA WDISCV,X
 AND SHADV
 RTS
* === CANAFFORD: C=1 if CASH >= T16 ===
CANAFFORD
 LDA CASHH
 CMP T16+1
 BCC CAFNO
 BNE CAFYES
 LDA CASHL
 CMP T16
 BCC CAFNO
CAFYES
 SEC
 RTS
CAFNO
 CLC
 RTS
* === SHOPBUY: buy lowest unowned recipe.
* debit-first refund on WOPLEARN reject ===
SHOPBUY
 JSR RDMKT
 JSR WSYNC
 JSR SHOPLOW
 STA SHOPIDX
 CMP #$FF
 BNE SHB1
 JSR CLRMSG
 LDA #<SALLOWN
 STA MSGPTR
 LDA #>SALLOWN
 STA MSGPTR+1
 LDA #0
 STA PRCOL
 LDY #21
 JSR PRSTR
 RTS
SHB1
 LDX SHOPIDX
 LDA RPRICEL,X
 STA T16
 LDA RPRICEH,X
 STA T16+1
 JSR CANAFFORD
 BCS SHB2
 JMP SHB_POOR
SHB2
* leg 1: farm OPSPEND(price)
 LDA #OPSPEND
 STA CMDOP
 LDX SHOPIDX
 LDA RPRICEL,X
 STA CMDA0
 LDA RPRICEH,X
 STA CMDA1
 LDA #0
 STA CMDA2
 JSR SENDCMD
 BCC SHB_NT
 JMP SHB_TO
SHB_NT
 CMP #ROK
 BEQ SHBL2
 CMP #RERRCASH
 BNE SHB_NTBAD
 JMP SHB_POOR
SHB_NTBAD
 JMP SHB_BADOP
SHBL2
* leg 2: workshop WOPLEARN(idx)
 LDA #WOPLEARN
 STA CMDOP2
 LDA SHOPIDX
 STA CMDA02
 LDA #0
 STA CMDA12
 STA CMDA22
 STA CMDA32
 JSR WSENDCMD
 BCC SHBLOK
 LDA #$FF
 STA ERRCODE
 JMP SHB_REFUND
SHBLOK
 STA ERRCODE
 CMP #ROK
 BNE SHB_REFUND
* success: LEARNED <name>
 JSR CLRMSG
 LDA #<SLEARN
 STA MSGPTR
 LDA #>SLEARN
 STA MSGPTR+1
 LDA #0
 STA PRCOL
 LDY #21
 JSR PRSTR
 LDX SHOPIDX
 LDA RNAML,X
 STA MSGPTR
 LDA RNAMH,X
 STA MSGPTR+1
 LDA #8
 STA PRCOL
 LDY #21
 JSR PRSTR
 JSR WSYNC
 RTS
SHB_REFUND
* WOPLEARN rejected -> refund
 LDA #OPADDC
 STA CMDOP
 LDX SHOPIDX
 LDA RPRICEL,X
 STA CMDA0
 LDA RPRICEH,X
 STA CMDA1
 LDA #0
 STA CMDA2
 JSR SENDCMD
 BCC SHB_ROK
 JMP SHB_TO
SHB_ROK
 JSR CLRMSG
 LDA #<SLERR
 STA MSGPTR
 LDA #>SLERR
 STA MSGPTR+1
 LDA #0
 STA PRCOL
 LDY #21
 JSR PRSTR
* 2 hex digits of WOPLEARN result at col 10
 LDY #21
 LDA GRLO,Y
 STA LINEP
 LDA GRHI,Y
 STA LINEP+1
 LDA ERRCODE
 LSR
 LSR
 LSR
 LSR
 JSR NIBA
 LDY #10
 STA (LINEP),Y
 LDA ERRCODE
 AND #$0F
 JSR NIBA
 LDY #11
 STA (LINEP),Y
 JSR WSYNC
 RTS
SHB_POOR
 JSR CLRMSG
 LDA #<SNEEDC
 STA MSGPTR
 LDA #>SNEEDC
 STA MSGPTR+1
 LDA #0
 STA PRCOL
 LDY #21
 JSR PRSTR
 RTS
SHB_TO
 JSR CLRMSG
 LDA #<SNORESP
 STA MSGPTR
 LDA #>SNORESP
 STA MSGPTR+1
 LDA #0
 STA PRCOL
 LDY #21
 JSR PRSTR
 RTS
SHB_BADOP
* OPSPEND returned non-cash err (stale farm
* blob lacks op) - tell user to ctrl-reset
 JSR CLRMSG
 LDA #<SBADOP
 STA MSGPTR
 LDA #>SBADOP
 STA MSGPTR+1
 LDA #0
 STA PRCOL
 LDY #21
 JSR PRSTR
 RTS
* === MKCLR: blank text rows 0-19 ===
MKCLR
 LDY #0
MKCROW
 TYA
 PHA
 LDA GRLO,Y
 STA LINEP
 LDA GRHI,Y
 STA LINEP+1
 LDA #$A0
 LDY #0
MKCCOL
 STA (LINEP),Y
 INY
 CPY #40
 BNE MKCCOL
 PLA
 TAY
 INY
 CPY #20
 BNE MKCROW
 RTS
* === MKDRAWROW: repaint ONE crop row ===
* NTMP=crop index 0-3; blanks row first.
MKDRAWROW
* compute row Y = NTMP*3+4
 LDA NTMP
 ASL
 CLC
 ADC NTMP
 CLC
 ADC #4
 TAY
 STY EVT ;EVT=row scratch
* blank 40 cols of this row
 LDA GRLO,Y
 STA LINEP
 LDA GRHI,Y
 STA LINEP+1
 LDA #$A0
 LDY #0
MDRCLR
 STA (LINEP),Y
 INY
 CPY #40
 BNE MDRCLR
* set LINEP for direct (LINEP),Y stores
 LDY EVT
 LDA GRLO,Y
 STA LINEP
 LDA GRHI,Y
 STA LINEP+1
* selection star col 0
 LDX NTMP
 CPX SELCROP
 BNE MKNOSEL
 LDA #$AA ; '*' hi-bit
 LDY #0
 STA (LINEP),Y
MKNOSEL
* key digit col 1
 LDA NTMP
 CLC
 ADC #$B1
 LDY #1
 STA (LINEP),Y
* name col 3
 LDX NTMP
 LDA SNAML,X
 STA MSGPTR
 LDA SNAMH,X
 STA MSGPTR+1
 LDA #3
 STA PRCOL
 LDY EVT
 JSR PRSTR
* cost col 12-14
 LDX NTMP
 LDA SEEDCT,X
 STA T16
 LDA #0
 STA T16+1
 LDX #12
 LDY EVT
 JSR PRDEC3
* price col 17-19
 LDX NTMP
 LDA PRICE4,X
 STA T16
 LDA #0
 STA T16+1
 LDX #17
 LDY EVT
 JSR PRDEC3
* trend glyph col 21 (LINEP at row EVT base)
 LDX NTMP
 LDA PRICE4,X
 CMP LASTP4,X
 BEQ MKTFL
 BCC MKTDN
 LDA #$AB ; '+'
 JMP MKTPUT
MKTDN
 LDA #$AD ; '-'
 JMP MKTPUT
MKTFL
 LDA #$BD ; '='
MKTPUT
 LDY #21
 STA (LINEP),Y
* seeds col 23-25
 LDX NTMP
 LDA SEED4,X
 STA T16
 LDA #0
 STA T16+1
 LDX #23
 LDY EVT
 JSR PRDEC3
* crops col 28-30
 LDX NTMP
 LDA CROP4,X
 STA T16
 LDA #0
 STA T16+1
 LDX #28
 LDY EVT
 JSR PRDEC3
 RTS
* === MKDRAW: full market repaint ===
* MKCLR + title + 4x MKDRAWROW + legend
MKDRAW
 JSR MKCLR
 LDA #<SMKT
 STA MSGPTR
 LDA #>SMKT
 STA MSGPTR+1
 LDA #15
 STA PRCOL
 LDY #1
 JSR PRSTR
* header row 3 col 3
 LDA #<SMHDR
 STA MSGPTR
 LDA #>SMHDR
 STA MSGPTR+1
 LDA #3
 STA PRCOL
 LDY #3
 JSR PRSTR
 LDA #0
 STA NTMP
MDRLP
 JSR MKDRAWROW
 INC NTMP
 LDA NTMP
 CMP #4
 BNE MDRLP
* row 16: recipe shop line
 JSR WSYNC
 JSR SHOPLOW
 STA SHOPIDX
 CMP #$FF
 BNE MKRSHOW
* all owned
 LDA #<SALLOWN
 STA MSGPTR
 LDA #>SALLOWN
 STA MSGPTR+1
 LDA #0
 STA PRCOL
 LDY #16
 JSR PRSTR
 JMP MKRDONE
MKRSHOW
 LDA #<SRECIPE
 STA MSGPTR
 LDA #>SRECIPE
 STA MSGPTR+1
 LDA #0
 STA PRCOL
 LDY #16
 JSR PRSTR
* recipe name at col 7
 LDX SHOPIDX
 LDA RNAML,X
 STA MSGPTR
 LDA RNAMH,X
 STA MSGPTR+1
 LDA #7
 STA PRCOL
 LDY #16
 JSR PRSTR
* price col 14: BUY nnn or NEED CASH
 LDX SHOPIDX
 LDA RPRICEL,X
 STA T16
 LDA RPRICEH,X
 STA T16+1
 JSR CANAFFORD
 BCC MKRPOOR
 LDA #<SBUYP
 STA MSGPTR
 LDA #>SBUYP
 STA MSGPTR+1
 LDA #14
 STA PRCOL
 LDY #16
 JSR PRSTR
 LDX #18
 LDY #16
 JSR PRDEC3
 JMP MKRDONE
MKRPOOR
 LDA #<SNEEDC
 STA MSGPTR
 LDA #>SNEEDC
 STA MSGPTR+1
 LDA #14
 STA PRCOL
 LDY #16
 JSR PRSTR
MKRDONE
* clear row 23, then market legend + cash
 LDX #23
 LDA GRLO,X
 STA LINEP
 LDA GRHI,X
 STA LINEP+1
 LDA #$A0
 LDY #0
MKR23LP
 STA (LINEP),Y
 INY
 CPY #40
 BNE MKR23LP
 LDA #<SMHELP
 STA MSGPTR
 LDA #>SMHELP
 STA MSGPTR+1
 LDA #0
 STA PRCOL
 LDY #23
 JSR PRSTR
 JSR HUDDRAW
 RTS

* recipe prices = 2 x value, 16-bit lo/hi
RPRICEL DFB 36,50,64,86,108,128,128,144
 DFB 224,238,238,254
RPRICEH DFB 0,0,0,0,0,0,0,0
 DFB 0,0,0,0
* RVALUE: goods display values (per-unit)
* MUST track RECTAB+5 - display only;
* cash from WORKTASK
RVALUE DFB 18,25,32,43,54,64,64,72
 DFB 112,119,119,127
* === RECTAB: recipe table 12x8 ===
* I0 I1 I2 I3 TIME VALUE RARITY PAD
RECTAB
 DFB 0,0,$FF,$FF,4,18,0,0
 DFB 0,1,$FF,$FF,2,25,0,0
 DFB 1,1,$FF,$FF,4,32,0,0
 DFB 0,2,$FF,$FF,4,43,1,0
 DFB 0,0,2,$FF,8,54,1,0
 DFB 2,2,$FF,$FF,4,64,1,0
 DFB 0,3,$FF,$FF,8,64,1,0
 DFB 1,3,$FF,$FF,8,72,1,0
 DFB 1,1,3,$FF,12,112,2,0
 DFB 0,2,3,$FF,12,119,2,0
 DFB 2,2,2,$FF,12,119,2,0
 DFB 0,1,2,3,20,127,3,0
* product names, 0-terminated, hi-ASCII
RNAMES ASC "BREAD"
 DFB 0
RNAME1 ASC "SALAD"
 DFB 0
RNAME2 ASC "SOUP"
 DFB 0
RNAME3 ASC "MUFFIN"
 DFB 0
RNAME4 ASC "CAKE"
 DFB 0
RNAME5 ASC "JAM"
 DFB 0
RNAME6 ASC "ROAST"
 DFB 0
RNAME7 ASC "STEW"
 DFB 0
RNAME8 ASC "CHOWDER"
 DFB 0
RNAME9 ASC "PIE"
 DFB 0
RNAMEA ASC "WINE"
 DFB 0
RNAMEB ASC "FEAST"
 DFB 0
RNAML DFB <RNAMES,<RNAME1,<RNAME2,<RNAME3
 DFB <RNAME4,<RNAME5,<RNAME6,<RNAME7
 DFB <RNAME8,<RNAME9,<RNAMEA,<RNAMEB
RNAMH DFB >RNAMES,>RNAME1,>RNAME2,>RNAME3
 DFB >RNAME4,>RNAME5,>RNAME6,>RNAME7
 DFB >RNAME8,>RNAME9,>RNAMEA,>RNAMEB
* === TRADE NPC tables (phase 2b) ===
* roster order: GROCER TRADER SEEDSHOP BULK
* EXOTIC BAKER. role (player POV) 0=sell to NPC
* (NPC=buyer) 1=buy from NPC (NPC=vendor)
NROLE DFB 0,0,1,1,1,0
NNIDX DFB 0,1,2,3,4,0
NICNT DFB 4,6,4,4,4,12
NIOFF DFB 0,4,10,14,18,22
* item curation: type 0=crop 1=good (34 items)
NITYP DFB 0,0,0,0
 DFB 0,0,1,1,1,1
 DFB 0,0,0,0
 DFB 0,0,0,0
 DFB 0,0,0,0
 DFB 1,1,1,1,1,1,1,1,1,1,1,1
NIIDX DFB 0,1,2,3
 DFB 2,3,8,9,10,11
 DFB 0,1,2,3
 DFB 0,1,2,3
 DFB 0,1,2,3
 DFB 0,1,2,3,4,5,6,7,8,9,10,11
* NPC name + role-hint strings (hi-ASCII)
TNGROC ASC "GROCER"
 DFB 0
TNTRAD ASC "TRADER"
 DFB 0
TNSEED ASC "SEEDSHOP"
 DFB 0
TNBULK ASC "BULK"
 DFB 0
TNEXOT ASC "EXOTIC"
 DFB 0
TNBAKE ASC "BAKER"
 DFB 0
THGROC ASC "BUYS CROPS"
 DFB 0
THTRAD ASC "BUYS RARE"
 DFB 0
THSEED ASC "SELLS SEEDS"
 DFB 0
THBULK ASC "CHEAP SEED"
 DFB 0
THEXOT ASC "RARE SEED"
 DFB 0
THBAKE ASC "BUYS GOODS"
 DFB 0
NNAML DFB <TNGROC,<TNTRAD,<TNSEED
 DFB <TNBULK,<TNEXOT,<TNBAKE
NNAMH DFB >TNGROC,>TNTRAD,>TNSEED
 DFB >TNBULK,>TNEXOT,>TNBAKE
NHNTL DFB <THGROC,<THTRAD,<THSEED
 DFB <THBULK,<THEXOT,<THBAKE
NHNTH DFB >THGROC,>THTRAD,>THSEED
 DFB >THBULK,>THEXOT,>THBAKE
TRTITL ASC "MARKET"
 DFB 0
TRPLEG ASC "RET=OPEN ESC=EXIT"
 DFB 0
LRDLB ASC "RET=BUY ESC=BACK"
 DFB 0
LRDLS ASC "RET=SELL ESC=BACK"
 DFB 0
HITEM ASC "ITEM"
 DFB 0
HOWN ASC "OWN"
 DFB 0
HCOST ASC "COST"
 DFB 0
HPAYS ASC "PAYS"
 DFB 0
SSD ASC "SD."
 DFB 0

* === INVENTER: inventory screen ===
INVENTER
 LDA #3
 STA SCREEN
 STA TEXTSW
 LDA #2
 STA INVPAGE
 LDA #0
 STA INVCUR
 STA INVOFF
 JSR RDMKT
 JSR WSYNC
 JSR INVDRAW
 RTS
* === INVEXIT: restore prior screen ===
INVEXIT
 LDA PREVSCR
 STA SCREEN
 CMP #0
 BNE INVX1
 STA GRAPH
 JSR DRAWALL
 JSR HUDDRAW
 RTS
INVX1
 STA TEXTSW
 CMP #1
 BNE INVX2
 JSR MKDRAW
 RTS
INVX2
 JSR WKDRAW
 RTS
* === INVCLRBOT: clear rows 20-23 ===
INVCLRBOT
 LDY #20
IVCBR
 LDA GRLO,Y
 STA LINEP
 LDA GRHI,Y
 STA LINEP+1
 TYA
 PHA
 LDY #0
 LDA #$A0
IVCBC
 STA (LINEP),Y
 INY
 CPY #40
 BNE IVCBC
 PLA
 TAY
 INY
 CPY #24
 BNE IVCBR
 RTS
* === INVCNT: A=count for INVPAGE ===
* page 0/1 -> 4, page 2 -> 12
INVCNT
 LDA INVPAGE
 CMP #2
 BEQ IVCGD
 LDA #4
 RTS
IVCGD
 LDA #12
 RTS
* === INVPGNAME: page name at row 0 col 12 ===
INVPGNAME
 LDA INVPAGE
 CMP #1
 BEQ IPGCROP
 CMP #2
 BEQ IPGGOOD
 LDA #<SPSEED
 STA MSGPTR
 LDA #>SPSEED
 STA MSGPTR+1
 JMP IPGPR
IPGCROP
 LDA #<SPCROP
 STA MSGPTR
 LDA #>SPCROP
 STA MSGPTR+1
 JMP IPGPR
IPGGOOD
 LDA #<SPGOOD
 STA MSGPTR
 LDA #>SPGOOD
 STA MSGPTR+1
IPGPR
 LDA #12
 STA PRCOL
 LDY #0
 JSR PRSTR
 RTS
* === INVHINTS: ^/v scroll hints ===
* ^ at row 1 if INVOFF>0
* v at row 22 if INVOFF+16 < count
INVHINTS
 LDA INVOFF
 BEQ IVHNO_U
 LDY #1
 LDA GRLO,Y
 STA LINEP
 LDA GRHI,Y
 STA LINEP+1
 LDA #$DE
 LDY #0
 STA (LINEP),Y
IVHNO_U
 JSR INVCNT
 STA NTMP
 LDA INVOFF
 CLC
 ADC #16
 CMP NTMP
 BCS IVHNO_D
 LDY #22
 LDA GRLO,Y
 STA LINEP
 LDA GRHI,Y
 STA LINEP+1
 LDA #$F6
 LDY #0
 STA (LINEP),Y
IVHNO_D
 RTS
* === INVROW: render item EVA on row EVB ===
* page 0: cropname col2 + SEED4 col11
* page 1: cropname col2 + CROP4 col11
*         + PRICE4 col16
* page 2: goodname col2 + WGOODS col11
*         + RVALUE col16
INVROW
 LDA INVPAGE
 CMP #2
 BEQ IVRGOOD
* pages 0/1: crop name at col 2
 LDX EVA
 LDA SNAML,X
 STA MSGPTR
 LDA SNAMH,X
 STA MSGPTR+1
 LDA #2
 STA PRCOL
 LDY EVB
 JSR PRSTR
* count at col 11
 LDX EVA
 LDA INVPAGE
 BEQ IVRSD
 LDA CROP4,X
 JMP IVRCNT
IVRSD
 LDA SEED4,X
IVRCNT
 STA T16
 LDA #0
 STA T16+1
 LDX #11
 LDY EVB
 JSR PRDEC3
* crops page: price at col 16
 LDA INVPAGE
 BEQ IVRDONE
 LDX EVA
 LDA PRICE4,X
 STA T16
 LDA #0
 STA T16+1
 LDX #16
 LDY EVB
 JSR PRDEC3
 JMP IVRDONE
IVRGOOD
* goods name at col 2
 LDX EVA
 LDA RNAML,X
 STA MSGPTR
 LDA RNAMH,X
 STA MSGPTR+1
 LDA #2
 STA PRCOL
 LDY EVB
 JSR PRSTR
* goods count at col 11
 LDX EVA
 LDA WGOODS,X
 STA T16
 LDA #0
 STA T16+1
 LDX #11
 LDY EVB
 JSR PRDEC3
* goods value at col 16
 LDX EVA
 LDA RVALUE,X
 STA T16
 LDA #0
 STA T16+1
 LDX #16
 LDY EVB
 JSR PRDEC3
IVRDONE
 RTS
* === INVDRAW: repaint inventory screen ===
INVDRAW
 JSR MKCLR
 JSR INVCLRBOT
* row 0: title
 LDA #<SINVT
 STA MSGPTR
 LDA #>SINVT
 STA MSGPTR+1
 LDA #0
 STA PRCOL
 LDY #0
 JSR PRSTR
 JSR INVPGNAME
 JSR CLRROW20
 JSR HUDCASH
* viewport rows 2..VROWS+1
 JSR INVCNT
 STA NTMP
 LDA #0
 STA EVT
IVDLP
 LDA EVT
 CMP #16
 BCS IVDDN
 CLC
 ADC INVOFF
 CMP NTMP
 BCS IVDNX2
 STA EVA
 LDA EVT
 CLC
 ADC #2
 STA EVB
* cursor '>' at col 0 if cursor row
 LDA INVOFF
 CLC
 ADC INVCUR
 CMP EVA
 BNE IVDNOC
 LDY EVB
 LDA GRLO,Y
 STA LINEP
 LDA GRHI,Y
 STA LINEP+1
 LDA #$BE
 LDY #0
 STA (LINEP),Y
IVDNOC
 JSR INVROW
IVDNX2
 INC EVT
 JMP IVDLP
IVDDN
 JSR INVHINTS
* row 23: legend
 LDA #<SINVLEG
 STA MSGPTR
 LDA #>SINVLEG
 STA MSGPTR+1
 LDA #0
 STA PRCOL
 LDY #23
 JSR PRSTR
 RTS
* === INVUP: scroll cursor up ===
INVUP
 LDA INVCUR
 BEQ IVUSC
 DEC INVCUR
 RTS
IVUSC
 LDA INVOFF
 BEQ IVUTOP
 DEC INVOFF
IVUTOP
 RTS
* === INVDOWN: scroll cursor down ===
INVDOWN
 JSR INVCNT
 STA NTMP
 LDA INVOFF
 CLC
 ADC INVCUR
 CLC
 ADC #1
 CMP NTMP
 BCS IVDBOT
 LDA INVCUR
 CMP #15
 BCC IVDINC
 INC INVOFF
 JMP IVDBOT
IVDINC
 INC INVCUR
IVDBOT
 RTS
* === INVSELLIT: sell selected item ===
INVSELLIT
 LDA INVOFF
 CLC
 ADC INVCUR
 STA INVSELL
 JSR CLRMSG
 LDA #<SQTYS
 STA MSGPTR
 LDA #>SQTYS
 STA MSGPTR+1
 LDA #0
 STA PRCOL
 LDY #21
 JSR PRSTR
 LDA #0
 STA QVAL
 STA QDIG
ISQKEY
 LDA KBD
 BPL ISQKEY
 STA KBDSTR
 CMP #$9B
 BNE ISQN1
 JSR CLRMSG
 RTS
ISQN1
 CMP #$8D
 BEQ ISQGO
 CMP #$B0
 BCC ISQKEY
 CMP #$BA
 BCS ISQKEY
 LDX QDIG
 CPX #3
 BCS ISQKEY
 CPX #2
 BNE ISQNOC
 PHA
 AND #$0F
 STA NTMP
 LDA QVAL
 CMP #26
 BCS ISQCREJ
 CMP #25
 BNE ISQCOK
 LDA NTMP
 CMP #6
 BCS ISQCREJ
ISQCOK
 PLA
 JMP ISQNOC
ISQCREJ
 PLA
 JMP ISQKEY
ISQNOC
 PHA
 LDY #21
 LDA GRLO,Y
 STA LINEP
 LDA GRHI,Y
 STA LINEP+1
 LDA LINEP
 CLC
 ADC #10
 STA LINEP
 LDA LINEP+1
 ADC #0
 STA LINEP+1
 PLA
 LDY QDIG
 STA (LINEP),Y
 AND #$0F
 PHA
 LDA QVAL
 ASL
 STA QVAL
 ASL
 ASL
 CLC
 ADC QVAL
 STA QVAL
 PLA
 CLC
 ADC QVAL
 STA QVAL
 INC QDIG
 JMP ISQKEY
ISQGO
 LDA QVAL
 BNE ISQGVLD
 JMP ISQCAN
ISQGVLD
 LDA INVPAGE
 CMP #1
 BEQ ISQCROP
 CMP #2
 BNE ISQCAN
 JMP ISQGOOD
ISQCAN
 JSR CLRMSG
 RTS
ISQCROP
* crops sell: OPSELL(abs, qty) via farm mbox
 LDA INVSELL
 STA CMDA0
 LDA QVAL
 STA CMDA1
 LDA #0
 STA CMDA2
 LDA #OPSELL
 STA CMDOP
 JSR SENDCMD
 BCS ISQTMO
 CMP #ROK
 BNE ISQERR
 JSR ISQSOLD
 RTS
ISQTMO
 JSR CLRMSG
 RTS
ISQERR
ISQWERR
 STA ERRCODE
 JSR CLRMSG
 LDA #<SERR
 STA MSGPTR
 LDA #>SERR
 STA MSGPTR+1
 LDA #0
 STA PRCOL
 LDY #21
 JSR PRSTR
 LDA ERRCODE
 LSR
 LSR
 LSR
 LSR
 JSR NIBA
 LDY #4
 STA (LINEP),Y
 LDA ERRCODE
 AND #$0F
 JSR NIBA
 LDY #5
 STA (LINEP),Y
 RTS
ISQGOOD
* goods sell: WOPCOLL(abs,qty) -> per-unit
* in WRES1V; //e multiplies then OPADDC
 LDA INVSELL
 STA CMDA02
 LDA QVAL
 STA CMDA12
 LDA #0
 STA CMDA22
 STA CMDA32
 LDA #WOPCOLL
 STA CMDOP2
 JSR WSENDCMD
 BCC ISQGWO
 JMP ISQTMO
ISQGWO
 CMP #ROK
 BNE ISQWERR
* total16 = QVAL * WRES1V (loop-add)
 LDA #0
 STA CNT
 STA CNT+1
 LDX QVAL
 BEQ ISQWS
ISQMUL
 LDA CNT
 CLC
 ADC WRES1V
 STA CNT
 LDA CNT+1
 ADC #0
 STA CNT+1
 DEX
 BNE ISQMUL
ISQWS
* OPADDC(total lo, total hi)
 LDA CNT
 STA CMDA0
 LDA CNT+1
 STA CMDA1
 LDA #0
 STA CMDA2
 LDA #OPADDC
 STA CMDOP
 JSR SENDCMD
 BCC ISQADO
 JMP ISQTMO
ISQADO
 JSR ISQSOLD
 RTS
ISQSOLD
 JSR RDMKT
 JSR WSYNC
 JSR INVDRAW
* SOLD message at row 21
 LDA #<SSOLD
 STA MSGPTR
 LDA #>SSOLD
 STA MSGPTR+1
 LDA #0
 STA PRCOL
 LDY #21
 JSR PRSTR
 RTS
* === INVKEY: inventory screen keys ===
* ESC: exit; up/dn: cursor; TAB: page;
* S: sell (seeds page: inert)
INVKEY
 CMP #$9B
 BNE INVK1
 JSR INVEXIT
 JMP MLOOP
INVK1
 CMP #$8B
 BNE INVK2
 JSR INVUP
 JSR INVDRAW
 JMP MLOOP
INVK2
 CMP #$8A
 BNE INVK3
 JSR INVDOWN
 JSR INVDRAW
 JMP MLOOP
INVK3
 CMP #$89
 BNE INVK4
 INC INVPAGE
 LDA INVPAGE
 CMP #3
 BNE INVKPG
 LDA #0
 STA INVPAGE
INVKPG
 LDA #0
 STA INVCUR
 STA INVOFF
 JSR INVDRAW
 JMP MLOOP
INVK4
 CMP #$D3
 BNE INVKNONE
 LDA INVPAGE
 BEQ INVKNONE
 JSR INVSELLIT
 JMP MLOOP
INVKNONE
 JMP MLOOP
* === TRENTER: -> text mode trade picker ===
TRENTER
 LDA #4
 STA SCREEN
 STA TEXTSW
 LDA #0
 STA TRNPC
 JSR TRPDRAW
 RTS
* === TREXIT: -> GR farm screen ===
TREXIT
 LDA #0
 STA SCREEN
 STA GRAPH
 JSR DRAWALL
 JSR HUDDRAW
 RTS
* === TRPDRAW: repaint NPC picker ===
TRPDRAW
 JSR MKCLR
 JSR INVCLRBOT
 LDA #<TRTITL
 STA MSGPTR
 LDA #>TRTITL
 STA MSGPTR+1
 LDA #12
 STA PRCOL
 LDY #1
 JSR PRSTR
 JSR HUDCASH
 LDA #0
 STA EVT
TPDLP
 LDA EVT
 CMP #6
 BCS TPDDN
 CLC
 ADC #2
 STA EVB
 LDA EVT
 CMP TRNPC
 BNE TPDNOC
 LDY EVB
 LDA GRLO,Y
 STA LINEP
 LDA GRHI,Y
 STA LINEP+1
 LDA #$BE
 LDY #0
 STA (LINEP),Y
TPDNOC
 LDX EVT
 LDA NNAML,X
 STA MSGPTR
 LDA NNAMH,X
 STA MSGPTR+1
 LDA #2
 STA PRCOL
 LDY EVB
 JSR PRSTR
 LDX EVT
 LDA NHNTL,X
 STA MSGPTR
 LDA NHNTH,X
 STA MSGPTR+1
 LDA #11
 STA PRCOL
 LDY EVB
 JSR PRSTR
 INC EVT
 JMP TPDLP
TPDDN
 LDA #<TRPLEG
 STA MSGPTR
 LDA #>TRPLEG
 STA MSGPTR+1
 LDA #0
 STA PRCOL
 LDY #23
 JSR PRSTR
 RTS
* === TRKEY: NPC picker keys ===
TRKEY
 CMP #$9B
 BNE TRK1
 JSR TREXIT
 JMP MLOOP
TRK1
 CMP #$8B
 BNE TRK2
 LDA TRNPC
 BEQ TRKLP
 DEC TRNPC
 JSR TRPDRAW
TRKLP
 JMP MLOOP
TRK2
 CMP #$8A
 BNE TRK3
 LDA TRNPC
 CMP #5
 BCS TRKLP2
 INC TRNPC
 JSR TRPDRAW
TRKLP2
 JMP MLOOP
TRK3
 CMP #$8D
 BNE TRKNON
 JSR TRDENTER
 JMP MLOOP
TRKNON
 JMP MLOOP
* === TRDENTER: -> text mode NPC drill-in ===
TRDENTER
 LDA #5
 STA SCREEN
 STA TEXTSW
 LDA #0
 STA TRCUR
 JSR RDMKT
 JSR WSYNC
 JSR TRDDRAW
 RTS
* === TRROW: render item TRROWN at row EVB ===
* also fills TRPC[TRROWN] with the price
TRROW
 LDX TRNPC
 LDA NIOFF,X
 CLC
 ADC TRROWN
 TAX
 LDA NITYP,X
 STA TRTYP
 LDA NIIDX,X
 STA TRIDX
 LDX TRNPC
 LDA NNIDX,X
 STA TRNI
 LDA TRTYP
 BNE TRRGN
 LDX TRIDX
 LDA SNAML,X
 STA MSGPTR
 LDA SNAMH,X
 STA MSGPTR+1
 JMP TRRNM
TRRGN
 LDX TRIDX
 LDA RNAML,X
 STA MSGPTR
 LDA RNAMH,X
 STA MSGPTR+1
TRRNM
 LDA #2
 STA PRCOL
 LDY EVB
 JSR PRSTR
* vendor crop = seed form: append SD. at col 8
 LDA TRTYP
 BNE TRRNT
 LDX TRNPC
 LDA NROLE,X
 BEQ TRRNT
 LDA #<SSD
 STA MSGPTR
 LDA #>SSD
 STA MSGPTR+1
 LDA #8
 STA PRCOL
 LDY EVB
 JSR PRSTR
TRRNT
* TRADER (NPC 1) mixes crops+goods: show c/g tag
 LDA TRNPC
 CMP #1
 BNE TRRHAV
 LDY EVB
 LDA GRLO,Y
 STA LINEP
 LDA GRHI,Y
 STA LINEP+1
 LDA TRTYP
 BNE TRRTG
 LDA #$E3
 JMP TRRTGW
TRRTG
 LDA #$E7
TRRTGW
 LDY #9
 STA (LINEP),Y
TRRHAV
 LDA TRTYP
 BNE TRRHGD
 LDX TRNPC
 LDA NROLE,X
 BNE TRRHSD
 LDX TRIDX
 LDA CROP4,X
 JMP TRRHST
TRRHSD
 LDX TRIDX
 LDA SEED4,X
 JMP TRRHST
TRRHGD
 LDX TRIDX
 LDA WGOODS,X
TRRHST
 STA T16
 LDA #0
 STA T16+1
 LDX #12
 LDY EVB
 JSR PRDEC3
 LDA TRTYP
 BNE TRRPGD
* price math also duplicated in TRADETICK -
* update both if layout/stride changes
* crop price addr = FNPC + NI*32 + IDX*2 (bank32)
 LDA TRNI
 ASL
 ASL
 ASL
 ASL
 ASL
 STA TRADL
 LDA TRIDX
 ASL
 CLC
 ADC TRADL
 STA TRADL
 LDA TRADL
 LDY #>FNPC
 JSR FRD
 JMP TRRPST
TRRPGD
* good price addr = WBNPC + NI*128 + IDX*2 (bank33)
 LDA #0
 STA TRADL
 LDA TRNI
 BEQ TRRPG0
 LDA #128
 STA TRADL
TRRPG0
 LDA TRIDX
 ASL
 CLC
 ADC TRADL
 STA TRADL
 LDA TRADL
 LDY #>WBNPC
 JSR WFRD
TRRPST
 LDA SDM_VAL
 STA TRPRV
 LDX TRROWN
 STA TRPC,X
 LDA TRPRV
 STA T16
 LDA #0
 STA T16+1
 LDX #17
 LDY EVB
 JSR PRDEC3
 RTS
* === TRDDRAW: repaint NPC drill-in ===
TRDDRAW
 JSR MKCLR
 JSR INVCLRBOT
 LDX TRNPC
 LDA NNAML,X
 STA MSGPTR
 LDA NNAMH,X
 STA MSGPTR+1
 LDA #0
 STA PRCOL
 LDY #0
 JSR PRSTR
 LDX TRNPC
 LDA NHNTL,X
 STA MSGPTR
 LDA NHNTH,X
 STA MSGPTR+1
 LDA #9
 STA PRCOL
 LDY #0
 JSR PRSTR
* column headers row 1
 LDA #<HITEM
 STA MSGPTR
 LDA #>HITEM
 STA MSGPTR+1
 LDA #2
 STA PRCOL
 LDY #1
 JSR PRSTR
 LDA #<HOWN
 STA MSGPTR
 LDA #>HOWN
 STA MSGPTR+1
 LDA #12
 STA PRCOL
 LDY #1
 JSR PRSTR
 LDX TRNPC
 LDA NROLE,X
 BEQ TDHPAY
 LDA #<HCOST
 STA MSGPTR
 LDA #>HCOST
 STA MSGPTR+1
 JMP TDHPW
TDHPAY
 LDA #<HPAYS
 STA MSGPTR
 LDA #>HPAYS
 STA MSGPTR+1
TDHPW
 LDA #17
 STA PRCOL
 LDY #1
 JSR PRSTR
 JSR HUDCASH
 LDA #0
 STA EVT
TDDLP
 LDX TRNPC
 LDA NICNT,X
 STA NTMP
 LDA EVT
 CMP NTMP
 BCS TDDDN
 STA TRROWN
 CLC
 ADC #2
 STA EVB
 LDA EVT
 CMP TRCUR
 BNE TDDNOC
 LDY EVB
 LDA GRLO,Y
 STA LINEP
 LDA GRHI,Y
 STA LINEP+1
 LDA #$BE
 LDY #0
 STA (LINEP),Y
TDDNOC
 JSR TRROW
 INC EVT
 JMP TDDLP
TDDDN
 LDX TRNPC
 LDA NROLE,X
 BEQ TDDLS
 LDA #<LRDLB
 STA MSGPTR
 LDA #>LRDLB
 STA MSGPTR+1
 JMP TDDLW
TDDLS
 LDA #<LRDLS
 STA MSGPTR
 LDA #>LRDLS
 STA MSGPTR+1
TDDLW
 LDA #0
 STA PRCOL
 LDY #23
 JSR PRSTR
 RTS
* === TRDKEY: NPC drill-in keys ===
TRDKEY
 CMP #$9B
 BNE TRDK1
* back to picker, keep cursor on this NPC
 LDA #4
 STA SCREEN
 STA TEXTSW
 JSR TRPDRAW
 JMP MLOOP
TRDK1
 CMP #$8B
 BNE TRDK2
 LDA TRCUR
 BEQ TRDKLP
 DEC TRCUR
 JSR TRDDRAW
TRDKLP
 JMP MLOOP
TRDK2
 CMP #$8A
 BNE TRDK3
 LDX TRNPC
 LDA NICNT,X
 STA NTMP
 LDA TRCUR
 CLC
 ADC #1
 CMP NTMP
 BCS TRDKLP2
 INC TRCUR
 JSR TRDDRAW
TRDKLP2
 JMP MLOOP
TRDK3
 CMP #$8D
 BNE TRDKNON
 JSR TRDSELL
 JMP MLOOP
TRDKNON
 JMP MLOOP
* === TRDSELL: arm op for selected item, prompt ===
TRDSELL
 LDX TRNPC
 LDA NIOFF,X
 CLC
 ADC TRCUR
 TAX
 LDA NITYP,X
 STA TRADETYP
 LDA NIIDX,X
 STA TRADEITEM
 LDX TRNPC
 LDA NNIDX,X
 STA TRADENPC
 LDA TRADETYP
 BEQ TRSCROP
 LDA #WOPTSELL
 STA TRADEOP
 JMP TRSPR
TRSCROP
 LDX TRNPC
 LDA NROLE,X
 BNE TRSBUY
 LDA #OPTSELL
 STA TRADEOP
 JMP TRSPR
TRSBUY
 LDA #OPTBUY
 STA TRADEOP
TRSPR
 LDA TRADEOP
 CMP #OPTBUY
 BEQ TRSPB
 LDA #<SQTYS
 STA MSGPTR
 LDA #>SQTYS
 STA MSGPTR+1
 JMP TQTYPROMPT
TRSPB
 LDA #<SQTYB
 STA MSGPTR
 LDA #>SQTYB
 STA MSGPTR+1
 JMP TQTYPROMPT
* === TRADEGO: qty in QVAL, op armed in TRADE* ===
TRADEGO
 LDA TRADETYP
 BNE TRGGOOD
 LDA TRADENPC
 STA CMDA0
 LDA TRADEITEM
 STA CMDA1
 LDA QVAL
 STA CMDA2
 LDA TRADEOP
 STA CMDOP
 JSR SENDCMD
 BCC TRGC1
 JMP TRGTMO
TRGC1
 CMP #ROK
 BEQ TRGCR1
 JMP TRGERR
TRGCR1
 JMP TRGOK
TRGGOOD
 LDA TRADENPC
 STA CMDA02
 LDA TRADEITEM
 STA CMDA12
 LDA QVAL
 STA CMDA22
 LDA #0
 STA CMDA32
 LDA #WOPTSELL
 STA CMDOP2
 JSR WSENDCMD
 BCC TRGW1
 JMP TRGTMO
TRGW1
 CMP #ROK
 BEQ TRGWR1
 JMP TRGERR
TRGWR1
 LDA #0
 STA CNT
 STA CNT+1
 LDX QVAL
 BEQ TRGADD
TRGMUL
 LDA CNT
 CLC
 ADC WRES1V
 STA CNT
 LDA CNT+1
 ADC #0
 STA CNT+1
 DEX
 BNE TRGMUL
TRGADD
 LDA CNT
 STA CMDA0
 LDA CNT+1
 STA CMDA1
 LDA #0
 STA CMDA2
 LDA #OPADDC
 STA CMDOP
 JSR SENDCMD
 BCC TRGOK
 JMP TRGTMO
TRGOK
 JSR RDMKT
 JSR WSYNC
 JSR TRDDRAW
 LDA TRADEOP
 CMP #OPTBUY
 BEQ TRGOKB
 LDA #<SSOLD
 STA MSGPTR
 LDA #>SSOLD
 STA MSGPTR+1
 JMP TRGOKP
TRGOKB
 LDA #<SBOUGHT
 STA MSGPTR
 LDA #>SBOUGHT
 STA MSGPTR+1
TRGOKP
 LDA #0
 STA PRCOL
 LDY #21
 JSR PRSTR
 RTS
TRGTMO
 JMP CLRMSG
TRGERR
 STA ERRCODE
 JSR CLRMSG
 LDA #<SERR
 STA MSGPTR
 LDA #>SERR
 STA MSGPTR+1
 LDA #0
 STA PRCOL
 LDY #21
 JSR PRSTR
 LDA ERRCODE
 LSR
 LSR
 LSR
 LSR
 JSR NIBA
 LDY #4
 STA (LINEP),Y
 LDA ERRCODE
 AND #$0F
 JSR NIBA
 LDY #5
 STA (LINEP),Y
 RTS

* === TRADETICK: drill-in live repaint on change ===
* recompute each visible row's price; if any differ
* from the TRPC cache, full TRDDRAW (refills cache)
TRADETICK
 LDA #0
 STA EVT
 STA TRKDRT
TTKLP
 LDX TRNPC
 LDA NICNT,X
 STA NTMP
 LDA EVT
 CMP NTMP
 BCC TTKCNT
 JMP TTKDN
TTKCNT
 STA TRROWN
 LDX TRNPC
 LDA NIOFF,X
 CLC
 ADC TRROWN
 TAX
 LDA NITYP,X
 STA TRTYP
 LDA NIIDX,X
 STA TRIDX
 LDX TRNPC
 LDA NNIDX,X
 STA TRNI
 LDA TRTYP
 BNE TTKGD
* crop addr FNPC+NI*32+IDX*2 - MUST MATCH TRROW
 LDA TRNI
 ASL
 ASL
 ASL
 ASL
 ASL
 STA TRADL
 LDA TRIDX
 ASL
 CLC
 ADC TRADL
 STA TRADL
 LDA TRADL
 LDY #>FNPC
 JSR FRD
 JMP TTKCMP
TTKGD
* good addr WBNPC+NI*128+IDX*2 - MUST MATCH TRROW
 LDA #0
 STA TRADL
 LDA TRNI
 BEQ TTKG0
 LDA #128
 STA TRADL
TTKG0
 LDA TRIDX
 ASL
 CLC
 ADC TRADL
 STA TRADL
 LDA TRADL
 LDY #>WBNPC
 JSR WFRD
TTKCMP
 LDX TRROWN
 LDA SDM_VAL
 CMP TRPC,X
 BEQ TTKNX
 LDA #1
 STA TRKDRT
TTKNX
 INC EVT
 JMP TTKLP
TTKDN
 LDA TRKDRT
 BEQ TTKRET
 JSR TRDDRAW
TTKRET
 RTS

 PUT FARMTASKB
 PUT WORKTASKB
