* GRVERSE.S - CONWAY MULTIVERSE GR RENDER
* HOST //e SIDE. ORG $6000. BRUN BIN.
* READS ONE UNIVERSE GRID FROM SDRAM AND
* BLITS IT TO LO-RES (40x48 BLOCKS).
* GRID ROW = 5 BYTES (ROWBYTES), 8 CELLS
* PER BYTE, BIT0 = LEFTMOST CELL.
* TEXT-PAGE BYTE = 2 STACKED BLOCKS:
*  LOW NIBBLE = TOP, HIGH NIBBLE = BOTTOM.
* TASK 3 = RENDER HALF. TASK 4 = SURF LOOP.
 TYP $06
 DSK GRVERSE.bin
 ORG $6000

 JMP MAIN
 PUT LIFEMAPGR
 PUT SDRAMLIB

* --- LO-RES SOFT SWITCHES ---
S80VOFF = $C00C
DHIROFF = $C05F
S80SOFF = $C000
PAGE2OF = $C054
GRAPH = $C050
LORES = $C056
FULLSC = $C052

* --- COPROC C4 LOAD/CALL PORTS (SLOT 4) ---
CP_RING = $C0C5
CP_LADLO = $C0C9
CP_LADHI = $C0CA
CP_WDATA = $C0CB

* --- KEYBOARD ---
KBD = $C000
KBDSTR = $C010

* --- ZP POINTERS (NON-PRODOS, TRANSIENT) ---
LINEP = $06
SRC = $08
PKL = $0A
PKV = $0C

* === RENDER STATE (INLINE STORAGE) ===
CHAN DS 1
GENB DS 1
GENA DS 1
LIVEBAS DS 2
PROD DS 1
MTMP DS 1
NTMP DS 1
RTOP DS 1
RBOT DS 1
COLBYTE DS 1
MASK DS 1
OUTB DS 1
YROW DS 1
GRLO DS 24
GRHI DS 24
GBUF DS 240
LASTGEN DS 1
CHGFLG DS 1
LFLO DS 1
LFHI DS 1
CNTLO DS 1
CNTHI DS 1
U DS 1

* === GRON: UNDO DHGR, THEN ENABLE LO-RES ===
GRON
 STA S80VOFF
 STA DHIROFF
 STA S80SOFF
 STA PAGE2OF
 STA GRAPH
 STA LORES
 STA FULLSC
 RTS

* === GRINIT: BUILD 24-ENTRY TEXT-LINE TABLE ===
* TEXTBASE(Y) = $400 + (Y&7)*$80 + (Y>>3)*$28
GRINIT
 LDX #0
GILP
 TXA
 AND #7
 STA NTMP
 LSR
 CLC
 ADC #4
 STA GRHI,X
 LDA NTMP
 AND #1
 BEQ GILO0
 LDA #$80
 JMP GISETL
GILO0
 LDA #0
GISETL
 STA GRLO,X
 TXA
 LSR
 LSR
 LSR
 TAY
 BEQ GIDONE
GIADD
 LDA GRLO,X
 CLC
 ADC #$28
 STA GRLO,X
 DEY
 BNE GIADD
GIDONE
 INX
 CPX #24
 BNE GILP
 RTS

* === GRCLR: ZERO 40 BYTES PER TEXT LINE ===
* USES LINE TABLE (SPARES SCREEN HOLES)
GRCLR
 LDX #0
GCROW
 LDA GRLO,X
 STA LINEP
 LDA GRHI,X
 STA LINEP+1
 LDY #0
 LDA #0
GCCOL
 STA (LINEP),Y
 INY
 CPY #GWIDTH
 BNE GCCOL
 INX
 CPX #24
 BNE GCROW
 RTS

* === RENDER: BLIT UNIVERSE CHAN TO GR ===
RENDER
RETRY
* READ GEN[CHAN] -> GENB
 LDA #MBANK
 STA SDM_BANK
 LDA #0
 STA SDM_BANK+1
 LDA #$20
 CLC
 ADC CHAN
 STA SDM_ADDR
 LDA #0
 STA SDM_ADDR+1
 JSR SDM_READ
 LDA SDM_VAL
 STA GENB
* READ FRONT[CHAN] -> LIVE BASE
 LDA #MBANK
 STA SDM_BANK
 LDA #0
 STA SDM_BANK+1
 LDA #$10
 CLC
 ADC CHAN
 STA SDM_ADDR
 LDA #0
 STA SDM_ADDR+1
 JSR SDM_READ
 LDA SDM_VAL
 BNE RFRONT
 LDA #<BUFA
 STA LIVEBAS
 LDA #>BUFA
 STA LIVEBAS+1
 JMP RBASEOK
RFRONT
 LDA #<BUFB
 STA LIVEBAS
 LDA #>BUFB
 STA LIVEBAS+1
RBASEOK
* GRID BANK = UBASE+CHAN, ADDR = LIVEBASE
 LDA #UBASE
 CLC
 ADC CHAN
 STA SDM_BANK
 LDA #0
 STA SDM_BANK+1
 JSR SDM_SETBANK
 LDA LIVEBAS
 STA SDM_ADDR
 LDA LIVEBAS+1
 STA SDM_ADDR+1
 JSR SDM_SETADDR
* READ 240 CONTIGUOUS GRID BYTES (48*5)
 LDY #0
RDGLP
 JSR SDM_RDNEXT
 LDA SDM_VAL
 STA GBUF,Y
 INY
 CPY #240
 BNE RDGLP
* RE-READ GEN[CHAN] -> GENA
 LDA #MBANK
 STA SDM_BANK
 LDA #0
 STA SDM_BANK+1
 LDA #$20
 CLC
 ADC CHAN
 STA SDM_ADDR
 LDA #0
 STA SDM_ADDR+1
 JSR SDM_READ
 LDA SDM_VAL
 STA GENA
 CMP GENB
 BEQ SNAPOK
 JMP RETRY
SNAPOK
* EXPAND: Y=0..23, X=0..39
 LDA #0
 STA YROW
EXROW
* RTOP = (2*YROW)*5, RBOT = RTOP+5
 LDA YROW
 ASL
 JSR MUL5
 LDA PROD
 STA RTOP
 CLC
 ADC #5
 STA RBOT
* LINEP = TEXTBASE(YROW)
 LDX YROW
 LDA GRLO,X
 STA LINEP
 LDA GRHI,X
 STA LINEP+1
 LDY #0
EXCOL
* COLBYTE = X>>3
 TYA
 LSR
 LSR
 LSR
 STA COLBYTE
* MASK = BIT (X&7)
 TYA
 AND #7
 TAX
 LDA BITMASK,X
 STA MASK
 LDA #0
 STA OUTB
* TOP CELL -> LOW NIBBLE
 LDA RTOP
 CLC
 ADC COLBYTE
 TAX
 LDA GBUF,X
 AND MASK
 BEQ EXTOP0
 LDA #$0F
 STA OUTB
EXTOP0
* BOTTOM CELL -> HIGH NIBBLE
 LDA RBOT
 CLC
 ADC COLBYTE
 TAX
 LDA GBUF,X
 AND MASK
 BEQ EXBOT0
 LDA OUTB
 ORA #$F0
 STA OUTB
EXBOT0
 LDA OUTB
 STA (LINEP),Y
 INY
 CPY #GWIDTH
 BNE EXCOL
 INC YROW
 LDA YROW
 CMP #24
 BNE EXROW
 RTS

* === MUL5: PROD = A * 5 (A*4 + A) ===
MUL5
 STA MTMP
 ASL
 ASL
 CLC
 ADC MTMP
 STA PROD
 RTS

* === MAIN: REGISTER, SEED, GO, SURF ===
MAIN
 JSR SDM_READY
 BCC MRDY
 RTS
MRDY
 JSR GRINIT
 JSR GRON
 JSR GRCLR
 JSR REGSKILL
 JSR SEED
 JSR GOLIFE
 LDA #0
 STA CHAN
 LDA #1
 STA CHGFLG
 JMP SURF

* === REGSKILL: load LSIM=0 LIFE8GR -> $0300 ===
* then TABLE[0]=$0300 (skill 0 entry)
REGSKILL
 LDA #$00
 STA CP_LADLO
 LDA #$03
 STA CP_LADHI
 LDA #<CSKILL
 STA SRC
 LDA #>CSKILL
 STA SRC+1
 LDA #<CSKLEN
 STA CNTLO
 LDA #>CSKLEN
 STA CNTHI
 LDY #0
RSLP
 LDA (SRC),Y
 STA CP_WDATA
 INC SRC
 BNE RSDEC
 INC SRC+1
RSDEC
 LDA CNTLO
 SEC
 SBC #1
 STA CNTLO
 LDA CNTHI
 SBC #0
 STA CNTHI
 ORA CNTLO
 BNE RSLP
* TABLE[0] lo/hi at coproc $0200 = $00/$03
 LDA #$00
 STA CP_LADLO
 LDA #$02
 STA CP_LADHI
 LDA #$00
 STA CP_WDATA
 LDA #$03
 STA CP_WDATA
 RTS

* === GOLIFE: stage slot-0 mailbox + ring ===
* skill_id=0 budget=0 (NO WATCHDOG) arg0=0
GOLIFE
 LDA #$80
 STA CP_LADLO
 LDA #$0F
 STA CP_LADHI
 LDA #$00
 STA CP_WDATA
 LDA #$00
 STA CP_WDATA
 LDA #$00
 STA CP_WDATA
 LDA #0
 STA CP_RING
 RTS

* === SEED: write 8 starting GR universes ===
* grid 40x48, 5 bytes/row, 8 cells/byte,
* bit0=leftmost. byte=row*5+(col>>3).
SEED
 LDA #0
 STA U
SEEDLP
 LDA #UBASE
 CLC
 ADC U
 STA SDM_BANK
 LDA #0
 STA SDM_BANK+1
 LDA #<BUFA
 STA SDM_ADDR
 LDA #>BUFA
 STA SDM_ADDR+1
 JSR SDM_SETBANK
 JSR SDM_SETADDR
 JSR ZEROF
 LDA U
 CMP #4
 BCC PATSEL
 JMP DOSOUP
PATSEL
 LDA U
 BNE SU1
 LDA #<G0LO
 STA PKL
 LDA #>G0LO
 STA PKL+1
 LDA #<G0VAL
 STA PKV
 LDA #>G0VAL
 STA PKV+1
 LDA #6
 STA CNTLO
 JSR POKE
 JMP SEEDZ
SU1
 CMP #1
 BNE SU2
 LDA #<G1LO
 STA PKL
 LDA #>G1LO
 STA PKL+1
 LDA #<G1VAL
 STA PKV
 LDA #>G1VAL
 STA PKV+1
 LDA #7
 STA CNTLO
 JSR POKE
 JMP SEEDZ
SU2
 CMP #2
 BNE SU3
 LDA #<G2LO
 STA PKL
 LDA #>G2LO
 STA PKL+1
 LDA #<G2VAL
 STA PKV
 LDA #>G2VAL
 STA PKV+1
 LDA #11
 STA CNTLO
 JSR POKE
 JMP SEEDZ
SU3
 LDA #<G3LO
 STA PKL
 LDA #>G3LO
 STA PKL+1
 LDA #<G3VAL
 STA PKV
 LDA #>G3VAL
 STA PKV+1
 LDA #3
 STA CNTLO
 JSR POKE
 JMP SEEDZ
DOSOUP
 JSR SOUPF
SEEDZ
 LDA #MBANK
 STA SDM_BANK
 LDA #0
 STA SDM_BANK+1
 LDA #$10
 CLC
 ADC U
 STA SDM_ADDR
 LDA #0
 STA SDM_ADDR+1
 LDA #0
 STA SDM_VAL
 JSR SDM_WRITE
 LDA #$20
 CLC
 ADC U
 STA SDM_ADDR
 LDA #0
 STA SDM_ADDR+1
 LDA #0
 STA SDM_VAL
 JSR SDM_WRITE
 INC U
 LDA U
 CMP #NUNIV
 BEQ SEEDDN
 JMP SEEDLP
SEEDDN
 RTS

* === ZEROF: zero 240 bytes (bank+addr set) ===
ZEROF
 LDA #0
 STA SDM_VAL
 LDX #240
ZFLP
 JSR SDM_WRNEXT
 DEX
 BNE ZFLP
 RTS

* === SOUPF: LFSR-fill 240 bytes (bank set) ===
SOUPF
 LDA #<BUFA
 STA SDM_ADDR
 LDA #>BUFA
 STA SDM_ADDR+1
 JSR SDM_SETADDR
 LDA U
 CLC
 ADC #$C5
 STA LFLO
 LDA U
 CLC
 ADC #$A0
 STA LFHI
 LDX #240
SFLP
 JSR NEXTRND
 LDA LFLO
 STA SDM_VAL
 JSR SDM_WRNEXT
 DEX
 BNE SFLP
 RTS

* === NEXTRND: 16-bit galois LFSR step ===
NEXTRND
 LSR LFHI
 ROR LFLO
 BCC NRNO
 LDA LFHI
 EOR #$B4
 STA LFHI
NRNO
 RTS

* === POKE: write CNTLO byte recs (bank set) ===
* PKL -> offset (0..239), PKV -> packed byte
POKE
 LDY #0
POKLP
 LDA (PKL),Y
 STA SDM_ADDR
 LDA #0
 STA SDM_ADDR+1
 LDA (PKV),Y
 STA SDM_VAL
 JSR SDM_WRITE
 INY
 CPY CNTLO
 BNE POKLP
 RTS

* === SURF: keyboard + gen-skip render ===
SURF
 LDA KBD
 BPL NOKEY
 STA KBDSTR
 CMP #$B0
 BCC CKARR
 CMP #$B8
 BCS CKARR
 SEC
 SBC #$B0
 STA CHAN
 JMP CHGED
CKARR
 CMP #$88
 BNE CKRGT
 LDA CHAN
 SEC
 SBC #1
 AND #$07
 STA CHAN
 JMP CHGED
CKRGT
 CMP #$95
 BNE NOKEY
 LDA CHAN
 CLC
 ADC #1
 AND #$07
 STA CHAN
CHGED
 LDA #1
 STA CHGFLG
NOKEY
 LDA #MBANK
 STA SDM_BANK
 LDA #0
 STA SDM_BANK+1
 LDA #$20
 CLC
 ADC CHAN
 STA SDM_ADDR
 LDA #0
 STA SDM_ADDR+1
 JSR SDM_READ
 LDA CHGFLG
 BNE DORND
 LDA SDM_VAL
 CMP LASTGEN
 BEQ SKIPR
DORND
 LDA #0
 STA CHGFLG
 JSR RENDER
 LDA GENA
 STA LASTGEN
SKIPR
 JMP SURF

* BIT0 = LEFTMOST CELL
BITMASK
 DFB $01,$02,$04,$08,$10,$20,$40,$80

* === GR SEED TABLES (OFFSET / PACKED BYTE) ===
* offsets recomputed for 5-byte rows, 8/byte
* U0: 2 gliders @ (r2,c2) (r20,c20)
G0LO
 DFB 10,15,20,102,107,112
G0VAL
 DFB $08,$10,$1C,$20,$40,$70
* U1: 2 gliders @ (r5,c30) (r30,c5)
G1LO
 DFB 28,34,38,39,150,155,160
G1VAL
 DFB $80,$01,$C0,$01,$40,$80,$E0
* U2: beacon @ (r5,c2) + 4 blinkers
G2LO
 DFB 25,30,35,40,51,102,107,112,153,154,200
G2VAL
 DFB $0C,$0C,$30,$30,$1C,$10,$10,$10,$C0,$01,$E0
* U3: r-pentomino centered (~r24,c20)
G3LO
 DFB 117,122,127
G3VAL
 DFB $30,$18,$10

 PUT LIFE8GRB
