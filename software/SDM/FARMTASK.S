* FARMTASK.S - FARM GAME COPROC TASK
* SKILL ID 2, ORG $2000, BUDGET=0 FOREVER.
* SOLE WRITER OF GBANK. SEI/CLI PER PORT BURST.
* EVERY PASS: MAILBOX. DIVIDED: GROW, MARKET.
 TYP $06
 DSK FARMTASK.bin
 ORG $2000
 PUT FARMEQU
* ABS SCRATCH (EVLIB USES $A000-$A005)
GROWC0 = $A010
GROWC1 = $A011
GROWC2 = $A012
MKTC0 = $A013
MKTC1 = $A014
MKTC2 = $A015
DECAYC = $A016
TOP = $A017
TA0 = $A018
TA1 = $A019
TA2 = $A01A
TRES = $A01B
* PLOTV: FSEEDS addr scratch / DOGROW byte1 temp
PLOTV = $A01C
PADRL = $A01D
PADRH = $A01E
PX = $A01F
PY = $A020
QTY = $A021
PRC = $A022
SUP = $A023
CSHL = $A024
CSHH = $A025
SEED = $A026
TGT = $A028
M20L = $A029
M20H = $A02A
LFSRL = $A02B
LFSRH = $A02C
HBV = $A02D
GTICK = $A02E
CROPI = $A02F
MKAL = $A030
MKAH = $A031
WP1L = $A032
WP1H = $A033
WPVAL = $A034

 JMP GAME

* === MAIN FOREVER LOOP ===
GAME
 JSR RELOADG
 JSR RELOADM
 LDA #0
 STA DECAYC
* seed LFSR non-zero (constant; entropy is
* the wall-clock sample phase at harvest)
 LDA #$C3
 STA LFSRL
 LDA #$A5
 STA LFSRH
 LDA #0
 STA GTICK
GLOOP
 JSR DOMBOX
* heartbeat liveness pulse
 INC HBV
 LDX HBV
 LDA #<FHBEAT
 LDY #>FHBEAT
 JSR WRB
 JSR NEXTRND
* growth 24-bit down-counter
 LDA GROWC0
 SEC
 SBC #1
 STA GROWC0
 LDA GROWC1
 SBC #0
 STA GROWC1
 LDA GROWC2
 SBC #0
 STA GROWC2
 ORA GROWC1
 ORA GROWC0
 BNE GNOG
 JSR DOGROW
 JSR RELOADG
GNOG
* market 24-bit down-counter
 LDA MKTC0
 SEC
 SBC #1
 STA MKTC0
 LDA MKTC1
 SBC #0
 STA MKTC1
 LDA MKTC2
 SBC #0
 STA MKTC2
 ORA MKTC1
 ORA MKTC0
 BNE GNOM
 JSR DOMKT
 JSR RELOADM
GNOM
 JMP GLOOP

RELOADG
 LDA #GROWD0
 STA GROWC0
 LDA #GROWD1
 STA GROWC1
 LDA #GROWD2
 STA GROWC2
 RTS
RELOADM
 LDA #MKTD0
 STA MKTC0
 LDA #MKTD1
 STA MKTC1
 LDA #MKTD2
 STA MKTC2
 RTS

* === NEXTRND: 16-bit Galois LFSR step ===
* free-running, stepped once per GLOOP pass
NEXTRND
 LSR LFSRH
 ROR LFSRL
 BCC NRNO
 LDA LFSRH
 EOR #$B4
 STA LFSRH
NRNO
 RTS
* (yield roll is an inline compare chain in
* CHARV - see HVROOM)

* === PORT HELPERS (PORTLIB) ===
 PUT PORTLIB

* === DOMBOX: consume one command if flagged ===
DOMBOX
 LDA #<FMFLAG
 LDY #>FMFLAG
 JSR RDB
 BNE MBGO
 RTS
MBGO
* read OP A0 A1 A2 (RDB sets addr per byte)
 LDA #<FMOP
 LDY #>FMOP
 JSR RDB
 STA TOP
 LDA #<FMA0
 LDY #>FMA0
 JSR RDB
 STA TA0
 LDA #<FMA1
 LDY #>FMA1
 JSR RDB
 STA TA1
 LDA #<FMA2
 LDY #>FMA2
 JSR RDB
 STA TA2
* dispatch
 LDA TOP
 BEQ CSTAT
 CMP #OPPLANT
 BEQ CPLANT
 CMP #OPHARV
 BEQ JCHARV
 CMP #OPSELL
 BEQ JSELL
 CMP #OPBUY
 BEQ JBUY
 CMP #OPWDRAW
 BEQ JWDRAW
 CMP #OPADDC
 BEQ JADDC
 CMP #OPSPEND
 BEQ JSPEND
 CMP #OPTSELL
 BEQ JOPTSL
 CMP #OPTBUY
 BEQ JOPTBY
 LDA #RERRBAD
 JMP MBFIN
JSELL
 JMP CSELL
JBUY
 JMP CBUY
JWDRAW
 JMP CWDRAW
JADDC
 JMP CADDC
JSPEND
 JMP CSPEND
JOPTSL
 JMP COPTSELL
JOPTBY
 JMP COPTBUY
JCHARV
 JMP CHARV
CSTAT
 LDA #ROK
 JMP MBFIN

* --- PLANT TA0=x TA1=y TA2=crop ---
CPLANT
 LDA TA2
 CMP #NCROPS
 BCC PLCROK
 LDA #RERRBAD
 JMP MBFIN
PLCROK
 JSR PLOTADR
* occupied? stage (byte1 low nibble) != 0
 JSR RDPLOT1
 AND #$0F
 BEQ PLOK
 LDA #RERROCC
 JMP MBFIN
PLOK
 LDA TA2
 CLC
 ADC #<FSEEDS
 STA PLOTV
 LDA PLOTV
 LDY #>FSEEDS
 JSR RDB
 BNE PLSEED
 LDA #RERRSEED
 JMP MBFIN
PLSEED
 SEC
 SBC #1
 TAX
 LDA PLOTV
 LDY #>FSEEDS
 JSR WRB
* 2-byte plot: byte0=crop, byte1=stage 1
 LDX TA2
 JSR WRPLOT
 LDX #1
 JSR WRPLOT1
 LDA #ROK
 JMP MBFIN

* --- HARVEST TA0=x TA1=y ---
CHARV
 JSR PLOTADR
* stage = byte1 low nibble; ripe?
 JSR RDPLOT1
 AND #$0F
 CMP #STRIPE
 BEQ HVOK
 LDA #RERRRIPE
 JMP MBFIN
HVOK
* crop id = byte0 -> CROPI, FCROPS+crop -> M20L
 JSR RDPLOT
 STA CROPI
 CLC
 ADC #<FCROPS
 STA M20L
; hi const $02 - breaks if FSEEDS/FCROPS cross a page
 LDA M20L
 LDY #>FCROPS
 JSR RDB
 CMP #$FF
 BNE HVROOM
 LDA #RERRFULL
 JMP MBFIN
HVROOM
* rare-yield roll on LFSR low byte:
*  $00 -> 0 (crop dies, ~0.4%)
*  16/32/64/128 -> 2 (~1.6%)
*  50/150 -> 3 (~0.8%)
*  else -> 1
 LDA LFSRL
 BEQ HVY0
 CMP #16
 BEQ HVY2
 CMP #32
 BEQ HVY2
 CMP #64
 BEQ HVY2
 CMP #128
 BEQ HVY2
 CMP #50
 BEQ HVY3
 CMP #150
 BEQ HVY3
 LDA #1
 JMP HVYSET
HVY0
 LDA #0
 JMP HVYSET
HVY2
 LDA #2
 JMP HVYSET
HVY3
 LDA #3
HVYSET
 STA QTY
 BEQ HVCLR
 LDA M20L
 LDY #>FCROPS
 JSR RDB
 CLC
 ADC QTY
 BCC HVNC
 LDA #$FF
HVNC
 TAX
 LDA M20L
 LDY #>FCROPS
 JSR WRB
HVCLR
 LDX #0
 JSR WRPLOT
 LDX #0 ; reload: WRPLOT clobbered X
 JSR WRPLOT1
 LDA #ROK
 JMP MBFIN

* --- SELL TA0=crop TA1=qty ---
CSELL
 LDA TA0
 CMP #NCROPS
 BCC SELCROK
 LDA #RERRBAD
 JMP MBFIN
SELCROK
 LDA TA1
 BNE CSELQ
 LDA #RERRBAD
 JMP MBFIN
CSELQ
 LDA TA0
 CLC
 ADC #<FCROPS
 STA M20L
; hi const $02 - breaks if FSEEDS/FCROPS cross a page
 LDA M20L
 LDY #>FCROPS
 JSR RDB
 CMP TA1
 BCS SLOK
 LDA #RERRCROP
 JMP MBFIN
SLOK
 SEC
 SBC TA1
 TAX
 LDA M20L
 LDY #>FCROPS
 JSR WRB
* cash += qty*price[crop] (loop), clamp $FFFF
 LDA TA0
 JSR MKADR
 LDA MKAL
 LDY MKAH
 JSR RDB
 STA PRC
 LDA #<FCASHL
 LDY #>FCASHL
 JSR RDB
 STA CSHL
 LDA #<FCASHH
 LDY #>FCASHH
 JSR RDB
 STA CSHH
 LDA TA1
 STA QTY
SLMUL
 LDA CSHL
 CLC
 ADC PRC
 STA CSHL
 LDA CSHH
 ADC #0
 STA CSHH
 BCC SLNC
 LDA #$FF
 STA CSHL
 STA CSHH
SLNC
 DEC QTY
 BNE SLMUL
 JSR WRCASH
* supply[crop] += qty clamp 255 (MKAL+2)
 LDA MKAL
 CLC
 ADC #2
 STA MKAL
 LDA MKAL
 LDY MKAH
 JSR RDB
 CLC
 ADC TA1
 BCC SPNC
 LDA #$FF
SPNC
 TAX
 LDA MKAL
 LDY MKAH
 JSR WRB
 LDA #ROK
 JMP MBFIN

* --- BUYSEED TA0=crop TA1=qty ---
CBUY
 LDA TA0
 CMP #NCROPS
 BCC BYCROK
 LDA #RERRBAD
 JMP MBFIN
BYCROK
 LDA TA1
 BNE CBUYQ
 LDA #RERRBAD
 JMP MBFIN
CBUYQ
* seeds slot addr -> PADRL (free here)
 LDA TA0
 CLC
 ADC #<FSEEDS
 STA PADRL
; hi const $02 - breaks if FSEEDS/FCROPS cross a page
 LDA PADRL
 LDY #>FSEEDS
 JSR RDB
 STA SEED
 CLC
 ADC TA1
 BCC BYROOM
 LDA #RERRFULL
 JMP MBFIN
BYROOM
* cost = qty * SEEDC[crop] -> M20L/H
 LDX TA0
 LDA SEEDC,X
 STA PRC
 LDA #0
 STA M20L
 STA M20H
 LDA TA1
 STA QTY
BYCST
 LDA M20L
 CLC
 ADC PRC
 STA M20L
 LDA M20H
 ADC #0
 STA M20H
 DEC QTY
 BNE BYCST
* cash >= cost?
 LDA #<FCASHL
 LDY #>FCASHL
 JSR RDB
 STA CSHL
 LDA #<FCASHH
 LDY #>FCASHH
 JSR RDB
 STA CSHH
 CMP M20H
 BCC BYPOOR
 BNE BYRICH
 LDA CSHL
 CMP M20L
 BCC BYPOOR
BYRICH
* full 16-bit subtract into scratch FIRST -
* never carry a borrow across a JSR
 LDA CSHL
 SEC
 SBC M20L
 STA CSHL
 LDA CSHH
 SBC M20H
 STA CSHH
 JSR WRCASH
 LDA SEED
 CLC
 ADC TA1
 TAX
 LDA PADRL
 LDY #>FSEEDS
 JSR WRB
 LDA #ROK
 JMP MBFIN
BYPOOR
 LDA #RERRCASH
 JMP MBFIN

* --- WITHDRAW TA0=crop TA1=qty ---
CWDRAW
 LDA TA0
 CMP #NCROPS
 BCC WDCROK
 LDA #RERRBAD
 JMP MBFIN
WDCROK
 LDA TA1
 BEQ WDBADQ
 LDA TA0
 CLC
 ADC #<FCROPS
 STA M20L
 LDA M20L
 LDY #>FCROPS
 JSR RDB
 CMP TA1
 BCC WDPOOR
 SEC
 SBC TA1
 TAX
 LDA M20L
 LDY #>FCROPS
 JSR WRB
 LDA #ROK
 JMP MBFIN
WDPOOR
 LDA #RERRCROP
 JMP MBFIN
WDBADQ
 LDA #RERRBAD
 JMP MBFIN

* --- ADDCASH TA0=lo TA1=hi, clamp $FFFF ---
CADDC
 LDA #<FCASHL
 LDY #>FCASHL
 JSR RDB
 STA CSHL
 LDA #<FCASHH
 LDY #>FCASHH
 JSR RDB
 STA CSHH
 LDA CSHL
 CLC
 ADC TA0
 STA CSHL
 LDA CSHH
 ADC TA1
 STA CSHH
 BCC ACNC
 LDA #$FF
 STA CSHL
 STA CSHH
ACNC
 JSR WRCASH
 LDA #ROK
 JMP MBFIN

* --- SPEND TA0=lo TA1=hi, RERRCASH if poor ---
CSPEND
 LDA #<FCASHL
 LDY #>FCASHL
 JSR RDB
 STA CSHL
 LDA #<FCASHH
 LDY #>FCASHH
 JSR RDB
 STA CSHH
* cash >= amount?
 LDA CSHH
 CMP TA1
 BCC SPPOOR
 BNE SPRICH
 LDA CSHL
 CMP TA0
 BCC SPPOOR
SPRICH
 LDA CSHL
 SEC
 SBC TA0
 STA CSHL
 LDA CSHH
 SBC TA1
 STA CSHH
 JSR WRCASH
 LDA #ROK
 JMP MBFIN
SPPOOR
 LDA #RERRCASH
 JMP MBFIN

* --- WRCASH: write CSHL->FCASHL, CSHH->FCASHH ---
WRCASH
 LDX CSHL
 LDA #<FCASHL
 LDY #>FCASHL
 JSR WRB
 LDX CSHH
 LDA #<FCASHH
 LDY #>FCASHH
 JSR WRB
 RTS

* --- MBFIN: A=result. RESULT then FLAG=0 ---
MBFIN
 TAX
 LDA #<FMRES
 LDY #>FMRES
 JSR WRB
 LDX #0
 LDA #<FMFLAG
 LDY #>FMFLAG
 JSR WRB
 RTS

* === PLOTADR: PADR = FGRID + TA1*20 + TA0 ===
* y*20 = y*16 + y*4, computed 16-BIT (19*16=304
* overflows 8 bits - corner test (19,19) guards)
PLOTADR
 LDA TA1
 STA M20L
 LDA #0
 STA M20H
 ASL M20L
 ROL M20H
 ASL M20L
 ROL M20H
* M20 = y*4, save copy in PADR
 LDA M20L
 STA PADRL
 LDA M20H
 STA PADRH
 ASL M20L
 ROL M20H
 ASL M20L
 ROL M20H
* M20 = y*16; add saved y*4
 LDA M20L
 CLC
 ADC PADRL
 STA M20L
 LDA M20H
 ADC PADRH
 STA M20H
* + x  (PADR = y*20 + x, 16-bit)
 LDA M20L
 CLC
 ADC TA0
 STA PADRL
 LDA M20H
 ADC #0
 STA PADRH
* itr4.1 2-byte plots: double the offset (16-bit;
* exceeds 255 past plot 128 - ASL would wrap)
 ASL PADRL
 ROL PADRH
* + FGRID base
 LDA PADRL
 CLC
 ADC #<FGRID
 STA PADRL
 LDA PADRH
 ADC #>FGRID
 STA PADRH
 RTS
RDPLOT
 LDA PADRL
 LDY PADRH
 JSR RDB
 RTS
WRPLOT
 LDA PADRL
 LDY PADRH
 JSR WRB
 RTS
* === RDPLOT1: A = byte1 (stage+flags) at PADR+1 ===
RDPLOT1
 LDA PADRL
 CLC
 ADC #1
 STA WP1L
 LDA PADRH
 ADC #0
 TAY
 LDA WP1L
 JSR RDB
 RTS
* === WRPLOT1: write X to byte1 at PADR+1 ===
WRPLOT1
 STX WPVAL
 LDA PADRL
 CLC
 ADC #1
 STA WP1L
 LDA PADRH
 ADC #0
 STA WP1H
 LDX WPVAL
 LDA WP1L
 LDY WP1H
 JSR WRB
 RTS

* === MKADR: A=crop -> MKAL/H = FMKT+crop*3 ===
MKADR
 STA CROPI
 ASL
 CLC
 ADC CROPI
 CLC
 ADC #<FMKT
 STA MKAL
 LDA #>FMKT ; hi const $02 - breaks if FMKT crosses a page
 STA MKAH
 RTS

* === DOGROW: advance plots due this tick ===
* GTICK++ each call; crop advances when
* (GTICK AND GROWM[crop]) == 0. PADR walks
* byte0 of each plot, stepping by 2.
DOGROW
 INC GTICK
 LDA #<FGRID
 STA PADRL
 LDA #>FGRID
 STA PADRH
 LDA #0
 STA PX
 STA PY
GRLP
* stage = byte1 (PADR+1)
 JSR RDPLOT1
 STA PLOTV
 AND #$0F
 BEQ GRNEXT
 CMP #STRIPE
 BCS GRNEXT
* crop = byte0 -> GROWM index
 LDA PADRL
 LDY PADRH
 JSR RDB
 TAX
 LDA GROWM,X
 AND GTICK
 BNE GRNEXT
* advance stage (low nibble +1, flags preserved)
 LDA PLOTV
 CLC
 ADC #1
 STA PLOTV
 TAX
 JSR WRPLOT1
 LDA PLOTV
 AND #$0F
 CMP #STRIPE
 BNE GRNEXT
* publish EV_RIPE x,y
 LDA #EVRIPE
 STA EVTYPE
 LDA PX
 STA EVP0
 LDA PY
 STA EVP1
 JSR PUTEV
GRNEXT
* step PADR by 2 (16-bit)
 LDA PADRL
 CLC
 ADC #2
 STA PADRL
 LDA PADRH
 ADC #0
 STA PADRH
 INC PX
 LDA PX
 CMP #GCOLS
 BNE GRLP
 LDA #0
 STA PX
 INC PY
 LDA PY
 CMP #GROWSN
 BNE GRLP
 RTS

* === DOMKT: per-crop price step + decay ===
DOMKT
 LDA #0
 STA CROPI
MKCROP
 LDA CROPI
 JSR MKADR
* read SUPPLY (MKAL+2) then PRICE (MKAL)
 LDA MKAL
 CLC
 ADC #2
 LDY MKAH
 JSR RDB
 STA SUP
 LDA MKAL
 LDY MKAH
 JSR RDB
 STA PRC
* TGT = BASEP[c] - SUP/2, floor PFLOOR
 LDX CROPI
 LDA BASEP,X
 STA TGT
 LDA SUP
 LSR
 STA PX
 LDA TGT
 SEC
 SBC PX
 BCC MKFLOOR
 CMP #PFLOOR
 BCS MKTGT
MKFLOOR
 LDA #PFLOOR
MKTGT
 STA TGT
* step PRICE 1 toward TGT, event on change
 LDA PRC
 CMP TGT
 BEQ MKDECAY
 BCC MKUP
 DEC PRC
 JMP MKWR
MKUP
 INC PRC
MKWR
 LDX PRC
 LDA MKAL
 LDY MKAH
 JSR WRB
* publish EV_PRICE crop, price lo
 LDA #EVPRICE
 STA EVTYPE
 LDA CROPI
 STA EVP0
 LDA PRC
 STA EVP1
 JSR PUTEV
MKDECAY
 INC CROPI
 LDA CROPI
 CMP #NCROPS
 BNE MKCROP
* supply decay: every DECAYDIV ticks, all crops
 INC DECAYC
 LDA DECAYC
 CMP #DECAYDIV
 BNE MKDONE
 LDA #0
 STA DECAYC
 STA CROPI
MKDCRP
 LDA CROPI
 JSR MKADR
 LDA MKAL
 CLC
 ADC #2
 STA MKAL
 LDA MKAL
 LDY MKAH
 JSR RDB
 BEQ MKDNXT
 SEC
 SBC #1
 TAX
 LDA MKAL
 LDY MKAH
 JSR WRB
MKDNXT
 INC CROPI
 LDA CROPI
 CMP #NCROPS
 BNE MKDCRP
MKDONE
 RTS

* --- OPTSELL TA0=npc TA1=crop TA2=qty ---
* sell crop to a purchaser at its current price,
* credit cash, drop the NPC price (saturation)
COPTSELL
 LDA TA0
 CMP #NCBUY
 BCC OSNOK
 LDA #RERRBAD
 JMP MBFIN
OSNOK
 LDA TA1
 CMP #NCROPS
 BCC OSCOK
 LDA #RERRBAD
 JMP MBFIN
OSCOK
 LDA TA2
 BNE OSQOK
 LDA #RERRBAD
 JMP MBFIN
OSQOK
 LDA TA0
 ASL
 ASL
 ASL
 ASL
 ASL
 STA CROPI
 LDA TA1
 ASL
 CLC
 ADC CROPI
 STA CROPI
 LDA TA1
 CLC
 ADC #<FCROPS
 STA PADRL
 LDA PADRL
 LDY #>FCROPS
 JSR RDB
 CMP TA2
 BCS OSINV
 LDA #RERRCROP
 JMP MBFIN
OSINV
 SEC
 SBC TA2
 TAX
 LDA PADRL
 LDY #>FCROPS
 JSR WRB
 LDA CROPI
 LDY #>FNPC
 JSR RDB
 STA PRC
 LDA #<FCASHL
 LDY #>FCASHL
 JSR RDB
 STA CSHL
 LDA #<FCASHH
 LDY #>FCASHH
 JSR RDB
 STA CSHH
 LDA TA2
 STA QTY
OSMUL
 LDA CSHL
 CLC
 ADC PRC
 STA CSHL
 LDA CSHH
 ADC #0
 STA CSHH
 BCC OSNC
 LDA #$FF
 STA CSHL
 STA CSHH
OSNC
 DEC QTY
 BNE OSMUL
 JSR WRCASH
 LDA PRC
 SEC
 SBC TA2
 BCC OSFL
 CMP #PFLOOR
 BCS OSWR
OSFL
 LDA #PFLOOR
OSWR
 TAX
 LDA CROPI
 LDY #>FNPC
 JSR WRB
 LDA #ROK
 JMP MBFIN
* --- OPTBUY TA0=npc TA1=crop TA2=qty ---
* buy seeds from a vendor at its price, debit
* cash, raise the NPC price (demand)
COPTBUY
 LDA TA0
 CMP #NCBUY
 BCS OBNOK
 LDA #RERRBAD
 JMP MBFIN
OBNOK
 LDA TA0
 CMP #NCNPC
 BCC OBN2
 LDA #RERRBAD
 JMP MBFIN
OBN2
 LDA TA1
 CMP #NCROPS
 BCC OBCOK
 LDA #RERRBAD
 JMP MBFIN
OBCOK
 LDA TA2
 BNE OBQOK
 LDA #RERRBAD
 JMP MBFIN
OBQOK
 LDA TA0
 ASL
 ASL
 ASL
 ASL
 ASL
 STA CROPI
 LDA TA1
 ASL
 CLC
 ADC CROPI
 STA CROPI
 LDA TA1
 CLC
 ADC #<FSEEDS
 STA PADRL
 LDA PADRL
 LDY #>FSEEDS
 JSR RDB
 STA SEED
 CLC
 ADC TA2
 BCC OBROOM
 LDA #RERRFULL
 JMP MBFIN
OBROOM
 LDA CROPI
 LDY #>FNPC
 JSR RDB
 STA PRC
 LDA #0
 STA M20L
 STA M20H
 LDA TA2
 STA QTY
OBCST
 LDA M20L
 CLC
 ADC PRC
 STA M20L
 LDA M20H
 ADC #0
 STA M20H
 DEC QTY
 BNE OBCST
 LDA #<FCASHL
 LDY #>FCASHL
 JSR RDB
 STA CSHL
 LDA #<FCASHH
 LDY #>FCASHH
 JSR RDB
 STA CSHH
 CMP M20H
 BCC OBPOOR
 BNE OBRICH
 LDA CSHL
 CMP M20L
 BCC OBPOOR
OBRICH
 LDA CSHL
 SEC
 SBC M20L
 STA CSHL
 LDA CSHH
 SBC M20H
 STA CSHH
 JSR WRCASH
 LDA SEED
 CLC
 ADC TA2
 TAX
 LDA PADRL
 LDY #>FSEEDS
 JSR WRB
 LDA PRC
 CLC
 ADC TA2
 BCC OBWR
 LDA #$FF
OBWR
 TAX
 LDA CROPI
 LDY #>FNPC
 JSR WRB
 LDA #ROK
 JMP MBFIN
OBPOOR
 LDA #RERRCASH
 JMP MBFIN
* per-crop profiles (blob-resident: hot loop)
GROWM DFB $00,$01,$03,$07 ;0=every 1/2/4/8th tick
BASEP DFB 8,14,24,40
SEEDC DFB 2,4,7,12

* CODE ENDS HERE. REGION $2000-$3FFF (8KB). SCRATCH AT $A000+.
 PUT EVLIB
