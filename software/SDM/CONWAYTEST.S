* CONWAYTEST.S - Conway/Life coproc self-test
* BRUN CONWAY_TEST. Seeds oracle patterns,
* rings the LIFE skill one gen (on-demand,
* deterministic), reads back + asserts.
* TEXT (LIFE8) + GR (LIFE8GR), LSIM=0 blobs.
* Mirrors FARM_TEST framework.
* Build: make conwaytest. Burn disk. BRUN.
 TYP $06
 DSK CONWAYTEST.bin
 ORG $2000
 JMP MAIN
 PUT FARMEQU
 PUT SDRAMLIB
 PUT CPLIB
* --- ZP (non-ProDOS transient) ---
SRC = $0C
MSGPTR = $0A
* --- SCRATCH (inline) ---
CNT DS 2
RSTWT DS 2
NPASS DS 1
NFAIL DS 1
TEXP DS 1
CVHND DS 1
* --- UNIVERSE CONSTANTS ---
UBASE = 16
CMBANK = 24
TBUFB = $4000
GBUFB = $0400
GBUFA = $0000
* --- MONITOR ---
HOME = $FC58
COUT = $FDED
CROUT = $FD8E

* === LRD: read bank UBASE(16) A=lo Y=hi ===
LRD
 STA SDM_ADDR
 STY SDM_ADDR+1
 LDA #UBASE
 STA SDM_BANK
 LDA #0
 STA SDM_BANK+1
 JSR SDM_READ
 RTS

* === LWR: write SDM_VAL to UBASE A=lo Y=hi ===
LWR
 STA SDM_ADDR
 STY SDM_ADDR+1
 LDA #UBASE
 STA SDM_BANK
 LDA #0
 STA SDM_BANK+1
 JSR SDM_WRITE
 RTS

* === MWR: write SDM_VAL to CMBANK A=lo Y=hi ===
MWR
 STA SDM_ADDR
 STY SDM_ADDR+1
 LDA #CMBANK
 STA SDM_BANK
 LDA #0
 STA SDM_BANK+1
 JSR SDM_WRITE
 RTS

* === LRDCHK: read UBASE A=lo Y=hi, cmp TEXP ===
LRDCHK
 JSR LRD
 LDA SDM_VAL
 CMP TEXP
 BEQ LRCKP
 JMP PRFAIL
LRCKP
 JMP PRPASS

* === RSTWAIT: poll CP_FSTAT bit 1 ===
RSTWAIT
 LDA #0
 STA RSTWT
 STA RSTWT+1
RSWLP
 LDA CP_FSTAT
 AND #2
 BNE RSWDN
 INC RSTWT
 BNE RSWLP
 INC RSTWT+1
 BNE RSWLP
RSWDN
 RTS

* === PRCHR: A=char -> COUT (set hi bit) ===
PRCHR
 ORA #$80
 JSR COUT
 RTS

* === PRNIB: A=nibble (0-15) -> hex char ===
PRNIB
 CLC
 ADC #$B0
 CMP #$BA
 BCC PRNBD
 ADC #6
PRNBD
 JMP COUT

* === PRHEX: A=byte -> 2 hex digits ===
PRHEX
 PHA
 LSR
 LSR
 LSR
 LSR
 JSR PRNIB
 PLA
 AND #$0F
 JMP PRNIB

* === PRMSG: print 0-term string at (MSGPTR) ===
PRMSG
 LDY #0
PMLP
 LDA (MSGPTR),Y
 BEQ PMDONE
 JSR COUT
 INY
 JMP PMLP
PMDONE
 RTS

* === PRPASS: INC NPASS, print "PASS " + label ===
PRPASS
 INC NPASS
 LDA #$D0
 JSR COUT
 LDA #$C1
 JSR COUT
 LDA #$D3
 JSR COUT
 LDA #$D3
 JSR COUT
 LDA #$A0
 JSR COUT
 JSR PRMSG
 JMP CROUT

* === PRFAIL: INC NFAIL, print "FAIL " + label ===
PRFAIL
 INC NFAIL
 LDA #$C6
 JSR COUT
 LDA #$C1
 JSR COUT
 LDA #$C9
 JSR COUT
 LDA #$CC
 JSR COUT
 LDA #$A0
 JSR COUT
 JSR PRMSG
 JMP CROUT

* === DOTEST: A=actual C=timeout TEXP=expected ===
DOTEST
 BCS DTFAIL
 CMP TEXP
 BEQ DTPASS
DTFAIL
 JMP PRFAIL
DTPASS
 JMP PRPASS

* === LOADLIFE: LSKILL -> coproc $0300 ===
* TABLE[0]=$0300 (LIFE8 forever)
* TABLE[1]=$0303 (LIFE1 single tick + DONE)
LOADLIFE
 LDA #$00
 STA CP_LADDRLO
 LDA #$03
 STA CP_LADDRHI
 LDA #<LSKILL
 STA SRC
 LDA #>LSKILL
 STA SRC+1
 LDA #<LSKLEN
 STA CNT
 LDA #>LSKLEN
 STA CNT+1
 LDY #0
LLLP
 LDA (SRC),Y
 STA CP_WDATA
 INC SRC
 BNE LLDC
 INC SRC+1
LLDC
 LDA CNT
 SEC
 SBC #1
 STA CNT
 LDA CNT+1
 SBC #0
 STA CNT+1
 ORA CNT
 BNE LLLP
* TABLE[0/1] at coproc $0200-$0203
 LDA #$00
 STA CP_LADDRLO
 LDA #$02
 STA CP_LADDRHI
 LDA #$00
 STA CP_WDATA
 LDA #$03
 STA CP_WDATA
 LDA #$03
 STA CP_WDATA
 LDA #$03
 STA CP_WDATA
 RTS

* === LOADLIFEGR: CSKILL -> coproc $0300 ===
* TABLE[0]=$0300 TABLE[1]=$0303 (same structure)
LOADLIFEGR
 LDA #$00
 STA CP_LADDRLO
 LDA #$03
 STA CP_LADDRHI
 LDA #<CSKILL
 STA SRC
 LDA #>CSKILL
 STA SRC+1
 LDA #<CSKLEN
 STA CNT
 LDA #>CSKLEN
 STA CNT+1
 LDY #0
LGRLP
 LDA (SRC),Y
 STA CP_WDATA
 INC SRC
 BNE LGDC
 INC SRC+1
LGDC
 LDA CNT
 SEC
 SBC #1
 STA CNT
 LDA CNT+1
 SBC #0
 STA CNT+1
 ORA CNT
 BNE LGRLP
 LDA #$00
 STA CP_LADDRLO
 LDA #$02
 STA CP_LADDRHI
 LDA #$00
 STA CP_WDATA
 LDA #$03
 STA CP_WDATA
 LDA #$03
 STA CP_WDATA
 LDA #$03
 STA CP_WDATA
 RTS

* === LIFETICK: ring skill 1 (LIFE1 one tick) ===
* Calls CP_CALL(skill=1,arg0=0,budget=0),
* CP_WAIT, CP_RESULT. C=1 if no slot free.
LIFETICK
 LDA #1
 LDX #0
 LDY #0
 JSR CP_CALL
 CMP #$FF
 BNE LTKWT
 LDA #<LLSPWN
 STA MSGPTR
 LDA #>LLSPWN
 STA MSGPTR+1
 JSR PRFAIL
 SEC
 RTS
LTKWT
 STA CVHND
 LDA CVHND
 JSR CP_WAIT
 LDA CVHND
 JSR CP_RESULT
 CLC
 RTS

* === SETMETA: FRONT[0]=0 GEN[0]=0 in CMBANK ===
SETMETA
 LDA #0
 STA SDM_VAL
 LDA #$10
 LDY #0
 JSR MWR
 LDA #$20
 LDY #0
 JSR MWR
 RTS

* === ZUBUF: zero $0320 bytes UBASE bufA ===
* covers rows 0-9 (10*80 bytes) of text grid
ZUBUF
 LDA #UBASE
 STA SDM_BANK
 LDA #0
 STA SDM_BANK+1
 JSR SDM_SETBANK
 LDA #0
 STA SDM_ADDR
 STA SDM_ADDR+1
 JSR SDM_SETADDR
 LDA #0
 STA SDM_VAL
 LDA #$20
 STA CNT
 LDA #$03
 STA CNT+1
ZULP
 JSR SDM_WRNEXT
 LDA CNT
 SEC
 SBC #1
 STA CNT
 LDA CNT+1
 SBC #0
 STA CNT+1
 ORA CNT
 BNE ZULP
 RTS

* === ZGRBUF: zero 240 bytes UBASE bufA (GR) ===
* covers all 48 GR rows (48*5 bytes)
ZGRBUF
 LDA #UBASE
 STA SDM_BANK
 LDA #0
 STA SDM_BANK+1
 JSR SDM_SETBANK
 LDA #0
 STA SDM_ADDR
 STA SDM_ADDR+1
 JSR SDM_SETADDR
 LDA #0
 STA SDM_VAL
 LDX #240
ZGLP
 JSR SDM_WRNEXT
 DEX
 BNE ZGLP
 RTS

* --- test label strings ---
LTITLE ASC "CONWAY_TEST"
 DFB 0
LLSPWN ASC "SPAWN"
 DFB 0
LLT1 ASC "TXT_BLA_R2"
 DFB 0
LLT2 ASC "TXT_BLB_R2"
 DFB 0
LLT3 ASC "TXT_GLI_R2B14"
 DFB 0
LLT4 ASC "TXT_GLI_R2B15"
 DFB 0
LLT5 ASC "TXT_BLA_R3"
 DFB 0
LLT6 ASC "TXT_BLB_R3"
 DFB 0
LLT7 ASC "TXT_GLI_R3B15"
 DFB 0
LLT8 ASC "TXT_BLA_R4"
 DFB 0
LLT9 ASC "TXT_BLB_R4"
 DFB 0
LLT10 ASC "TXT_GLI_R4B15"
 DFB 0
LLT11 ASC "TXT_TRS_R5"
 DFB 0
LLT12 ASC "TXT_TRS_R6"
 DFB 0
LLT13 ASC "TXT_TRS_R7"
 DFB 0
LLT14 ASC "TXT_BLB_DEAD"
 DFB 0
LLT15 ASC "TXT_TRS_DEAD"
 DFB 0
LLGA1 ASC "GRA_R1C11"
 DFB 0
LLGA2 ASC "GRA_R2C11"
 DFB 0
LLGA3 ASC "GRA_R3C11"
 DFB 0
LLGC1 ASC "GRC_R3C0"
 DFB 0
LLGC2 ASC "GRC_R4C0"
 DFB 0
LLGC3 ASC "GRC_R5C0"
 DFB 0
LLGB1 ASC "GRB_R3C8"
 DFB 0
LLGB2 ASC "GRB_R4C9"
 DFB 0
LLGB3 ASC "GRB_R5C7"
 DFB 0
LLGB4 ASC "GRB_R5C89"
 DFB 0

* === MAIN ===
MAIN
 JSR HOME
 LDA #<LTITLE
 STA MSGPTR
 LDA #>LTITLE
 STA MSGPTR+1
 JSR PRMSG
 JSR CROUT
 LDA #0
 STA NPASS
 STA NFAIL
 JSR RSTWAIT

* === TEXT ENGINE (LIFE8, LSIM=0) ===
* load text blob to $0300 + TABLE[0,1]
 JSR LOADLIFE

* --- zero rows 0-9 of bank16 bufA ---
 JSR ZUBUF

* --- seed oracle pattern ---
* glider r1b15: offset 95 = $5F
 LDA #$01
 STA SDM_VAL
 LDA #<GBUFA+95
 LDY #>GBUFA+95
 JSR LWR
* glider r2b15: offset 175 = $AF
 LDA #$02
 STA SDM_VAL
 LDA #<GBUFA+175
 LDY #>GBUFA+175
 JSR LWR
* blinkerB r3b0 bit6: offset 240 = $F0
 LDA #$40
 STA SDM_VAL
 LDA #<GBUFA+240
 LDY #>GBUFA+240
 JSR LWR
* blinkerB r3b1 bits0,1: offset 241 = $F1
 LDA #$03
 STA SDM_VAL
 LDA #<GBUFA+241
 LDY #>GBUFA+241
 JSR LWR
* blinkerA r3b2 bit6: offset 242 = $F2
 LDA #$40
 STA SDM_VAL
 LDA #<GBUFA+242
 LDY #>GBUFA+242
 JSR LWR
* blinkerA r3b3 bits0,1: offset 243 = $F3
 LDA #$03
 STA SDM_VAL
 LDA #<GBUFA+243
 LDY #>GBUFA+243
 JSR LWR
* glider r3b14 bit6: offset 254 = $FE
 LDA #$40
 STA SDM_VAL
 LDA #<GBUFA+254
 LDY #>GBUFA+254
 JSR LWR
* glider r3b15 bits0,1: offset 255 = $FF
 LDA #$03
 STA SDM_VAL
 LDA #<GBUFA+255
 LDY #>GBUFA+255
 JSR LWR
* torus col-seam r6b0 bits0,1: offset 480
 LDA #$03
 STA SDM_VAL
 LDA #<GBUFA+480
 LDY #>GBUFA+480
 JSR LWR
* torus col-seam r6b79 bit6: offset 559
 LDA #$40
 STA SDM_VAL
 LDA #<GBUFA+559
 LDY #>GBUFA+559
 JSR LWR

* set FRONT[0]=0 GEN[0]=0 then tick one gen
 JSR SETMETA
 JSR LIFETICK

* --- assert evolved cells in bufB ($4000) ---
* blinkerA col8 row2
 LDA #1
 STA TEXP
 LDA #<LLT1
 STA MSGPTR
 LDA #>LLT1
 STA MSGPTR+1
 LDA #<TBUFB+161
 LDY #>TBUFB+161
 JSR LRDCHK
* blinkerB col24 row2
 LDA #1
 STA TEXP
 LDA #<LLT2
 STA MSGPTR
 LDA #>LLT2
 STA MSGPTR+1
 LDA #<TBUFB+163
 LDY #>TBUFB+163
 JSR LRDCHK
* glider row2 byte14 bit6
 LDA #$40
 STA TEXP
 LDA #<LLT3
 STA MSGPTR
 LDA #>LLT3
 STA MSGPTR+1
 LDA #<TBUFB+174
 LDY #>TBUFB+174
 JSR LRDCHK
* glider row2 byte15 bit1
 LDA #$02
 STA TEXP
 LDA #<LLT4
 STA MSGPTR
 LDA #>LLT4
 STA MSGPTR+1
 LDA #<TBUFB+175
 LDY #>TBUFB+175
 JSR LRDCHK
* blinkerA col8 row3
 LDA #1
 STA TEXP
 LDA #<LLT5
 STA MSGPTR
 LDA #>LLT5
 STA MSGPTR+1
 LDA #<TBUFB+241
 LDY #>TBUFB+241
 JSR LRDCHK
* blinkerB col24 row3
 LDA #1
 STA TEXP
 LDA #<LLT6
 STA MSGPTR
 LDA #>LLT6
 STA MSGPTR+1
 LDA #<TBUFB+243
 LDY #>TBUFB+243
 JSR LRDCHK
* glider row3 byte15 bits0,1
 LDA #$03
 STA TEXP
 LDA #<LLT7
 STA MSGPTR
 LDA #>LLT7
 STA MSGPTR+1
 LDA #<TBUFB+255
 LDY #>TBUFB+255
 JSR LRDCHK
* blinkerA col8 row4
 LDA #1
 STA TEXP
 LDA #<LLT8
 STA MSGPTR
 LDA #>LLT8
 STA MSGPTR+1
 LDA #<TBUFB+321
 LDY #>TBUFB+321
 JSR LRDCHK
* blinkerB col24 row4
 LDA #1
 STA TEXP
 LDA #<LLT9
 STA MSGPTR
 LDA #>LLT9
 STA MSGPTR+1
 LDA #<TBUFB+323
 LDY #>TBUFB+323
 JSR LRDCHK
* glider row4 byte15 bit0 col120
 LDA #1
 STA TEXP
 LDA #<LLT10
 STA MSGPTR
 LDA #>LLT10
 STA MSGPTR+1
 LDA #<TBUFB+335
 LDY #>TBUFB+335
 JSR LRDCHK
* torus vertical col0 row5
 LDA #1
 STA TEXP
 LDA #<LLT11
 STA MSGPTR
 LDA #>LLT11
 STA MSGPTR+1
 LDA #<TBUFB+400
 LDY #>TBUFB+400
 JSR LRDCHK
* torus vertical col0 row6
 LDA #1
 STA TEXP
 LDA #<LLT12
 STA MSGPTR
 LDA #>LLT12
 STA MSGPTR+1
 LDA #<TBUFB+480
 LDY #>TBUFB+480
 JSR LRDCHK
* torus vertical col0 row7
 LDA #1
 STA TEXP
 LDA #<LLT13
 STA MSGPTR
 LDA #>LLT13
 STA MSGPTR+1
 LDA #<TBUFB+560
 LDY #>TBUFB+560
 JSR LRDCHK
* blinkerB seed should have died (offset 240 in bufB)
 LDA #0
 STA TEXP
 LDA #<LLT14
 STA MSGPTR
 LDA #>LLT14
 STA MSGPTR+1
 LDA #<TBUFB+240
 LDY #>TBUFB+240
 JSR LRDCHK
* torus seed r6b79 should be dead in bufB
 LDA #0
 STA TEXP
 LDA #<LLT15
 STA MSGPTR
 LDA #>LLT15
 STA MSGPTR+1
 LDA #<TBUFB+559
 LDY #>TBUFB+559
 JSR LRDCHK

* === GR ENGINE (LIFE8GR, LSIM=0) ===
* reload $0300 with GR blob (same TABLE[0,1])
 JSR LOADLIFEGR

* --- GR TEST A: interior horiz blinker ---
* seed: row2 byte1 = $1C (bits2,3,4=col10,11,12)
* expected after 1 tick: vertical at col11 rows1,2,3
 JSR ZGRBUF
 LDA #$1C
 STA SDM_VAL
 LDA #11
 LDY #0
 JSR LWR
 JSR SETMETA
 JSR LIFETICK
* check bufB ($0400)
 LDA #$08
 STA TEXP
 LDA #<LLGA1
 STA MSGPTR
 LDA #>LLGA1
 STA MSGPTR+1
 LDA #<GBUFB+6
 LDY #>GBUFB+6
 JSR LRDCHK
 LDA #$08
 STA TEXP
 LDA #<LLGA2
 STA MSGPTR
 LDA #>LLGA2
 STA MSGPTR+1
 LDA #<GBUFB+11
 LDY #>GBUFB+11
 JSR LRDCHK
 LDA #$08
 STA TEXP
 LDA #<LLGA3
 STA MSGPTR
 LDA #>LLGA3
 STA MSGPTR+1
 LDA #<GBUFB+16
 LDY #>GBUFB+16
 JSR LRDCHK

* --- GR TEST C: col-seam blinker ---
* seed: r4b4=$80(col39) r4b0=$03(col0,1)
* expected after 1 tick: vertical col0 rows3,4,5
 JSR ZGRBUF
 LDA #$80
 STA SDM_VAL
 LDA #24
 LDY #0
 JSR LWR
 LDA #$03
 STA SDM_VAL
 LDA #20
 LDY #0
 JSR LWR
 JSR SETMETA
 JSR LIFETICK
* check bufB ($0400)
 LDA #1
 STA TEXP
 LDA #<LLGC1
 STA MSGPTR
 LDA #>LLGC1
 STA MSGPTR+1
 LDA #<GBUFB+15
 LDY #>GBUFB+15
 JSR LRDCHK
 LDA #1
 STA TEXP
 LDA #<LLGC2
 STA MSGPTR
 LDA #>LLGC2
 STA MSGPTR+1
 LDA #<GBUFB+20
 LDY #>GBUFB+20
 JSR LRDCHK
 LDA #1
 STA TEXP
 LDA #<LLGC3
 STA MSGPTR
 LDA #>LLGC3
 STA MSGPTR+1
 LDA #<GBUFB+25
 LDY #>GBUFB+25
 JSR LRDCHK

* --- GR TEST B: glider 4 ticks -> bufA ---
* seed: (r2,c7)(r3,c8)(r4,c6)(r4,c7)(r4,c8)
* after 4 ticks: shifted +1row +1col in bufA($0000)
 JSR ZGRBUF
 LDA #$80
 STA SDM_VAL
 LDA #10
 LDY #0
 JSR LWR
 LDA #$01
 STA SDM_VAL
 LDA #16
 LDY #0
 JSR LWR
 LDA #$C0
 STA SDM_VAL
 LDA #20
 LDY #0
 JSR LWR
 LDA #$01
 STA SDM_VAL
 LDA #21
 LDY #0
 JSR LWR
 JSR SETMETA
* 4 ticks (even: live buffer returns to bufA)
 JSR LIFETICK
 JSR LIFETICK
 JSR LIFETICK
 JSR LIFETICK
* check bufA ($0000) for shifted glider
 LDA #$01
 STA TEXP
 LDA #<LLGB1
 STA MSGPTR
 LDA #>LLGB1
 STA MSGPTR+1
 LDA #<GBUFA+16
 LDY #>GBUFA+16
 JSR LRDCHK
 LDA #$02
 STA TEXP
 LDA #<LLGB2
 STA MSGPTR
 LDA #>LLGB2
 STA MSGPTR+1
 LDA #<GBUFA+21
 LDY #>GBUFA+21
 JSR LRDCHK
 LDA #$80
 STA TEXP
 LDA #<LLGB3
 STA MSGPTR
 LDA #>LLGB3
 STA MSGPTR+1
 LDA #<GBUFA+25
 LDY #>GBUFA+25
 JSR LRDCHK
 LDA #$03
 STA TEXP
 LDA #<LLGB4
 STA MSGPTR
 LDA #>LLGB4
 STA MSGPTR+1
 LDA #<GBUFA+26
 LDY #>GBUFA+26
 JSR LRDCHK

* === TALLY ===
MN_TAL
 JSR CROUT
 LDA #$D0
 JSR COUT
 LDA #$C1
 JSR COUT
 LDA #$D3
 JSR COUT
 LDA #$D3
 JSR COUT
 LDA #$BD
 JSR COUT
 LDA NPASS
 JSR PRHEX
 LDA #$A0
 JSR COUT
 LDA #$C6
 JSR COUT
 LDA #$C1
 JSR COUT
 LDA #$C9
 JSR COUT
 LDA #$CC
 JSR COUT
 LDA #$BD
 JSR COUT
 LDA NFAIL
 JSR PRHEX
 JSR CROUT
 RTS

* --- embedded blobs (LSIM=0 production) ---
 PUT LIFE8B
 PUT LIFE8GRB
