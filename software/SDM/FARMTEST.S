* FARMTEST.S - farm+workshop coproc self-test
* BRUN FARM_TEST. Prints PASS/FAIL per case.
* Spawns FARMTASK/WORKTASK, seeds known world,
* drives mailbox ops, prints PASS/FAIL + tally.
* Build: make farmtest. Burn disk. BRUN.
* Replaces slow Verilog farm/workshop tb.
* TWO-RUN RESET TEST:
*  Cold: BRUN -> full suite, leaves SIG+world.
*  Ctrl-Reset. Warm: BRUN -> reset-survival.
 TYP $06
 DSK FARMTEST.bin
 ORG $2000
 JMP MAIN
 PUT FARMEQU
 PUT SDRAMLIB
 PUT CPLIB
* --- ZP (NON-PRODOS TRANSIENT) ---
SRC = $0C
MSGPTR = $0A
* --- SCRATCH ---
TMO DS 2
CNT DS 2
RSTWT DS 2
CMDOP DS 1
CMDA0 DS 1
CMDA1 DS 1
CMDA2 DS 1
ERRCODE DS 1
CMDOP2 DS 1
CMDA02 DS 1
CMDA12 DS 1
CMDA22 DS 1
CMDA32 DS 1
WRES1V DS 1
TEXP DS 1
NPASS DS 1
NFAIL DS 1
HBTMP DS 1
POLLAL DS 1
POLLAH DS 1
POLLT DS 1
POLLC DS 2
* --- DRAIN / EVENT VARS ---
TAIL DS 1
EXPSEQ DS 1
NRIPE DS 1
NPRICE DS 1
REVX DS 1
REVY DS 1
LAPPED DS 1
RECLO DS 1
RSEQ DS 1
EVTT DS 1
EVPP0 DS 1
EVPP1 DS 1
* --- LAP LOOP VARS ---
LAPX DS 1
LAPY DS 1
LAPN DS 1
* --- MONITOR ENTRY POINTS ---
HOME = $FC58
COUT = $FDED
CROUT = $FD8E
* --- protocol helpers COPIED from FARM.S ---
* (keep in sync with FARM.S versions)

* === FRD: read GBANK, A=lo Y=hi -> SDM_VAL ===
FRD
 STA SDM_ADDR
 STY SDM_ADDR+1
 LDA #GBANK
 STA SDM_BANK
 LDA #0
 STA SDM_BANK+1
 JSR SDM_READ
 RTS

* === FWR: write SDM_VAL to GBANK, A=lo Y=hi ===
FWR
 STA SDM_ADDR
 STY SDM_ADDR+1
 LDA #GBANK
 STA SDM_BANK
 LDA #0
 STA SDM_BANK+1
 JSR SDM_WRITE
 RTS

* === WFRD: read WBANK, A=lo Y=hi -> SDM_VAL ===
WFRD
 STA SDM_ADDR
 STY SDM_ADDR+1
 LDA #WBANK
 STA SDM_BANK
 LDA #0
 STA SDM_BANK+1
 JSR SDM_READ
 RTS

* === WFWR: write SDM_VAL to WBANK, A=lo Y=hi ===
WFWR
 STA SDM_ADDR
 STY SDM_ADDR+1
 LDA #WBANK
 STA SDM_BANK
 LDA #0
 STA SDM_BANK+1
 JSR SDM_WRITE
 RTS

* === SENDCMD: caller stages CMDOP/CMDA0-2 ===
* Returns A=result C=1 timeout.
* Pre: FMFLAG=0. Timeout=$0000 wrap of
* 16-bit poll counter (~1-3s).
SENDCMD
 LDA #0
 STA TMO
 STA TMO+1
SCWAIT0
 LDA #<FMFLAG
 LDY #>FMFLAG
 JSR FRD
 LDA SDM_VAL
 BEQ SCWRITE
 INC TMO
 BNE SCWAIT0
 INC TMO+1
 BNE SCWAIT0
 SEC
 RTS
SCWRITE
 LDA CMDOP
 STA SDM_VAL
 LDA #<FMOP
 LDY #>FMOP
 JSR FWR
 LDA CMDA0
 STA SDM_VAL
 LDA #<FMA0
 LDY #>FMA0
 JSR FWR
 LDA CMDA1
 STA SDM_VAL
 LDA #<FMA1
 LDY #>FMA1
 JSR FWR
 LDA CMDA2
 STA SDM_VAL
 LDA #<FMA2
 LDY #>FMA2
 JSR FWR
 LDA #1
 STA SDM_VAL
 LDA #<FMFLAG
 LDY #>FMFLAG
 JSR FWR
* poll flag clear (task clears when done)
 LDA #0
 STA TMO
 STA TMO+1
SCPOLL
 LDA #<FMFLAG
 LDY #>FMFLAG
 JSR FRD
 LDA SDM_VAL
 BEQ SCRES
 INC TMO
 BNE SCPOLL
 INC TMO+1
 BNE SCPOLL
 SEC
 RTS
SCRES
 LDA #<FMRES
 LDY #>FMRES
 JSR FRD
 LDA SDM_VAL
 CLC
 RTS

* === WSENDCMD: workshop mailbox cmd ===
* CMDOP2/CMDA02-32 staged by caller.
* Returns A=result WRES1V=RES1 C=1 timeout.
WSENDCMD
 LDA #0
 STA TMO
 STA TMO+1
WSCWT
 LDA #<WBFLAG
 LDY #>WBFLAG
 JSR WFRD
 LDA SDM_VAL
 BEQ WSCWR
 INC TMO
 BNE WSCWT
 INC TMO+1
 BNE WSCWT
 SEC
 RTS
WSCWR
 LDA CMDOP2
 STA SDM_VAL
 LDA #<WBOP
 LDY #>WBOP
 JSR WFWR
 LDA CMDA02
 STA SDM_VAL
 LDA #<WBI0
 LDY #>WBI0
 JSR WFWR
 LDA CMDA12
 STA SDM_VAL
 LDA #<WBI1
 LDY #>WBI1
 JSR WFWR
 LDA CMDA22
 STA SDM_VAL
 LDA #<WBI2
 LDY #>WBI2
 JSR WFWR
 LDA CMDA32
 STA SDM_VAL
 LDA #<WBI3
 LDY #>WBI3
 JSR WFWR
 LDA #1
 STA SDM_VAL
 LDA #<WBFLAG
 LDY #>WBFLAG
 JSR WFWR
 LDA #0
 STA TMO
 STA TMO+1
WSCPL
 LDA #<WBFLAG
 LDY #>WBFLAG
 JSR WFRD
 LDA SDM_VAL
 BEQ WSCRES
 INC TMO
 BNE WSCPL
 INC TMO+1
 BNE WSCPL
 SEC
 RTS
WSCRES
 LDA #<WBRES
 LDY #>WBRES
 JSR WFRD
 LDA SDM_VAL
 PHA
 LDA #<WBRES1
 LDY #>WBRES1
 JSR WFRD
 LDA SDM_VAL
 STA WRES1V
 PLA
 CLC
 RTS

* === RSTWAIT: poll CP_FSTAT bit 1 ===
* 16-bit counter RSTWT (not ZP)
RSTWAIT
 LDA #0
 STA RSTWT
 STA RSTWT+1
RSWLP
 LDA CP_FSTAT
 AND #2
 BNE RSWDN
 INC RSTWT
 BNE RSWLP
 INC RSTWT+1
 BNE RSWLP
RSWDN
 RTS

* === LOADBLOB: FSKILL -> coproc $2000 ===
LOADBLOB
 LDA #$00
 STA CP_LADDRLO
 LDA #$20
 STA CP_LADDRHI
 LDA #<FSKILL
 STA SRC
 LDA #>FSKILL
 STA SRC+1
 LDA #<FSKLEN
 STA CNT
 LDA #>FSKLEN
 STA CNT+1
 LDY #0
LBLP
 LDA (SRC),Y
 STA CP_WDATA
 INC SRC
 BNE LBDEC
 INC SRC+1
LBDEC
 LDA CNT
 SEC
 SBC #1
 STA CNT
 LDA CNT+1
 SBC #0
 STA CNT+1
 ORA CNT
 BNE LBLP
 RTS

* === LOADWBLOB: WSKILL -> coproc $4000 ===
LOADWBLOB
 LDA #$00
 STA CP_LADDRLO
 LDA #$40
 STA CP_LADDRHI
 LDA #<WSKILL
 STA SRC
 LDA #>WSKILL
 STA SRC+1
 LDA #<WSKLEN
 STA CNT
 LDA #>WSKLEN
 STA CNT+1
 LDY #0
WBLP
 LDA (SRC),Y
 STA CP_WDATA
 INC SRC
 BNE WBDEC
 INC SRC+1
WBDEC
 LDA CNT
 SEC
 SBC #1
 STA CNT
 LDA CNT+1
 SBC #0
 STA CNT+1
 ORA CNT
 BNE WBLP
 RTS

* === LOADF: farm blob $2000 + TABLE[2] poke ===
LOADF
 JSR LOADBLOB
 LDA #$04
 STA CP_LADDRLO
 LDA #$02
 STA CP_LADDRHI
 LDA #$00
 STA CP_WDATA
 LDA #$20
 STA CP_WDATA
 RTS

* === RINGF: raw ring slot 0 (farm task) ===
* C=0 always
RINGF
 LDA #0
 STA CP_RING
 CLC
 RTS

* === LOADW: workshop blob $4000 + TABLE[3] ===
LOADW
 JSR LOADWBLOB
 LDA #$06
 STA CP_LADDRLO
 LDA #$02
 STA CP_LADDRHI
 LDA #$00
 STA CP_WDATA
 LDA #$40
 STA CP_WDATA
 RTS

* === RINGW: raw ring slot 1 (workshop task) ===
* C=0 always
RINGW
 LDA #1
 STA CP_RING
 CLC
 RTS

* === STAGEF: stage slot 0 mailbox ===
* skill 2, budget 0, arg0 0 (farm task)
STAGEF
 LDA #$80
 STA CP_LADDRLO
 LDA #$0F
 STA CP_LADDRHI
 LDA #2
 STA CP_WDATA
 LDA #0
 STA CP_WDATA
 STA CP_WDATA
 RTS

* === STAGEW: stage slot 1 mailbox ===
* skill 3, budget 0, arg0 0 (workshop task)
STAGEW
 LDA #$A0
 STA CP_LADDRLO
 LDA #$0F
 STA CP_LADDRHI
 LDA #3
 STA CP_WDATA
 LDA #0
 STA CP_WDATA
 STA CP_WDATA
 RTS

* --- test framework ---

* PRCHR: A=ascii char -> COUT (sets hi bit)
PRCHR
 ORA #$80
 JSR COUT
 RTS

* PRNIB: A=nibble (0-15) -> print hex digit
PRNIB
 CLC
 ADC #$B0
 CMP #$BA
 BCC PRNBD
 ADC #6
PRNBD
 JMP COUT

* PRHEX: A=byte -> print 2 hex digits
PRHEX
 PHA
 LSR
 LSR
 LSR
 LSR
 JSR PRNIB
 PLA
 AND #$0F
 JMP PRNIB

* PRMSG: print 0-term hi-ASCII at (MSGPTR)
PRMSG
 LDY #0
PMLP
 LDA (MSGPTR),Y
 BEQ PMDONE
 JSR COUT
 INY
 JMP PMLP
PMDONE
 RTS

* PRPASS: INC NPASS, print "PASS ", PRMSG, CROUT
* MSGPTR must point to test label string.
PRPASS
 INC NPASS
 LDA #$D0
 JSR COUT
 LDA #$C1
 JSR COUT
 LDA #$D3
 JSR COUT
 LDA #$D3
 JSR COUT
 LDA #$A0
 JSR COUT
 JSR PRMSG
 JMP CROUT

* PRFAIL: INC NFAIL, print "FAIL ", PRMSG, CROUT
* MSGPTR must point to test label string.
PRFAIL
 INC NFAIL
 LDA #$C6
 JSR COUT
 LDA #$C1
 JSR COUT
 LDA #$C9
 JSR COUT
 LDA #$CC
 JSR COUT
 LDA #$A0
 JSR COUT
 JSR PRMSG
 JMP CROUT

* DOTEST: A=actual, C=timeout, TEXP=expected
* MSGPTR set to test label. Tail-calls PRPASS/PRFAIL.
DOTEST
 BCS DTFAIL
 CMP TEXP
 BEQ DTPASS
DTFAIL
 JMP PRFAIL
DTPASS
 JMP PRPASS

* FRDCHK: read GBANK, A=lo Y=hi, compare SDM_VAL
* to TEXP. MSGPTR set. Tail-calls PRPASS/PRFAIL.
FRDCHK
 JSR FRD
 LDA SDM_VAL
 CMP TEXP
 BEQ FRDCKP
 JMP PRFAIL
FRDCKP
 JMP PRPASS

* WRDCHK: read WBANK, A=lo Y=hi, compare SDM_VAL
* to TEXP. MSGPTR set. Tail-calls PRPASS/PRFAIL.
WRDCHK
 JSR WFRD
 LDA SDM_VAL
 CMP TEXP
 BEQ WRDCKP
 JMP PRFAIL
WRDCKP
 JMP PRPASS

* POLLRIP: poll byte1 (POLLAL/POLLAH) low nibble
* until == POLLT, or 16-bit POLLC wrap.
* C=0 reached target, C=1 timeout.
POLLRIP
 LDA #0
 STA POLLC
 STA POLLC+1
PRPLP
 LDA POLLAL
 LDY POLLAH
 JSR FRD
 LDA SDM_VAL
 AND #$0F
 CMP POLLT
 BEQ PRPOK
 INC POLLC
 BNE PRPLP
 INC POLLC+1
 BNE PRPLP
 SEC
 RTS
PRPOK
 CLC
 RTS

* === SETUP: seed both banks + init drain + spawn ===
* === TEST FIXTURE - resource map ===
* plots: (3,3)(19,19) basic plant
*  (10,10)(11,11)(12,12) ripen/divergence
*  (0,0) EV_RIPE drain-poll (case 31)
*  rows 5-8 (0-19) lap test (70 plots)
* crop0=wheat SEEDS depleted by plants
*  crop1=carrot (buy) crop3=pumpkin
*  (SEEDS[3]=254 overflow + divergence)
* SIG "FM"+CVER seeded -> lap SIG-survival
*  + reset warm-detect
* Returns C=0 success, C=1 spawn fail.
SETUP
 JSR RSTWAIT
* seed GBANK zero $0000-$0AFF
 LDA #GBANK
 STA SDM_BANK
 LDA #0
 STA SDM_BANK+1
 JSR SDM_SETBANK
 LDA #0
 STA SDM_ADDR
 STA SDM_ADDR+1
 JSR SDM_SETADDR
 LDA #0
 STA SDM_VAL
 LDA #<$0B00
 STA CNT
 LDA #>$0B00
 STA CNT+1
SU0LP
 JSR SDM_WRNEXT
 LDA CNT
 SEC
 SBC #1
 STA CNT
 LDA CNT+1
 SBC #0
 STA CNT+1
 ORA CNT
 BNE SU0LP
* write SIG "FM" + CVER
 LDA #SIGF
 STA SDM_VAL
 LDA #<FSIG0
 LDY #>FSIG0
 JSR FWR
 LDA #SIGM
 STA SDM_VAL
 LDA #<FSIG1
 LDY #>FSIG1
 JSR FWR
 LDA #CVERNUM
 STA SDM_VAL
 LDA #<FBCVER
 LDY #>FBCVER
 JSR FWR
* market base prices
 LDA #8
 STA SDM_VAL
 LDA #<FMKT
 LDY #>FMKT
 JSR FWR
 LDA #14
 STA SDM_VAL
 LDA #<FMKT+3
 LDY #>FMKT
 JSR FWR
 LDA #24
 STA SDM_VAL
 LDA #<FMKT+6
 LDY #>FMKT
 JSR FWR
 LDA #40
 STA SDM_VAL
 LDA #<FMKT+9
 LDY #>FMKT
 JSR FWR
* cash
 LDA #100
 STA SDM_VAL
 LDA #<FCASHL
 LDY #>FCASHL
 JSR FWR
 LDA #0
 STA SDM_VAL
 LDA #<FCASHH
 LDY #>FCASHH
 JSR FWR
* seeds[0..3] = 5 each
 LDA #5
 STA SDM_VAL
 LDA #<FSEEDS
 LDY #>FSEEDS
 JSR FWR
 LDA #5
 STA SDM_VAL
 LDA #<FSEEDS+1
 LDY #>FSEEDS
 JSR FWR
 LDA #5
 STA SDM_VAL
 LDA #<FSEEDS+2
 LDY #>FSEEDS
 JSR FWR
 LDA #5
 STA SDM_VAL
 LDA #<FSEEDS+3
 LDY #>FSEEDS
 JSR FWR
* seeds[3]=254 overflow guard for TEST 20
 LDA #254
 STA SDM_VAL
 LDA #<FSEEDS+3
 LDY #>FSEEDS
 JSR FWR
* crops[0]=5 (wheat; econ tests sell all 5)
 LDA #5
 STA SDM_VAL
 LDA #<FCROPS
 LDY #>FCROPS
 JSR FWR
* seed WBANK zero $0200-$027F
 LDA #WBANK
 STA SDM_BANK
 LDA #0
 STA SDM_BANK+1
 JSR SDM_SETBANK
 LDA #<WBFLAG
 STA SDM_ADDR
 LDA #>WBFLAG
 STA SDM_ADDR+1
 JSR SDM_SETADDR
 LDA #0
 STA SDM_VAL
 LDA #128
 STA CNT
 LDA #0
 STA CNT+1
SU1LP
 JSR SDM_WRNEXT
 DEC CNT
 BNE SU1LP
* stream RECTAB (96 bytes) -> WBRECIP $0300
 LDA #WBANK
 STA SDM_BANK
 LDA #0
 STA SDM_BANK+1
 JSR SDM_SETBANK
 LDA #<WBRECIP
 STA SDM_ADDR
 LDA #>WBRECIP
 STA SDM_ADDR+1
 JSR SDM_SETADDR
 LDA #<RECTAB
 STA SRC
 LDA #>RECTAB
 STA SRC+1
 LDA #96
 STA CNT
 LDA #0
 STA CNT+1
SURLP
 LDY #0
 LDA (SRC),Y
 STA SDM_VAL
 JSR SDM_WRNEXT
 INC SRC
 BNE SURDC
 INC SRC+1
SURDC
 LDA CNT
 SEC
 SBC #1
 STA CNT
 LDA CNT+1
 SBC #0
 STA CNT+1
 ORA CNT
 BNE SURLP
* seed SKILL=$FF (lifts craft discovery rate)
 LDA #$FF
 STA SDM_VAL
 LDA #<WBSKILL
 LDY #>WBSKILL
 JSR WFWR
* init ring drain vars
 LDA #0
 STA TAIL
 STA EXPSEQ
 STA NRIPE
 STA NPRICE
 STA LAPPED
* spawn both tasks
 JSR LOADF
 JSR LOADW
 JSR STAGEF
 JSR STAGEW
 JSR RINGF
 BCS SUSPF
 JSR RINGW
 BCS SUSPF
 CLC
 RTS
SUSPF
 SEC
 RTS

* === SYNCRING: atomic TAIL=FHEAD, EXPSEQ=FSEQC ===
* Double-read of FSEQC guards against mid-write.
SYNCRING
SYRAGS
 LDA #<FSEQC
 LDY #>FSEQC
 JSR FRD
 LDA SDM_VAL
 STA EXPSEQ
 LDA #<FHEAD
 LDY #>FHEAD
 JSR FRD
 LDA SDM_VAL
 STA TAIL
 LDA #<FSEQC
 LDY #>FSEQC
 JSR FRD
 LDA SDM_VAL
 CMP EXPSEQ
 BNE SYRAGS
 RTS

* === DRAINEV: drain ring TAIL..FHEAD ===
* Counts: NRIPE+=EV_RIPE, NPRICE+=EV_PRICE.
* First EV_RIPE: REVX/REVY captured.
* Seq-tear or seq-gap: LAPPED=1, TAIL=FHEAD.
* DS: TAIL EXPSEQ NRIPE NPRICE REVX REVY
*     LAPPED RECLO RSEQ EVTT EVPP0 EVPP1
DRAINEV
 LDA #<FHEAD
 LDY #>FHEAD
 JSR FRD
 LDA SDM_VAL
 CMP TAIL
 BNE DRWORK
 RTS
DRWORK
* RECLO = TAIL*4 (ring page-aligned, no carry)
 LDA TAIL
 ASL
 ASL
 STA RECLO
* read SEQ TYPE P0 P1
 LDA RECLO
 LDY #>FRING
 JSR FRD
 LDA SDM_VAL
 STA RSEQ
 LDA RECLO
 CLC
 ADC #1
 LDY #>FRING
 JSR FRD
 LDA SDM_VAL
 STA EVTT
 LDA RECLO
 CLC
 ADC #2
 LDY #>FRING
 JSR FRD
 LDA SDM_VAL
 STA EVPP0
 LDA RECLO
 CLC
 ADC #3
 LDY #>FRING
 JSR FRD
 LDA SDM_VAL
 STA EVPP1
* seqlock re-read: guard mid-write tear
 LDA RECLO
 LDY #>FRING
 JSR FRD
 LDA SDM_VAL
 CMP RSEQ
 BNE DRLAPD
 LDA RSEQ
 CMP EXPSEQ
 BNE DRLAPD
* classify event type
 LDA EVTT
 CMP #EVRIPE
 BNE DRCKPR
 INC NRIPE
 LDA NRIPE
 CMP #1
 BNE DRADV
 LDA EVPP0
 STA REVX
 LDA EVPP1
 STA REVY
 JMP DRADV
DRCKPR
 CMP #EVPRICE
 BNE DRADV
 INC NPRICE
DRADV
 INC EXPSEQ
 LDA TAIL
 CLC
 ADC #1
 AND #$3F
 STA TAIL
 JMP DRAINEV
DRLAPD
* seq mismatch: lap detected, resync TAIL=HEAD
 LDA #1
 STA LAPPED
 LDA #<FHEAD
 LDY #>FHEAD
 JSR FRD
 LDA SDM_VAL
 STA TAIL
 RTS

* --- test label strings (0-term hi-ASCII) ---
LTITLE ASC "FARM_TEST"
 DFB 0
LSTAT ASC "STATUS"
 DFB 0
LPL33 ASC "PLANT(3,3)"
 DFB 0
LGD33C ASC "GRID(3,3)CROP"
 DFB 0
LGD33S ASC "GRID(3,3)STG"
 DFB 0
LSEED0 ASC "SEEDS[0]"
 DFB 0
LPL99 ASC "PLANT(19,19)"
 DFB 0
LGD99C ASC "GRID(19,19)CROP"
 DFB 0
LGD99S ASC "GRID(19,19)STG"
 DFB 0
LLOCC ASC "OCCUPIED"
 DFB 0
LLURP ASC "UNRIPE"
 DFB 0
LLWKS ASC "WKSTAT"
 DFB 0
LLWKC ASC "WKCRAFT"
 DFB 0
LLWKSA ASC "WKSTA0"
 DFB 0
LSPWN ASC "SPAWN"
 DFB 0
LLSELL ASC "SELL"
 DFB 0
LLSOLD ASC "CROPS=0"
 DFB 0
LLSUP ASC "SUPPLY=5"
 DFB 0
LLNOC ASC "SELL-EMPTY"
 DFB 0
LLBUY ASC "BUYSEED"
 DFB 0
LLSD1 ASC "SEEDS[1]=7"
 DFB 0
LLFULL ASC "SEED-FULL"
 DFB 0
LLSD3 ASC "SEEDS[3]=254"
 DFB 0
LLBEAT ASC "HEARTBEAT"
 DFB 0
LLPLT1 ASC "PLANT(10,10)"
 DFB 0
LLRIPE ASC "WHEAT RIPENS"
 DFB 0
LLHARV ASC "HARVEST OK"
 DFB 0
LLHCLRC ASC "HARV CLR CROP"
 DFB 0
LLHCLRS ASC "HARV CLR STG"
 DFB 0
LLDIVP ASC "PLANT PUMPKIN"
 DFB 0
LLDIVW ASC "PLANT WHEAT12"
 DFB 0
LLDIV ASC "PUMPKIN SLOWER"
 DFB 0
* --- new test label strings ---
LLEV31 ASC "EV_RIPE>=1"
 DFB 0
LLEVXY ASC "EV_RIPE XY"
 DFB 0
LLEVRP ASC "EV_PRICE>=1"
 DFB 0
LLSIGF ASC "LAP SIG-F"
 DFB 0
LLSIGM ASC "LAP SIG-M"
 DFB 0
LLRSRV ASC "RESET SURVIVAL"
 DFB 0
LLWARM ASC "WARM: RESET CHECK"
 DFB 0

* === RECTAB: recipe table 12x8 ===
* I0 I1 I2 I3 TIME VALUE RARITY PAD
RECTAB
 DFB 0,0,$FF,$FF,4,28,0,0
 DFB 0,1,$FF,$FF,2,36,0,0
 DFB 1,1,$FF,$FF,4,48,0,0
 DFB 0,2,$FF,$FF,4,56,1,0
 DFB 0,0,2,$FF,8,76,1,0
 DFB 2,2,$FF,$FF,4,80,1,0
 DFB 0,3,$FF,$FF,8,80,1,0
 DFB 1,3,$FF,$FF,8,92,1,0
 DFB 1,1,3,$FF,12,100,2,0
 DFB 0,2,3,$FF,12,105,2,0
 DFB 2,2,2,$FF,12,110,2,0
 DFB 0,1,2,3,20,127,3,0

* === MAIN ===
MAIN
* 1. Clear screen + title
 JSR HOME
 LDA #<LTITLE
 STA MSGPTR
 LDA #>LTITLE
 STA MSGPTR+1
 JSR PRMSG
 JSR CROUT
* 2. Warm/cold detect via SIG bytes
* Cold: SIG != "FM" -> full suite.
* Warm (ctrl-reset): SIG == "FM" -> reset check.
 LDA #<FSIG0
 LDY #>FSIG0
 JSR FRD
 LDA SDM_VAL
 CMP #SIGF
 BNE MNCOLD
 LDA #<FSIG1
 LDY #>FSIG1
 JSR FRD
 LDA SDM_VAL
 CMP #SIGM
 BNE MNCOLD
 JMP MNWARM
MNCOLD
* 3. Cold: run fixture + test suite
 JSR SETUP
 BCS MN_SPF
 JMP MN_FRM
MN_SPF
 LDA #<LSPWN
 STA MSGPTR
 LDA #>LSPWN
 STA MSGPTR+1
 JSR PRFAIL
 JMP MN_TAL
* 6. Farm tests
MN_FRM
* TEST 1: STATUS
 LDA #OPSTAT
 STA CMDOP
 LDA #0
 STA CMDA0
 STA CMDA1
 STA CMDA2
 LDA #ROK
 STA TEXP
 LDA #<LSTAT
 STA MSGPTR
 LDA #>LSTAT
 STA MSGPTR+1
 JSR SENDCMD
 JSR DOTEST
* TEST 2: PLANT(3,3) crop 0
 LDA #OPPLANT
 STA CMDOP
 LDA #3
 STA CMDA0
 STA CMDA1
 LDA #0
 STA CMDA2
 LDA #ROK
 STA TEXP
 LDA #<LPL33
 STA MSGPTR
 LDA #>LPL33
 STA MSGPTR+1
 JSR SENDCMD
 JSR DOTEST
* TEST 3: GRID(3,3) crop byte == 0
 LDA #0
 STA TEXP
 LDA #<LGD33C
 STA MSGPTR
 LDA #>LGD33C
 STA MSGPTR+1
 LDA #<FGRID+126
 LDY #>FGRID+126
 JSR FRDCHK
* TEST 4: GRID(3,3) stage byte == 1 (tilled)
 LDA #1
 STA TEXP
 LDA #<LGD33S
 STA MSGPTR
 LDA #>LGD33S
 STA MSGPTR+1
 LDA #<FGRID+127
 LDY #>FGRID+127
 JSR FRDCHK
* TEST 5: SEEDS[0] == 4 (was 5, decremented)
 LDA #4
 STA TEXP
 LDA #<LSEED0
 STA MSGPTR
 LDA #>LSEED0
 STA MSGPTR+1
 LDA #<FSEEDS
 LDY #>FSEEDS
 JSR FRDCHK
* TEST 6: PLANT(19,19) - page-cross plot (off=798)
* This is the case that hung in sim. C=1 = FAIL.
 LDA #OPPLANT
 STA CMDOP
 LDA #19
 STA CMDA0
 STA CMDA1
 LDA #0
 STA CMDA2
 LDA #ROK
 STA TEXP
 LDA #<LPL99
 STA MSGPTR
 LDA #>LPL99
 STA MSGPTR+1
 JSR SENDCMD
 JSR DOTEST
* TEST 7: GRID(19,19) crop byte == 0
 LDA #0
 STA TEXP
 LDA #<LGD99C
 STA MSGPTR
 LDA #>LGD99C
 STA MSGPTR+1
 LDA #<FGRID+798
 LDY #>FGRID+798
 JSR FRDCHK
* TEST 8: GRID(19,19) stage byte == 1
 LDA #1
 STA TEXP
 LDA #<LGD99S
 STA MSGPTR
 LDA #>LGD99S
 STA MSGPTR+1
 LDA #<FGRID+799
 LDY #>FGRID+799
 JSR FRDCHK
* TEST 9: OCCUPIED - re-plant (3,3) -> RERROCC
 LDA #OPPLANT
 STA CMDOP
 LDA #3
 STA CMDA0
 STA CMDA1
 LDA #0
 STA CMDA2
 LDA #RERROCC
 STA TEXP
 LDA #<LLOCC
 STA MSGPTR
 LDA #>LLOCC
 STA MSGPTR+1
 JSR SENDCMD
 JSR DOTEST
* TEST 10: UNRIPE HARVEST - harvest (3,3) -> RERRRIPE
 LDA #OPHARV
 STA CMDOP
 LDA #3
 STA CMDA0
 STA CMDA1
 LDA #0
 STA CMDA2
 LDA #RERRRIPE
 STA TEXP
 LDA #<LLURP
 STA MSGPTR
 LDA #>LLURP
 STA MSGPTR+1
 JSR SENDCMD
 JSR DOTEST
* 7. Workshop tests
* TEST 11: WK STATUS
 LDA #WOPSTAT
 STA CMDOP2
 LDA #0
 STA CMDA02
 STA CMDA12
 STA CMDA22
 STA CMDA32
 LDA #ROK
 STA TEXP
 LDA #<LLWKS
 STA MSGPTR
 LDA #>LLWKS
 STA MSGPTR+1
 JSR WSENDCMD
 JSR DOTEST
* TEST 12: WK CRAFT recipe 0 (0,0,$FF,$FF).
* discovery roll is random per craft (~65% at
* SKILL=$FF); RUIN/FAIL consume nothing, so retry
* up to 16x until ROK. Station cooks on success.
 LDA #0
 STA CMDA02
 STA CMDA12
 LDA #$FF
 STA CMDA22
 STA CMDA32
 LDA #ROK
 STA TEXP
 LDA #<LLWKC
 STA MSGPTR
 LDA #>LLWKC
 STA MSGPTR+1
 LDX #16
WKCTRY
 LDA #WOPCRAFT
 STA CMDOP2
 JSR WSENDCMD
 BCS WKCNXT
 CMP #ROK
 BEQ WKCWIN
WKCNXT
 DEX
 BNE WKCTRY
 SEC
 JSR DOTEST
 JMP WKCDONE
WKCWIN
 CLC
 LDA #ROK
 JSR DOTEST
WKCDONE
* TEST 13: WK station 0 STATE == 1 (cooking)
 LDA #1
 STA TEXP
 LDA #<LLWKSA
 STA MSGPTR
 LDA #>LLWKSA
 STA MSGPTR+1
 LDA #<WBSTA
 LDY #>WBSTA
 JSR WRDCHK
* 8. Economy + heartbeat tests
* TEST 14: SELL crop0 qty 5 -> ROK
 LDA #OPSELL
 STA CMDOP
 LDA #0
 STA CMDA0
 LDA #5
 STA CMDA1
 LDA #0
 STA CMDA2
 LDA #ROK
 STA TEXP
 LDA #<LLSELL
 STA MSGPTR
 LDA #>LLSELL
 STA MSGPTR+1
 JSR SENDCMD
 JSR DOTEST
* TEST 15: FCROPS[0] == 0 (sold all)
 LDA #0
 STA TEXP
 LDA #<LLSOLD
 STA MSGPTR
 LDA #>LLSOLD
 STA MSGPTR+1
 LDA #<FCROPS
 LDY #>FCROPS
 JSR FRDCHK
* TEST 16: SUPPLY[0] == 5 (sell added qty)
 LDA #5
 STA TEXP
 LDA #<LLSUP
 STA MSGPTR
 LDA #>LLSUP
 STA MSGPTR+1
 LDA #<FMKT+2
 LDY #>FMKT
 JSR FRDCHK
* TEST 17: SELL empty crop0 qty 1 -> RERRCROP
 LDA #OPSELL
 STA CMDOP
 LDA #0
 STA CMDA0
 LDA #1
 STA CMDA1
 LDA #0
 STA CMDA2
 LDA #RERRCROP
 STA TEXP
 LDA #<LLNOC
 STA MSGPTR
 LDA #>LLNOC
 STA MSGPTR+1
 JSR SENDCMD
 JSR DOTEST
* TEST 18: BUYSEED carrot(1) qty 2 -> ROK
 LDA #OPBUY
 STA CMDOP
 LDA #1
 STA CMDA0
 LDA #2
 STA CMDA1
 LDA #0
 STA CMDA2
 LDA #ROK
 STA TEXP
 LDA #<LLBUY
 STA MSGPTR
 LDA #>LLBUY
 STA MSGPTR+1
 JSR SENDCMD
 JSR DOTEST
* TEST 19: SEEDS[1] == 7 (was 5, +2)
 LDA #7
 STA TEXP
 LDA #<LLSD1
 STA MSGPTR
 LDA #>LLSD1
 STA MSGPTR+1
 LDA #<FSEEDS+1
 LDY #>FSEEDS
 JSR FRDCHK
* TEST 20: BUYSEED crop3 qty 5 -> RERRFULL
 LDA #OPBUY
 STA CMDOP
 LDA #3
 STA CMDA0
 LDA #5
 STA CMDA1
 LDA #0
 STA CMDA2
 LDA #RERRFULL
 STA TEXP
 LDA #<LLFULL
 STA MSGPTR
 LDA #>LLFULL
 STA MSGPTR+1
 JSR SENDCMD
 JSR DOTEST
* TEST 21: SEEDS[3] unchanged == 254
 LDA #254
 STA TEXP
 LDA #<LLSD3
 STA MSGPTR
 LDA #>LLSD3
 STA MSGPTR+1
 LDA #<FSEEDS+3
 LDY #>FSEEDS
 JSR FRDCHK
* TEST 22: HEARTBEAT advances (read, delay, read, NE)
 LDA #<FHBEAT
 LDY #>FHBEAT
 JSR FRD
 LDA SDM_VAL
 STA HBTMP
* delay loop (~task runs several passes)
 LDX #0
 LDY #0
HBDLY
 INX
 BNE HBDLY
 INY
 CPY #16
 BNE HBDLY
 LDA #<FHBEAT
 LDY #>FHBEAT
 JSR FRD
 LDA #<LLBEAT
 STA MSGPTR
 LDA #>LLBEAT
 STA MSGPTR+1
 LDA SDM_VAL
 CMP HBTMP
 BEQ HBEQ
 CLC
 LDA #1
 STA TEXP
 LDA #1
 JSR DOTEST
 JMP HBDONE
HBEQ
 SEC
 JSR DOTEST
HBDONE
* TEST 23: PLANT(10,10) wheat -> ROK
 LDA #OPPLANT
 STA CMDOP
 LDA #10
 STA CMDA0
 STA CMDA1
 LDA #0
 STA CMDA2
 LDA #ROK
 STA TEXP
 LDA #<LLPLT1
 STA MSGPTR
 LDA #>LLPLT1
 STA MSGPTR+1
 JSR SENDCMD
 JSR DOTEST
* TEST 24: poll wheat(10,10) stage=6 x4
 LDA #<FGRID+421
 STA POLLAL
 LDA #>FGRID+421
 STA POLLAH
 LDA #6
 STA POLLT
 LDA #1
 STA TEXP
 LDA #<LLRIPE
 STA MSGPTR
 LDA #>LLRIPE
 STA MSGPTR+1
 LDX #16
RIPTRY
 JSR POLLRIP
 BCC RIPWIN
 DEX
 BNE RIPTRY
 SEC
 JSR DOTEST
 JMP RIPDONE
RIPWIN
 CLC
 LDA #1
 JSR DOTEST
RIPDONE
* TEST 25: HARVEST(10,10) -> ROK
 LDA #OPHARV
 STA CMDOP
 LDA #10
 STA CMDA0
 STA CMDA1
 LDA #0
 STA CMDA2
 LDA #ROK
 STA TEXP
 LDA #<LLHARV
 STA MSGPTR
 LDA #>LLHARV
 STA MSGPTR+1
 JSR SENDCMD
 JSR DOTEST
* TEST 26: harvest cleared crop=0
 LDA #0
 STA TEXP
 LDA #<LLHCLRC
 STA MSGPTR
 LDA #>LLHCLRC
 STA MSGPTR+1
 LDA #<FGRID+420
 LDY #>FGRID+420
 JSR FRDCHK
* TEST 27: harvest cleared stage=0
 LDA #0
 STA TEXP
 LDA #<LLHCLRS
 STA MSGPTR
 LDA #>LLHCLRS
 STA MSGPTR+1
 LDA #<FGRID+421
 LDY #>FGRID+421
 JSR FRDCHK
* TEST 28: PLANT(11,11) pumpkin -> ROK
 LDA #OPPLANT
 STA CMDOP
 LDA #11
 STA CMDA0
 STA CMDA1
 LDA #3
 STA CMDA2
 LDA #ROK
 STA TEXP
 LDA #<LLDIVP
 STA MSGPTR
 LDA #>LLDIVP
 STA MSGPTR+1
 JSR SENDCMD
 JSR DOTEST
* TEST 29: PLANT(12,12) wheat -> ROK
 LDA #OPPLANT
 STA CMDOP
 LDA #12
 STA CMDA0
 STA CMDA1
 LDA #0
 STA CMDA2
 LDA #ROK
 STA TEXP
 LDA #<LLDIVW
 STA MSGPTR
 LDA #>LLDIVW
 STA MSGPTR+1
 JSR SENDCMD
 JSR DOTEST
* TEST 30: wheat(12,12) ripe; pumpkin<ripe
 LDA #<FGRID+505
 STA POLLAL
 LDA #>FGRID+505
 STA POLLAH
 LDA #6
 STA POLLT
 LDX #16
DIVTRY
 JSR POLLRIP
 BCC DIVRDY
 DEX
 BNE DIVTRY
DIVRDY
 LDA #<FGRID+463
 LDY #>FGRID+463
 JSR FRD
 LDA SDM_VAL
 AND #$0F
 CMP #6
 BCS DIVBAD
 LDA #<LLDIV
 STA MSGPTR
 LDA #>LLDIV
 STA MSGPTR+1
 JSR PRPASS
 JMP C30DN
DIVBAD
 LDA #<LLDIV
 STA MSGPTR
 LDA #>LLDIV
 STA MSGPTR+1
 JSR PRFAIL
C30DN
* === NEW: EV_RIPE / EV_PRICE / LAP+SIG tests ===

* TEST 31-32: EV_RIPE: plant (0,0), drain-poll
* SYNCRING -> atomic ring position before plant.
* Drain every 16 FRD-polls to prevent ring lap.
* LAPN=64 outer-outer: ~35s timeout (covers ripen).
* NOTE: market-events dominate ring during poll;
* drain-during-poll keeps TAIL current so DRAINEV
* can count the single EV_RIPE without lap loss.
 JSR SYNCRING
 LDA #0
 STA NRIPE
 STA NPRICE
 STA LAPPED
* plant (0,0) wheat for EV_RIPE test
 LDA #OPPLANT
 STA CMDOP
 LDA #0
 STA CMDA0
 STA CMDA1
 STA CMDA2
 JSR SENDCMD
* drain-during-poll: inner 16 FRD + drain + outer
 LDA #64
 STA LAPN
EVRDOO
 LDA #0
 STA TMO+1
EVRDOU
 LDA #16
 STA CNT
EVRDPL
 LDA #<FGRID+1
 LDY #>FGRID+1
 JSR FRD
 LDA SDM_VAL
 AND #$0F
 CMP #STRIPE
 BEQ EVRDN
 DEC CNT
 BNE EVRDPL
 JSR DRAINEV
 INC TMO+1
 BNE EVRDOU
 DEC LAPN
 BNE EVRDOO
EVRDN
 JSR DRAINEV
* TEST 31: EV_RIPE >= 1
 LDA #1
 STA TEXP
 LDA #<LLEV31
 STA MSGPTR
 LDA #>LLEV31
 STA MSGPTR+1
 LDA NRIPE
 BEQ EV31FAL
 CLC
 LDA #1
 JSR DOTEST
 JMP EV31D
EV31FAL
 SEC
 JSR DOTEST
EV31D
* TEST 32: EV_RIPE XY valid (REVX <= 19)
 LDA #1
 STA TEXP
 LDA #<LLEVXY
 STA MSGPTR
 LDA #>LLEVXY
 STA MSGPTR+1
 LDA REVX
 CMP #20
 BCS EV32FAL
 CLC
 LDA #1
 JSR DOTEST
 JMP EV32D
EV32FAL
 SEC
 JSR DOTEST
EV32D

* TEST 33: EV_PRICE >= 1
* SYNCRING, poke SUPPLY[0]=20 (TGT[0]=2),
* drain-until-NPRICE inner-256+drain loop.
* Market ticks ~every 50ms; NPRICE>0 within ~200ms.
 LDA #0
 STA NPRICE
 STA NRIPE
 STA LAPPED
 JSR SYNCRING
* poke SUPPLY[0]=20 to force price drift
 LDA #20
 STA SDM_VAL
 LDA #<FMKT+2
 LDY #>FMKT
 JSR FWR
* drain-until-NPRICE: inner 256 tight + drain
 LDA #2
 STA LAPN
EVPROO
 LDA #0
 STA TMO+1
EVPRPOL
 LDA #0
 STA TMO
EVPRIN
 INC TMO
 BNE EVPRIN
 JSR DRAINEV
 LDA NPRICE
 BNE EVPRGOT
 INC TMO+1
 BNE EVPRPOL
 DEC LAPN
 BNE EVPROO
EVPRGOT
 LDA #1
 STA TEXP
 LDA #<LLEVRP
 STA MSGPTR
 LDA #>LLEVRP
 STA MSGPTR+1
 LDA NPRICE
 BEQ EV33FAL
 CLC
 LDA #1
 JSR DOTEST
 JMP EV33D
EV33FAL
 SEC
 JSR DOTEST
EV33D

* TEST 34-35: LAP SIG-F / LAP SIG-M
* Plant 70 plots rows 5-8 (FAST: ~40ms total).
* Then wait-until-LAPPED using market events:
* ring laps in ~800ms (4 events/50ms tick).
* SIG "FM" at $0000-$0001 must survive ring
* activity (PUTEV never writes those bytes).
* NOTE: spec's 70-ripen wait replaced by market-
* event-driven lap; same SIG-survival coverage.
 LDA #$FF
 STA SDM_VAL
 LDA #<FSEEDS
 LDY #>FSEEDS
 JSR FWR
* plant 70 plots rows 5-8 cols 0-19
 LDA #0
 STA LAPX
 LDA #5
 STA LAPY
 LDA #70
 STA LAPN
LAPLNT
 LDA #OPPLANT
 STA CMDOP
 LDA LAPX
 STA CMDA0
 LDA LAPY
 STA CMDA1
 LDA #0
 STA CMDA2
 JSR SENDCMD
 INC LAPX
 LDA LAPX
 CMP #20
 BCC LAPNXT
 LDA #0
 STA LAPX
 INC LAPY
LAPNXT
 DEC LAPN
 BNE LAPLNT
* SYNCRING then wait until ring laps
 JSR SYNCRING
 LDA #0
 STA LAPPED
 LDA #10
 STA LAPN
LAPWOO
 LDA #0
 STA TMO+1
LAPWOU
 LDA #0
 STA TMO
LAPWIN2
 INC TMO
 BNE LAPWIN2
 JSR DRAINEV
 LDA LAPPED
 BNE LAPDET
 INC TMO+1
 BNE LAPWOU
 DEC LAPN
 BNE LAPWOO
LAPDET
* TEST 34: LAP SIG-F (FSIG0 == $46)
 LDA #SIGF
 STA TEXP
 LDA #<LLSIGF
 STA MSGPTR
 LDA #>LLSIGF
 STA MSGPTR+1
 LDA #<FSIG0
 LDY #>FSIG0
 JSR FRDCHK
* TEST 35: LAP SIG-M (FSIG1 == $4D)
 LDA #SIGM
 STA TEXP
 LDA #<LLSIGM
 STA MSGPTR
 LDA #>LLSIGM
 STA MSGPTR+1
 LDA #<FSIG1
 LDY #>FSIG1
 JSR FRDCHK
* 9. Tally
MN_TAL
 JSR CROUT
 LDA #$D0
 JSR COUT
 LDA #$C1
 JSR COUT
 LDA #$D3
 JSR COUT
 LDA #$D3
 JSR COUT
 LDA #$BD
 JSR COUT
 LDA NPASS
 JSR PRHEX
 LDA #$A0
 JSR COUT
 LDA #$C6
 JSR COUT
 LDA #$C1
 JSR COUT
 LDA #$C9
 JSR COUT
 LDA #$CC
 JSR COUT
 LDA #$BD
 JSR COUT
 LDA NFAIL
 JSR PRHEX
 JSR CROUT
 RTS

* === MNWARM: warm boot reset-survival check ===
* Two-run test procedure:
*  Cold: BRUN -> full suite, SIG "FM" written.
*  Ctrl-Reset. Warm: BRUN -> this path.
* Verifies: SDRAM world survived, task respawns,
*  STATUS responds, plot(3,3) stage byte != 0.
MNWARM
 LDA #<LLWARM
 STA MSGPTR
 LDA #>LLWARM
 STA MSGPTR+1
 JSR PRMSG
 JSR CROUT
 JSR RSTWAIT
* respawn farm task (workshop not needed here)
 JSR LOADF
 JSR STAGEF
 JSR RINGF
 BCS MNWFAL
* STATUS probe -> ROK
 LDA #OPSTAT
 STA CMDOP
 LDA #0
 STA CMDA0
 STA CMDA1
 STA CMDA2
 JSR SENDCMD
 BCS MNWFAL
 CMP #ROK
 BNE MNWFAL
* survivor: plot (3,3) byte1 (stage) != 0
* byte1 = FGRID+127 (idx=63, 2-byte plot)
 LDA #<FGRID+127
 LDY #>FGRID+127
 JSR FRD
 LDA SDM_VAL
 BEQ MNWFAL
* PASS
 LDA #<LLRSRV
 STA MSGPTR
 LDA #>LLRSRV
 STA MSGPTR+1
 JSR PRPASS
 JMP MN_TAL
MNWFAL
 LDA #<LLRSRV
 STA MSGPTR
 LDA #>LLRSRV
 STA MSGPTR+1
 JSR PRFAIL
 JMP MN_TAL

* --- embedded blobs ---
 PUT FARMTASKB
 PUT WORKTASKB
