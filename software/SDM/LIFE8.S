* LIFE8.S - CONWAY MULTIVERSE TICK1
* ONE UNIVERSE (U0), ONE GENERATION
* BIT-PACKED 7 CELLS/BYTE, BIT0=LEFT
* SLIDING 3-ROWBUF WINDOW, TORUS WRAP
* COLSUM PASS THEN ROWOUT PASS
* WRAP: TICK U0, FLIP FRONT, BUMP GEN
 TYP $06
 DSK LIFE8.bin
 ORG $0300
 PUT LIFEMAP
* GROWS = ACTIVE ROWS
* LSIM=1 SMALL SIM GRID, 0 = HW NROWS
LSIM = 1
 DO LSIM
GROWS = 8
 FIN
 DO 1-LSIM
GROWS = NROWS
 FIN
DONE = $1006
* SCRATCH BRAM (BELOW $0F80 MAILBOX)
ROWBUF0 = $0C00
ROWBUF1 = $0C50
ROWBUF2 = $0CA0
ROWOUT = $0CF0
COLSUM = $0D40
CS2 = COLSUM+2
* ZP SLOT-0 SCRATCH $80-$A7
UPP = $80
MIDP = $82
DNP = $84
PROD = $86
T16 = $88
CSP = $8A
RDP = $8C
FBASE = $8E
BBASE = $90
RBUFP = $92
WSAD = $94
BYTEC = $96
BITC = $97
UPB = $98
MIDB = $99
DNB = $9A
MB = $9B
OUTB = $9C
CLEFT = $9D
CMID = $9E
CRIGHT = $9F
ROW = $A0
NVAL = $A1
FRONTV = $A2
SWAPT = $A3
MASKB = $A5
MIDBIT = $A6
BANK = $A7

LIFE8
* --- read FRONT[0] from MBANK $0010 ---
 LDA #$10
 STA RADDRLO
 LDA #$00
 STA RADDRHI
 LDA #MBANK
 STA RBANKR
 STA RTRIG
 LDA RDATA
 STA FRONTV
* --- bank = UBASE+0 (both buffers) ---
 LDA #UBASE
 STA BANK
* --- pick front/back buffer base ---
 LDA FRONTV
 BNE BFRONT
 LDA #<BUFA
 STA FBASE
 LDA #>BUFA
 STA FBASE+1
 LDA #<BUFB
 STA BBASE
 LDA #>BUFB
 STA BBASE+1
 JMP BASEOK
BFRONT
 LDA #<BUFB
 STA FBASE
 LDA #>BUFB
 STA FBASE+1
 LDA #<BUFA
 STA BBASE
 LDA #>BUFA
 STA BBASE+1
BASEOK
* --- init rowbuf pointers ---
 LDA #<ROWBUF0
 STA UPP
 LDA #>ROWBUF0
 STA UPP+1
 LDA #<ROWBUF1
 STA MIDP
 LDA #>ROWBUF1
 STA MIDP+1
 LDA #<ROWBUF2
 STA DNP
 LDA #>ROWBUF2
 STA DNP+1
* --- prime: UP=last MID=0 DN=1 ---
 LDA UPP
 STA RBUFP
 LDA UPP+1
 STA RBUFP+1
 LDA #GROWS-1
 JSR READROW
 LDA MIDP
 STA RBUFP
 LDA MIDP+1
 STA RBUFP+1
 LDA #0
 JSR READROW
 LDA DNP
 STA RBUFP
 LDA DNP+1
 STA RBUFP+1
 LDA #1
 JSR READROW
* --- main row loop r=0..GROWS-1 ---
 LDA #0
 STA ROW
RLOOP
 JSR DOCOLSUM
 JSR DOROWOUT
 JSR WRITEROW
 LDA ROW
 CMP #GROWS-1
 BEQ TICKEND
* rotate UP<-MID<-DN, DN<-freed UP
 LDA UPP
 STA SWAPT
 LDA UPP+1
 STA SWAPT+1
 LDA MIDP
 STA UPP
 LDA MIDP+1
 STA UPP+1
 LDA DNP
 STA MIDP
 LDA DNP+1
 STA MIDP+1
 LDA SWAPT
 STA DNP
 LDA SWAPT+1
 STA DNP+1
* read next row into DN
 LDA DNP
 STA RBUFP
 LDA DNP+1
 STA RBUFP+1
 LDA ROW
 CMP #GROWS-2
 BEQ WRAP0
 CLC
 ADC #2
 JMP RDNEXT
WRAP0
 LDA #0
RDNEXT
 JSR READROW
 INC ROW
 JMP RLOOP
TICKEND
* --- flip FRONT[0] ---
 LDA FRONTV
 EOR #1
 PHA
 LDA #$10
 STA SADDRLO
 LDA #$00
 STA SADDRHI
 LDA #MBANK
 STA SBANKR
 PLA
 STA SDATA
* --- bump GEN[0] ---
 LDA #$20
 STA RADDRLO
 LDA #$00
 STA RADDRHI
 LDA #MBANK
 STA RBANKR
 STA RTRIG
 LDA RDATA
 CLC
 ADC #1
 PHA
 LDA #$20
 STA SADDRLO
 LDA #$00
 STA SADDRHI
 LDA #MBANK
 STA SBANKR
 PLA
 STA SDATA
 JMP DONE

* === READROW: A=rownum, dest=(RBUFP) ===
READROW
 JSR MUL80
 CLC
 LDA FBASE
 ADC PROD
 STA RADDRLO
 LDA FBASE+1
 ADC PROD+1
 STA RADDRHI
 LDA BANK
 STA RBANKR
 LDY #0
RRLP
 STA RTRIG
 LDA RDATA
 STA (RBUFP),Y
 INY
 CPY #ROWBYTES
 BNE RRLP
 RTS

* === MUL80: PROD = A * 80 ===
MUL80
 STA PROD
 LDA #0
 STA PROD+1
 LDX #4
MULSH
 ASL PROD
 ROL PROD+1
 DEX
 BNE MULSH
 LDA PROD
 STA T16
 LDA PROD+1
 STA T16+1
 ASL PROD
 ROL PROD+1
 ASL PROD
 ROL PROD+1
 CLC
 LDA PROD
 ADC T16
 STA PROD
 LDA PROD+1
 ADC T16+1
 STA PROD+1
 RTS

* === DOCOLSUM: COLSUM[x]=up+mid+dn ===
DOCOLSUM
 LDA #<COLSUM
 STA CSP
 LDA #>COLSUM
 STA CSP+1
 LDA #0
 STA BYTEC
CSBYTE
 LDY BYTEC
 LDA (UPP),Y
 STA UPB
 LDA (MIDP),Y
 STA MIDB
 LDA (DNP),Y
 STA DNB
 LDX #7
 LDY #0
CSBIT
 LDA #0
 LSR UPB
 ADC #0
 LSR MIDB
 ADC #0
 LSR DNB
 ADC #0
 STA (CSP),Y
 INC CSP
 BNE CSNC
 INC CSP+1
CSNC
 DEX
 BNE CSBIT
 INC BYTEC
 LDA BYTEC
 CMP #ROWBYTES
 BNE CSBYTE
 RTS

* === DOROWOUT: build ROWOUT from COLSUM ===
DOROWOUT
 LDA COLSUM+559
 STA CLEFT
 LDA COLSUM
 STA CMID
 LDA COLSUM+1
 STA CRIGHT
 LDA #<CS2
 STA RDP
 LDA #>CS2
 STA RDP+1
 LDA #0
 STA BYTEC
ROBYTE
 LDY BYTEC
 LDA (MIDP),Y
 STA MB
 LDA #0
 STA OUTB
 LDA #1
 STA MASKB
 LDX #7
ROBIT
 LDA MB
 AND #1
 STA MIDBIT
 LSR MB
 CLC
 LDA CLEFT
 ADC CMID
 CLC
 ADC CRIGHT
 SEC
 SBC MIDBIT
 STA NVAL
 CMP #3
 BEQ ALIVE
 LDA MIDBIT
 BEQ SLIDE
 LDA NVAL
 CMP #2
 BNE SLIDE
ALIVE
 LDA OUTB
 ORA MASKB
 STA OUTB
SLIDE
 LDA BYTEC
 CMP #ROWBYTES-1
 BNE ADV
 CPX #1
 BEQ NOCOL
ADV
 LDA CMID
 STA CLEFT
 LDA CRIGHT
 STA CMID
 LDA BYTEC
 CMP #ROWBYTES-1
 BNE RDC
 CPX #2
 BNE RDC
 LDA COLSUM
 STA CRIGHT
 JMP NOCOL
RDC
 LDY #0
 LDA (RDP),Y
 STA CRIGHT
 INC RDP
 BNE NOCOL
 INC RDP+1
NOCOL
 ASL MASKB
 DEX
 BEQ ROSTORE
 JMP ROBIT
ROSTORE
 LDA OUTB
 LDY BYTEC
 STA ROWOUT,Y
 INC BYTEC
 LDA BYTEC
 CMP #ROWBYTES
 BNE ROBYTE
 RTS

* === WRITEROW: ROWOUT -> back row ROW ===
WRITEROW
 LDA ROW
 JSR MUL80
 CLC
 LDA BBASE
 ADC PROD
 STA WSAD
 LDA BBASE+1
 ADC PROD+1
 STA WSAD+1
 LDA BANK
 STA SBANKR
 LDY #0
WRLP
 LDA WSAD
 STA SADDRLO
 LDA WSAD+1
 STA SADDRHI
 LDA ROWOUT,Y
 STA SDATA
 INC WSAD
 BNE WRNC
 INC WSAD+1
WRNC
 INY
 CPY #ROWBYTES
 BNE WRLP
 RTS
