* MVERSE.S - CONWAY MULTIVERSE DHGR RENDER
* HOST //e SIDE. ORG $6000. BRUN BIN.
* READS ONE UNIVERSE GRID FROM SDRAM AND
* BLITS IT TO DOUBLE HI-RES (560x192).
* GRID ROW = 80 BYTES (ROWBYTES):
*  EVEN BYTE -> AUX  ODD BYTE -> MAIN
* BIT0 = LEFTMOST = DHGR LSB (R9):
*  STRAIGHT BYTE COPY, NO BIT REVERSAL.
* TASK 4 = RENDER HALF. TASK 5 = SURF LOOP.
 TYP $06
 DSK MVERSE.bin
 ORG $6000

 JMP MAIN
 PUT LIFEMAP
 PUT SDRAMLIB
 PUT LINEADDR

* --- DHGR SOFT SWITCHES ---
S80STON = $C001
S80VID = $C00D
HIRESON = $C057
DHIRON = $C05E
MIXOFF = $C052
GRAPH = $C050
PAGE2ON = $C055
PAGE2OF = $C054

* --- COPROC C4 LOAD/CALL PORTS (SLOT 4) ---
CP_RING = $C0C5
CP_LADLO = $C0C9
CP_LADHI = $C0CA
CP_WDATA = $C0CB

* --- KEYBOARD ---
KBD = $C000
KBDSTR = $C010

* --- 40 BYTES PER BANK PER SCANLINE ---
NCOLS = ROWBYTES/2

* --- ZP POINTERS (NON-PRODOS, TRANSIENT) ---
LINEP = $06
SRC = $08
PKL = $0A
PKH = $0C
PKV = $0E

* --- MONITOR ---
COUT = $FDED

* === RENDER STATE (INLINE STORAGE) ===
CHAN DS 1
ROW DS 1
LIVEBAS DS 2
PROD DS 2
T16 DS 2
U DS 1
CNTLO DS 1
CNTHI DS 1
LFLO DS 1
LFHI DS 1
LASTGEN DS 1
CHGFLG DS 1
LINEBUF DS 80

* === DHGRON: ENABLE DOUBLE HI-RES ===
DHGRON
 STA S80STON
 STA HIRESON
 STA DHIRON
 STA S80VID
 STA MIXOFF
 STA GRAPH
 RTS

* === DHGRCLR: ZERO AUX THEN MAIN BANK ===
* NEEDS 80STORE+HIRES ON (DHGRON FIRST)
DHGRCLR
 STA PAGE2ON
 JSR CLRPG
 STA PAGE2OF
 JSR CLRPG
 RTS

* CLRPG: ZERO $2000-$3FFF (CURRENT BANK)
CLRPG
 LDA #$00
 STA LINEP
 LDA #$20
 STA LINEP+1
 LDY #0
 TYA
CLRLP
 STA (LINEP),Y
 INY
 BNE CLRLP
 INC LINEP+1
 LDX LINEP+1
 CPX #$40
 BNE CLRLP
 RTS

* === RENDER: BLIT UNIVERSE CHAN TO DHGR ===
RENDER
* --- READ FRONT[CHAN] FROM MBANK $10+CHAN ---
 LDA #MBANK
 STA SDM_BANK
 LDA #0
 STA SDM_BANK+1
 LDA #$10
 CLC
 ADC CHAN
 STA SDM_ADDR
 LDA #0
 STA SDM_ADDR+1
 JSR SDM_READ
* --- LIVE BASE = FRONT? BUFB : BUFA ---
 LDA SDM_VAL
 BNE RFRONT
 LDA #<BUFA
 STA LIVEBAS
 LDA #>BUFA
 STA LIVEBAS+1
 JMP RBASEOK
RFRONT
 LDA #<BUFB
 STA LIVEBAS
 LDA #>BUFB
 STA LIVEBAS+1
RBASEOK
* --- GRID BANK = UBASE+CHAN ---
 LDA #UBASE
 CLC
 ADC CHAN
 STA SDM_BANK
 LDA #0
 STA SDM_BANK+1
 JSR SDM_SETBANK
* --- WALK ALL NROWS SCANLINES ---
 LDA #0
 STA ROW
RROW
* SDM_ADDR = LIVEBAS + ROW*80
 LDA ROW
 JSR MUL80
 CLC
 LDA LIVEBAS
 ADC PROD
 STA SDM_ADDR
 LDA LIVEBAS+1
 ADC PROD+1
 STA SDM_ADDR+1
 JSR SDM_SETADDR
* READ 80 GRID BYTES INTO LINEBUF
 LDY #0
RDLP
 JSR SDM_RDNEXT
 LDA SDM_VAL
 STA LINEBUF,Y
 INY
 CPY #ROWBYTES
 BNE RDLP
* LINE BASE PTR FROM LINEADDR HI:LO
 LDX ROW
 LDA HI,X
 STA LINEP+1
 LDA LO,X
 STA LINEP
* AUX PASS: EVEN BYTES 0,2..78
 STA PAGE2ON
 LDX #0
 LDY #0
AUXLP
 LDA LINEBUF,X
 STA (LINEP),Y
 INX
 INX
 INY
 CPY #NCOLS
 BNE AUXLP
* MAIN PASS: ODD BYTES 1,3..79
 STA PAGE2OF
 LDX #1
 LDY #0
MAINLP
 LDA LINEBUF,X
 STA (LINEP),Y
 INX
 INX
 INY
 CPY #NCOLS
 BNE MAINLP
* NEXT ROW
 INC ROW
 LDA ROW
 CMP #NROWS
 BNE RROW
 RTS

* === MUL80: PROD = A * 80 ===
MUL80
 STA PROD
 LDA #0
 STA PROD+1
 LDX #4
MULSH
 ASL PROD
 ROL PROD+1
 DEX
 BNE MULSH
 LDA PROD
 STA T16
 LDA PROD+1
 STA T16+1
 ASL PROD
 ROL PROD+1
 ASL PROD
 ROL PROD+1
 CLC
 LDA PROD
 ADC T16
 STA PROD
 LDA PROD+1
 ADC T16+1
 STA PROD+1
 RTS

* === MAIN: REGISTER, SEED, GO, SURF ===
MAIN
 JSR SDM_READY
 BCC MRDY
 LDA #<EMSG
 STA SRC
 LDA #>EMSG
 STA SRC+1
 JSR PRMSG
 RTS
MRDY
 JSR DHGRON
 JSR DHGRCLR
 JSR REGSKILL
 JSR SEED
 JSR GOLIFE
 LDA #0
 STA CHAN
 LDA #1
 STA CHGFLG
 JMP SURF

* === REGSKILL: load LSIM=0 LIFE8 -> $0300 ===
* then TABLE[0]=$0300 (skill 0 entry)
REGSKILL
 LDA #$00
 STA CP_LADLO
 LDA #$03
 STA CP_LADHI
 LDA #<CSKILL
 STA SRC
 LDA #>CSKILL
 STA SRC+1
 LDA #<CSKLEN
 STA CNTLO
 LDA #>CSKLEN
 STA CNTHI
 LDY #0
RSLP
 LDA (SRC),Y
 STA CP_WDATA
 INC SRC
 BNE RSDEC
 INC SRC+1
RSDEC
 LDA CNTLO
 SEC
 SBC #1
 STA CNTLO
 LDA CNTHI
 SBC #0
 STA CNTHI
 ORA CNTLO
 BNE RSLP
* TABLE[0] lo/hi at coproc $0200 = $00/$03
 LDA #$00
 STA CP_LADLO
 LDA #$02
 STA CP_LADHI
 LDA #$00
 STA CP_WDATA
 LDA #$03
 STA CP_WDATA
 RTS

* === GOLIFE: stage slot-0 mailbox + ring ===
* skill_id=0 budget=0 (NO WATCHDOG) arg0=0
GOLIFE
 LDA #$80
 STA CP_LADLO
 LDA #$0F
 STA CP_LADHI
 LDA #$00
 STA CP_WDATA
 LDA #$00
 STA CP_WDATA
 LDA #$00
 STA CP_WDATA
 LDA #0
 STA CP_RING
 RTS

* === SEED: write 8 starting universes ===
SEED
 LDA #0
 STA U
SEEDLP
 LDA #UBASE
 CLC
 ADC U
 STA SDM_BANK
 LDA #0
 STA SDM_BANK+1
 LDA #<BUFA
 STA SDM_ADDR
 LDA #>BUFA
 STA SDM_ADDR+1
 JSR SDM_SETBANK
 JSR SDM_SETADDR
 LDA U
 CMP #4
 BCC PATSEL
 JMP DOSOUP
PATSEL
 JSR ZEROF
 LDA U
 BNE SU1
 LDA #<GUNLO
 STA PKL
 LDA #>GUNLO
 STA PKL+1
 LDA #<GUNHI
 STA PKH
 LDA #>GUNHI
 STA PKH+1
 LDA #<GUNVAL
 STA PKV
 LDA #>GUNVAL
 STA PKV+1
 LDA #23
 STA CNTLO
 JSR POKE
 JMP SEEDZ
SU1
 CMP #1
 BNE SU2
 LDA #<GLILO
 STA PKL
 LDA #>GLILO
 STA PKL+1
 LDA #<GLIHI
 STA PKH
 LDA #>GLIHI
 STA PKH+1
 LDA #<GLIVAL
 STA PKV
 LDA #>GLIVAL
 STA PKV+1
 LDA #16
 STA CNTLO
 JSR POKE
 JMP SEEDZ
SU2
 CMP #2
 BNE SU3
 LDA #<BLILO
 STA PKL
 LDA #>BLILO
 STA PKL+1
 LDA #<BLIHI
 STA PKH
 LDA #>BLIHI
 STA PKH+1
 LDA #<BLIVAL
 STA PKV
 LDA #>BLIVAL
 STA PKV+1
 LDA #13
 STA CNTLO
 JSR POKE
 JMP SEEDZ
SU3
 LDA #<PENLO
 STA PKL
 LDA #>PENLO
 STA PKL+1
 LDA #<PENHI
 STA PKH
 LDA #>PENHI
 STA PKH+1
 LDA #<PENVAL
 STA PKV
 LDA #>PENVAL
 STA PKV+1
 LDA #4
 STA CNTLO
 JSR POKE
 JMP SEEDZ
DOSOUP
 JSR SOUPF
SEEDZ
 LDA #MBANK
 STA SDM_BANK
 LDA #0
 STA SDM_BANK+1
 LDA #$10
 CLC
 ADC U
 STA SDM_ADDR
 LDA #0
 STA SDM_ADDR+1
 LDA #0
 STA SDM_VAL
 JSR SDM_WRITE
 LDA #$20
 CLC
 ADC U
 STA SDM_ADDR
 LDA #0
 STA SDM_ADDR+1
 LDA #0
 STA SDM_VAL
 JSR SDM_WRITE
 INC U
 LDA U
 CMP #NUNIV
 BEQ SEEDDN
 JMP SEEDLP
SEEDDN
 RTS

* === ZEROF: zero buf A (bank set) 15360 ===
ZEROF
 LDA #<BUFA
 STA SDM_ADDR
 LDA #>BUFA
 STA SDM_ADDR+1
 JSR SDM_SETADDR
 LDA #0
 STA SDM_VAL
 LDA #$00
 STA CNTLO
 LDA #$3C
 STA CNTHI
ZFLP
 JSR SDM_WRNEXT
 LDA CNTLO
 SEC
 SBC #1
 STA CNTLO
 LDA CNTHI
 SBC #0
 STA CNTHI
 ORA CNTLO
 BNE ZFLP
 RTS

* === SOUPF: LFSR-fill buf A (bank set) ===
SOUPF
 LDA #<BUFA
 STA SDM_ADDR
 LDA #>BUFA
 STA SDM_ADDR+1
 JSR SDM_SETADDR
 LDA U
 CLC
 ADC #$C5
 STA LFLO
 LDA U
 CLC
 ADC #$A0
 STA LFHI
 LDA #$00
 STA CNTLO
 LDA #$3C
 STA CNTHI
SFLP
 JSR NEXTRND
 LDA LFLO
 STA SDM_VAL
 JSR SDM_WRNEXT
 LDA CNTLO
 SEC
 SBC #1
 STA CNTLO
 LDA CNTHI
 SBC #0
 STA CNTHI
 ORA CNTLO
 BNE SFLP
 RTS

* === NEXTRND: 16-bit galois LFSR step ===
NEXTRND
 LSR LFHI
 ROR LFLO
 BCC NRNO
 LDA LFHI
 EOR #$B4
 STA LFHI
NRNO
 RTS

* === POKE: write CNTLO recs (bank set) ===
* PKL/PKH/PKV -> lo/hi/val arrays
POKE
 LDY #0
POKLP
 LDA (PKL),Y
 STA SDM_ADDR
 LDA (PKH),Y
 STA SDM_ADDR+1
 LDA (PKV),Y
 STA SDM_VAL
 JSR SDM_WRITE
 INY
 CPY CNTLO
 BNE POKLP
 RTS

* === PRMSG: print (SRC) hi-bit asciiz ===
PRMSG
 LDY #0
PMLP
 LDA (SRC),Y
 BEQ PMEND
 JSR COUT
 INY
 BNE PMLP
PMEND
 RTS

* === SURF: keyboard + gen-skip render ===
SURF
 LDA KBD
 BPL NOKEY
 STA KBDSTR
 CMP #$B0
 BCC CKARR
 CMP #$B8
 BCS CKARR
 SEC
 SBC #$B0
 STA CHAN
 JMP CHGED
CKARR
 CMP #$88
 BNE CKRGT
 LDA CHAN
 SEC
 SBC #1
 AND #$07
 STA CHAN
 JMP CHGED
CKRGT
 CMP #$95
 BNE NOKEY
 LDA CHAN
 CLC
 ADC #1
 AND #$07
 STA CHAN
CHGED
 LDA #1
 STA CHGFLG
NOKEY
 LDA #MBANK
 STA SDM_BANK
 LDA #0
 STA SDM_BANK+1
 LDA #$20
 CLC
 ADC CHAN
 STA SDM_ADDR
 LDA #0
 STA SDM_ADDR+1
 JSR SDM_READ
 LDA CHGFLG
 BNE DORND
 LDA SDM_VAL
 CMP LASTGEN
 BEQ SKIPR
DORND
 LDA SDM_VAL
 STA LASTGEN
 LDA #0
 STA CHGFLG
 JSR RENDER
SKIPR
 JMP SURF

EMSG ASC "SDRAM NOT READY"
 DFB $8D,$00

* CSKILL = LIFE8 LSIM=0 (192-ROW HW BUILD)
* 689 BYTES, ORG $0300; ENTRY $0300=LIFE8
CSKILL
 DFB $4C,$06,$03,$4C,$18,$03,$A9,$00
 DFB $85,$97,$20,$22,$03,$E6,$97,$A5
 DFB $97,$C9,$08,$D0,$F5,$4C,$06,$03
 DFB $A9,$00,$85,$97,$20,$22,$03,$4C
 DFB $06,$10,$A9,$10,$18,$65,$97,$8D
 DFB $04,$E0,$A9,$00,$8D,$05,$E0,$A9
 DFB $18,$8D,$06,$E0,$8D,$07,$E0,$AD
 DFB $08,$E0,$85,$A2,$A9,$10,$18,$65
 DFB $97,$85,$A7,$A5,$A2,$D0,$13,$A9
 DFB $00,$85,$8E,$A9,$00,$85,$8F,$A9
 DFB $00,$85,$90,$A9,$40,$85,$91,$4C
 DFB $6A,$03,$A9,$00,$85,$8E,$A9,$40
 DFB $85,$8F,$A9,$00,$85,$90,$A9,$00
 DFB $85,$91,$20,$BB,$03,$A5,$A2,$49
 DFB $01,$48,$A9,$10,$18,$65,$97,$8D
 DFB $00,$E0,$A9,$00,$8D,$01,$E0,$A9
 DFB $18,$8D,$02,$E0,$68,$8D,$03,$E0
 DFB $A9,$20,$18,$65,$97,$8D,$04,$E0
 DFB $A9,$00,$8D,$05,$E0,$A9,$18,$8D
 DFB $06,$E0,$8D,$07,$E0,$AD,$08,$E0
 DFB $18,$69,$01,$48,$A9,$20,$18,$65
 DFB $97,$8D,$00,$E0,$A9,$00,$8D,$01
 DFB $E0,$A9,$18,$8D,$02,$E0,$68,$8D
 DFB $03,$E0,$60,$A9,$00,$85,$80,$A9
 DFB $0C,$85,$81,$A9,$50,$85,$82,$A9
 DFB $0C,$85,$83,$A9,$A0,$85,$84,$A9
 DFB $0C,$85,$85,$A5,$80,$85,$92,$A5
 DFB $81,$85,$93,$A9,$BF,$20,$4C,$04
 DFB $A5,$82,$85,$92,$A5,$83,$85,$93
 DFB $A9,$00,$20,$4C,$04,$A5,$84,$85
 DFB $92,$A5,$85,$85,$93,$A9,$01,$20
 DFB $4C,$04,$A9,$00,$85,$A0,$20,$A0
 DFB $04,$20,$E0,$04,$20,$7C,$05,$A5
 DFB $A0,$C9,$BF,$F0,$3E,$A5,$80,$85
 DFB $A3,$A5,$81,$85,$A4,$A5,$82,$85
 DFB $80,$A5,$83,$85,$81,$A5,$84,$85
 DFB $82,$A5,$85,$85,$83,$A5,$A3,$85
 DFB $84,$A5,$A4,$85,$85,$A5,$84,$85
 DFB $92,$A5,$85,$85,$93,$A5,$A0,$C9
 DFB $BE,$F0,$06,$18,$69,$02,$4C,$43
 DFB $04,$A9,$00,$20,$4C,$04,$E6,$A0
 DFB $4C,$FE,$03,$60,$20,$73,$04,$18
 DFB $A5,$8E,$65,$86,$8D,$04,$E0,$A5
 DFB $8F,$65,$87,$8D,$05,$E0,$A5,$A7
 DFB $8D,$06,$E0,$A0,$00,$8D,$07,$E0
 DFB $AD,$08,$E0,$91,$92,$C8,$C0,$50
 DFB $D0,$F3,$60,$85,$86,$A9,$00,$85
 DFB $87,$A2,$04,$06,$86,$26,$87,$CA
 DFB $D0,$F9,$A5,$86,$85,$88,$A5,$87
 DFB $85,$89,$06,$86,$26,$87,$06,$86
 DFB $26,$87,$18,$A5,$86,$65,$88,$85
 DFB $86,$A5,$87,$65,$89,$85,$87,$60
 DFB $A9,$40,$85,$8A,$A9,$0D,$85,$8B
 DFB $A9,$00,$85,$96,$A4,$96,$B1,$80
 DFB $85,$98,$B1,$82,$85,$99,$B1,$84
 DFB $85,$9A,$A2,$07,$A0,$00,$A9,$00
 DFB $46,$98,$69,$00,$46,$99,$69,$00
 DFB $46,$9A,$69,$00,$91,$8A,$E6,$8A
 DFB $D0,$02,$E6,$8B,$CA,$D0,$E7,$E6
 DFB $96,$A5,$96,$C9,$50,$D0,$CD,$60
 DFB $AD,$6F,$0F,$85,$9D,$AD,$40,$0D
 DFB $85,$9E,$AD,$41,$0D,$85,$9F,$A9
 DFB $42,$85,$8C,$A9,$0D,$85,$8D,$A9
 DFB $00,$85,$96,$A4,$96,$B1,$82,$85
 DFB $9B,$A9,$00,$85,$9C,$A9,$01,$85
 DFB $A5,$A2,$07,$A5,$9B,$29,$01,$85
 DFB $A6,$46,$9B,$18,$A5,$9D,$65,$9E
 DFB $18,$65,$9F,$38,$E5,$A6,$85,$A1
 DFB $C9,$03,$F0,$0A,$A5,$A6,$F0,$0C
 DFB $A5,$A1,$C9,$02,$D0,$06,$A5,$9C
 DFB $05,$A5,$85,$9C,$A5,$96,$C9,$4F
 DFB $D0,$04,$E0,$01,$F0,$26,$A5,$9E
 DFB $85,$9D,$A5,$9F,$85,$9E,$A5,$96
 DFB $C9,$4F,$D0,$0C,$E0,$02,$D0,$08
 DFB $AD,$40,$0D,$85,$9F,$4C,$64,$05
 DFB $A0,$00,$B1,$8C,$85,$9F,$E6,$8C
 DFB $D0,$02,$E6,$8D,$06,$A5,$CA,$F0
 DFB $03,$4C,$0B,$05,$A5,$9C,$A4,$96
 DFB $99,$F0,$0C,$E6,$96,$A5,$96,$C9
 DFB $50,$D0,$80,$60,$A5,$A0,$20,$73
 DFB $04,$18,$A5,$90,$65,$86,$85,$94
 DFB $A5,$91,$65,$87,$85,$95,$A5,$A7
 DFB $8D,$02,$E0,$A0,$00,$A5,$94,$8D
 DFB $00,$E0,$A5,$95,$8D,$01,$E0,$B9
 DFB $F0,$0C,$8D,$03,$E0,$E6,$94,$D0
 DFB $02,$E6,$95,$C8,$C0,$50,$D0,$E5
 DFB $60
CSKEND
CSKLEN = CSKEND-CSKILL

* === SEED POKE TABLES (LO/HI/VAL) ===
* U0: GOSPER GLIDER GUN (CANONICAL RLE)
* placed at col+2,row+2; 7 cells/byte bit0=left
GUNLO
 DFB $A3,$F3,$42,$43,$45,$91,$92,$93
 DFB $95,$E0,$E1,$E2,$E3,$30,$31,$32
 DFB $33,$81,$82,$83,$D1,$D2,$22
GUNHI
 DFB $00,$00,$01,$01,$01,$01,$01,$01
 DFB $01,$01,$01,$01,$01,$02,$02,$02
 DFB $02,$02,$02,$02,$02,$02,$03
GUNVAL
 DFB $20,$28,$03,$06,$06,$40,$08,$06
 DFB $06,$0C,$20,$10,$06,$0C,$20,$34
 DFB $28,$20,$10,$20,$40,$08,$03
* U1: GLIDERS
GLILO
 DFB $F0,$F4,$40,$44,$90,$94,$4D,$9D
 DFB $EC,$ED,$60,$B0,$00,$A7,$F7,$47
GLIHI
 DFB $00,$00,$01,$01,$01,$01,$06,$06
 DFB $06,$06,$09,$09,$0A,$0F,$0F,$10
GLIVAL
 DFB $10,$08,$20,$10,$38,$1C,$01,$02
 DFB $40,$03,$10,$20,$38,$04,$08,$0E
* U2: BLINKERS
BLILO
 DFB $21,$25,$26,$BA,$4E,$71,$82,$83
 DFB $A8,$D5,$1C,$4C,$4D
BLIHI
 DFB $03,$03,$03,$04,$06,$09,$0C,$0C
 DFB $0F,$12,$19,$1F,$1F
BLIVAL
 DFB $38,$60,$01,$07,$1C,$0E,$40,$03
 DFB $70,$38,$70,$40,$03
* U3: R-PENTOMINO (NEAR CENTER)
PENLO
 DFB $D7,$D8,$27,$77
PENHI
 DFB $1D,$1D,$1E,$1E
PENVAL
 DFB $40,$01,$60,$40
